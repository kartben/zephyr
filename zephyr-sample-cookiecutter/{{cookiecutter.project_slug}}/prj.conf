## CMakeLists.txt
```
# SPDX-License-Identifier: Apache-2.0

cmake_minimum_required(VERSION 3.20.0)
find_package(Zephyr REQUIRED HINTS $ENV{ZEPHYR_BASE})
project({{cookiecutter.project_slug}})

target_sources(app PRIVATE src/main.c)
```

## sample.yaml
```
sample:
  name: "{{cookiecutter.project_name}}"
  description: "{{cookiecutter.project_description}}"
tests:
  sample.basic.test:
    tags: introduction
    harness: console
    harness_config:
      type: one_line
      regex:
        - ".*"
```

## prj.conf
```kconfig
# Add your configuration options here
```

## src/main.c
```c
/*
 * Copyright (c) {{cookiecutter.year}}
 *
 * SPDX-License-Identifier: Apache-2.0
 */

#include <stdio.h>
#include <zephyr/kernel.h>

int main(void)
{
	printf("{{cookiecutter.project_name}} started\n");

	/* Add your code here */

	return 0;
}
```
