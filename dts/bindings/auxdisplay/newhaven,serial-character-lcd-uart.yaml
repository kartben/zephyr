## dts/bindings/display/zephyr,palette-dither-display.yaml
```yaml
# SPDX-FileCopyrightText: Copyright The Zephyr Project Contributors
# SPDX-License-Identifier: Apache-2.0

title: |
  Virtual display wrapper for palette-backed displays.

description: |
  This node references another display device and exposes a new display device
  which accepts RGB565, RGB888, or I_4 writes. Non-indexed writes are
  dithered to the wrapped display's palette and forwarded as I_4.

  I_4 writes are passed through without dithering.

compatible: "zephyr,palette-dither-display"

include: display-controller.yaml

properties:
  display:
    type: phandle
    required: true
    description: Wrapped display device. It must support PIXEL_FORMAT_I_4.

  pixel-format:
    type: int
    required: true
    description: Initial pixel format exposed by the virtual display.
    enum:
      - 1 # PANEL_PIXEL_FORMAT_RGB_888
      - 16 # PANEL_PIXEL_FORMAT_RGB_565
      - 8192 # PANEL_PIXEL_FORMAT_I_4

  dithering-algorithm:
    type: string
    default: "ordered-bayer-4x4"
    enum:
      - "none"
      - "ordered-bayer-4x4"
      - "ordered-bayer-8x8"
      - "floyd-steinberg"
    description: |
      Algorithm used when RGB565 or RGB888 writes are converted to the wrapped display's I_4 palette
      format.

      "none" maps each source pixel to the nearest palette entry. It is the fastest option and
      preserves hard edges in text, icons, and exact palette artwork.

      "ordered-bayer-4x4" is the default. It is a good general-purpose choice for small displays and
      simple graphics.

      "ordered-bayer-8x8" gives smoother gradients than 4x4 ordered dithering, but at the cost of a
      larger visible ordered pattern.

      "floyd-steinberg" diffuses quantization error between neighboring pixels. It is typically
      slower and more memory-intensive, but gives the best average tone and hue accuracy for photos
      and smooth gradients.

examples:
  - |
    #include <zephyr/dt-bindings/display/panel.h>

    palette_display: palette-dither-display {
      compatible = "zephyr,palette-dither-display";
      display = <&sdl_dc>;
      width = <480>;
      height = <272>;
      pixel-format = <PANEL_PIXEL_FORMAT_RGB_565>;
      dithering-algorithm = "ordered-bayer-4x4";
    };
```

## dts/bindings/firmware/arm,scmi-clock.yaml
```yaml
# Copyright 2024 NXP
# SPDX-License-Identifier: Apache-2.0

title: Arm SCMI clock management

description: |
  Arm SCMI (System Control and Management Interface) clock management protocol node
  (protocol ID: 0x14). This is a child node of the SCMI transport node and provides
  clock control and rate configuration capabilities through the SCMI interface.

compatible: "arm,scmi-clock"

include: [base.yaml, clock-controller.yaml]

properties:
  shmem:
    type: phandles

  reg:
    required: true
    const: [0x14]

  "#clock-cells":
    required: true
    const: 1
    description: |
      Vendor-specific clock identifier. Needs to match identifier
      expected by the SCMI platform as this is directly used in SCMI
      clock management messages.

clock-cells:
  - name
```

## dts/bindings/firmware/arm,scmi-pinctrl.yaml
```yaml
# Copyright 2024 NXP
# SPDX-License-Identifier: Apache-2.0

title: Arm SCMI pin control

description: |
  Arm SCMI (System Control and Management Interface) pin control protocol node
  (protocol ID: 0x19). This is a child node of the SCMI transport node and provides
  pin multiplexing and configuration capabilities through the SCMI interface.

compatible: "arm,scmi-pinctrl"

include: base.yaml

properties:
  reg:
    required: true
    const: [0x19]

child-binding:
  description: SCMI pin protocol pin group
  properties:
    pinmux:
      required: true
      type: array
```

## dts/bindings/firmware/arm,scmi-power.yaml
```yaml
# Copyright 2024 NXP
# SPDX-License-Identifier: Apache-2.0

title: Arm SCMI power domain management

description: |
  Arm SCMI (System Control and Management Interface) power domain management protocol
  node (protocol ID: 0x11). This is a child node of the SCMI transport node and provides
  power domain control capabilities through the SCMI interface. It acts as a provider of
  power domains, with each domain identified by a vendor-specific identifier.

compatible: "arm,scmi-power"

include: [base.yaml]

properties:
  reg:
    required: true
    const: [0x11]

  "#power-domain-cells":
    type: int
    required: true
    const: 1

power-domain-cells:
  - name
```

## dts/bindings/firmware/arm,scmi-shmem.yaml
```yaml
# Copyright 2024 NXP
# SPDX-License-Identifier: Apache-2.0

title: Arm SCMI shared memory region

description: |
  Shared memory region used by the Arm SCMI (System Control and Management Interface)
  transport for message exchange between the SCMI agent and platform. This node
  describes the memory area where SCMI messages are written and read.

compatible: "arm,scmi-shmem"

include: [base.yaml]

properties:
  reg:
    required: true
```

## dts/bindings/firmware/arm,scmi-system.yaml
```yaml
# Copyright 2025 NXP
# SPDX-License-Identifier: Apache-2.0

title: Arm SCMI system power management

description: |
  Arm SCMI (System Control and Management Interface) system power management protocol
  node (protocol ID: 0x12). This is a child node of the SCMI transport node and
  provides system-level power state control capabilities, such as system reset and
  shutdown, through the SCMI interface.

compatible: "arm,scmi-system"

include: [base.yaml]

properties:
  reg:
    required: true
    const: [0x12]
```

## dts/bindings/firmware/nxp,scmi-cpu.yaml
```yaml
# Copyright 2025 NXP
# SPDX-License-Identifier: Apache-2.0

title: NXP SCMI CPU domain management

description: |
  NXP vendor-specific SCMI (System Control and Management Interface) CPU domain
  management protocol node (protocol ID: 0x82). This is a child node of the SCMI
  transport node and provides CPU domain management capabilities specific to NXP
  platforms through the SCMI interface.

compatible: "nxp,scmi-cpu"

include: [base.yaml]

properties:
  reg:
    required: true
    const: [0x82]
```

## dts/bindings/gpio/ti,sn74hc138.yaml
```yaml
# Copyright (c) 2024 Benjamin Cabé <benjamin@zephyrproject.org>
# SPDX-License-Identifier: Apache-2.0

description: SN74HC138 3-to-8 decoder based GPIO expander

compatible: "ti,sn74hc138"

include: [gpio-controller.yaml, base.yaml]

properties:
  reg:
    required: true

  "#gpio-cells":
    const: 2

  ngpios:
    type: int
    required: true
    const: 8
    description: Number of GPIOs supported

  input-a-gpios:
    type: phandle-array
    required: true
    description: Pin used to control the A (least significant bit) input of the decoder

  input-b-gpios:
    type: phandle-array
    required: true
    description: Pin used to control the B input of the decoder

  input-c-gpios:
    type: phandle-array
    required: true
    description: Pin used to control the C (most significant bit) input of the decoder

gpio-cells:
  - pin
  - flags
```

## dts/bindings/input/csmic,si12t.yaml
```yaml
# SPDX-FileCopyrightText: Copyright The Zephyr Project Contributors
# SPDX-License-Identifier: Apache-2.0

description: Nanjing Zhongke Microelectronics Si12T capacitive touch sensor

compatible: "csmic,si12t"

include: i2c-device.yaml

properties:
  interrupt-gpios:
    type: phandle-array
    description: |
      The interrupt line is asserted when at least one "key" is pressed.

  threshold-windows:
    type: string-array
    required: true
    description: |
      Array of threshold windows for touch detection. Length must match input-codes.

      Values:
      - "narrow": Narrower detection window around the midpoint. Requires a firmer or stronger touch
        to register (i.e. less sensitive).
      - "wide": Wider detection window. Detects smaller capacitance changes, making it more
        sensitive to light touches.

  threshold-midpoints:
    type: uint8-array
    required: true
    description: |
      Array of threshold midpoints (0-7, M[2:0]). Higher values = more sensitive.
      Length must match input-codes.

      The sensor reports touch strength based on capacitance change relative to
      the midpoint:

      - 0 (none): below lower bound
      - 1 (low touch): between lower bound and midpoint
      - 2 (medium touch): at or near midpoint
      - 3 (high touch): above midpoint toward upper bound

      Example thresholds (capacitance change %) for "wide" (1) window:

        Level | Low bound | Midpoint | High bound
        ------|-----------|----------|------------
          0   |   0.40%   |   0.50%  |   0.60%
          3   |   0.95%   |   1.20%  |   1.45%
          7   |   2.85%   |   3.55%  |   4.30%

  input-codes:

    type: array
    required: true
    description: |
      Array of input event key codes (INPUT_KEY_* or INPUT_BTN_*).

      The Si12T supports up to 12 capacitive touch channels. Each index in this
      array corresponds to a channel (0-11).
      Input events report touch strength as the value (0=none, 1=low, 2=medium, 3=high).
```
