## dts/bindings/auxdisplay/newhaven,serial-character-lcd-uart.yaml
```yaml
# Copyright (c) 2026
# SPDX-License-Identifier: Apache-2.0

title: Newhaven serial character LCD on UART

compatible: "newhaven,serial-character-lcd"

include: ["newhaven,serial-character-lcd-common.yaml", uart-device.yaml]
```

## dts/bindings/biometrics/dfrobot,ai10.yaml
```yaml
# SPDX-FileCopyrightText: Copyright The Zephyr Project Contributors
# SPDX-License-Identifier: Apache-2.0

description: |
  DFRobot AI10 face and palm-vein recognition module (e.g. SEN0677).

  The module communicates over UART at a fixed baud rate of 115200 using a
  binary framed protocol. It stores up to 1000 face and 1000 palm-vein
  templates on-device; face templates are assigned user IDs 1-1000 and
  palm-vein templates user IDs 1001-2000.

  Datasheet: https://dfimg.dfrobot.com/wiki/21122/SEN0677_ai-binocular-face-palm-vein-qr-code-recognition-sensor_datasheet_V1.0.pdf

compatible: "dfrobot,ai10"

include: [uart-device.yaml]

examples:
  - |
    &uart1 {
      status = "okay";
      current-speed = <115200>;

      ai10: ai10 {
        compatible = "dfrobot,ai10";
        status = "okay";
      };
    };
```

## dts/bindings/biometrics/dfrobot,id809-i2c.yaml
```yaml
# SPDX-License-Identifier: Apache-2.0
# Copyright (c) 2025 Siratul Islam

description: |
  DFRobot ID809 Capacitive Fingerprint Sensor (SEN0348) - I2C variant

  High-performance capacitive fingerprint scanner based on the ID809
  processor. Communicates over I2C at address 0x1F (default) using the
  same fixed-frame protocol as the UART variant. Supports 360-degree
  recognition, self-learning, duplicate detection, and an RGB LED indicator.

  Example:
    &i2c0 {
      id809: id809@1f {
        compatible = "dfrobot,id809-i2c";
        reg = <0x1f>;
        max-templates = <80>;
      };
    };

compatible: "dfrobot,id809-i2c"

include: [i2c-device.yaml]

properties:
  max-templates:
    type: int
    default: 80
    description: |
      Maximum number of fingerprint templates the module can store.
      The ID809 firmware ships with a capacity of 80 templates (default).
      Some firmware versions support up to 200 templates.
```

## dts/bindings/biometrics/dfrobot,id809.yaml
```yaml
# SPDX-License-Identifier: Apache-2.0

description: |
  DFRobot ID809 capacitive fingerprint sensor.

  The ID809 uses a framed packet protocol over I2C and supports on-device
  enrollment, verification, identification, template management, and LED
  control.

compatible: "dfrobot,id809"

include: [i2c-device.yaml]

properties:
  max-templates:
    type: int
    required: true
    description: |
      Maximum number of fingerprint templates the connected module can store.
      Common variants support 80 or 200 templates.

  template-size:
    type: int
    default: 1008
    description: |
      Size of a single fingerprint template in bytes. ID809 modules use
      1008-byte templates when uploading or downloading template data.
```

## dts/bindings/buzzer/i2s-buzzer.yaml
```yaml
# SPDX-FileCopyrightText: Copyright The Zephyr Project Contributors
# SPDX-License-Identifier: Apache-2.0

title: I2S-driven buzzer

description: |
  Buzzer connected to an I2S transmit controller. The driver synthesizes
  a square wave from the runtime buzzer API requests, so the devicetree
  node only describes the presence of the buzzer on the I2S bus.

compatible: "i2s-buzzer"

include: i2s-device.yaml
```

## dts/bindings/cpu/xuantie,e906.yaml
```yaml
# Copyright (c) 2025 Andes Technology Corporation
# SPDX-License-Identifier: Apache-2.0

description: Xuantie E906 Core CPU

compatible: "xuantie,e906"

include: riscv-common.yaml

properties:
  hardware-exec-breakpoint-count:
    type: int
    description: Number of hardware break points
```

## dts/bindings/debug/arm,coresight-etm4x.yaml
```yaml
# Copyright (c) 2026 Benjamin Cabé
# SPDX-License-Identifier: Apache-2.0

description: |
  Arm CoreSight Embedded Trace Macrocell (ETMv4 / ETM-M33).

  The ETM is a trace source that traces the executed instruction stream of a
  CPU. Its ATB output is routed through the SoC CoreSight trace fabric to a sink
  (ETB/ETF/ETR). The captured stream is decoded offline against the application
  image.

compatible: "arm,coresight-etm4x"

include: [base.yaml]

properties:
  reg:
    required: true

  arm,trace-id:
    type: int
    default: 0x10
    description: |
      ATB trace ID assigned to this ETM. Must match the ID forwarded to the
      trace sink by the SoC trace fabric. The values 0x00 and 0x70-0x7F are
      reserved by the CoreSight architecture and must not be used.
```

## dts/bindings/debug/arm,coresight-tmc.yaml
```yaml
# Copyright (c) 2026 Benjamin Cabé
# SPDX-License-Identifier: Apache-2.0

description: |
  Arm CoreSight Trace Memory Controller (TMC).

  A TMC is a trace sink that can be configured as an Embedded Trace Buffer (ETB,
  on-chip SRAM), an Embedded Trace FIFO (ETF) or an Embedded Trace Router (ETR,
  routing trace to system memory). It captures the formatted CoreSight trace
  stream emitted by trace sources such as an ETM or STM.

compatible: "arm,coresight-tmc"

include: [base.yaml]

properties:
  reg:
    required: true

  arm,sink-mode:
    type: string
    enum:
      - etb
      - etf
      - etr
    description: |
      How this TMC instance is configured. Optional; if omitted it can be
      derived at runtime from the TMC DEVID register.

  memory-region:
    type: phandle
    description: |
      For an ETR, the system memory region used as the trace buffer.
```

## dts/bindings/debug/nordic,coresight-nrf.yaml
```yaml
# Copyright (c) 2025 Nordic Semiconductor ASA
# SPDX-License-Identifier: Apache-2.0

description: Nordic Coresight Subsystem (Trace Port Interface Unit)

compatible: "nordic,coresight-nrf"

include: [base.yaml, pinctrl-device.yaml, nordic-clockpin.yaml]

properties:
  reg:
    required: true

  mode:
    required: true
    type: string
    enum:
      - "unconfigured"
      - "stm-tpiu"
      - "stm-etr"
      - "etm-etb"
      - "etm-etr"
    description: >
      Specifies which mode to configure the Coresight subsystem in. The "etm-*"
      modes route Embedded Trace Macrocell (ETM) instruction trace through the
      ATB fabric to the on-chip ETB or ETR sink for capture via the ETM trace
      API (see CONFIG_ETM_TRACE).
```

## dts/bindings/display/eink,t133a01.yaml
```yaml
# Copyright (c) 2026 The Zephyr Project Contributors
# SPDX-License-Identifier: Apache-2.0

title: E-Ink T133A01 Display Controller

description: |
  Controller of the E-Ink T133A01 Spectra 6 e-ink display, as found on the
  Seeed Studio reTerminal E1004 (13.3", 1200x1600, 6 colors).

  The T133A01 belongs to the same controller family as the ED2208-GCA but is
  a dual-controller panel: two controller dies share the SPI clock, data and
  data/command lines but each has its own chip-select and drives one half of
  the panel. The "master" chip-select is provided through the parent MIPI DBI
  SPI controller (via the device 'reg' and the SPI controller 'cs-gpios'),
  while the "slave" chip-select is driven directly by the driver through
  'slave-cs-gpios'.

compatible: "eink,t133a01"

include:
  - display-controller.yaml
  - name: mipi-dbi-spi-device.yaml
    property-blocklist:
      - te-delay

properties:
  busy-gpios:
    type: phandle-array
    required: true
    description: |
      BUSY_N status GPIO.

      The BUSY_N pin is active low. If connected directly the MCU pin
      should be configured as active low.

  slave-cs-gpios:
    type: phandle-array
    required: true
    description: |
      Chip-select GPIO of the second ("slave") controller die. Active low.

  enable-gpios:
    type: phandle-array
    description: |
      Panel power-enable GPIO. Driven to its active level during
      initialization to power the panel logic. Active high.
```

## dts/bindings/display/gooddisplay,gdep073e01.yaml
```yaml
# Copyright (c) 2026
# SPDX-License-Identifier: Apache-2.0

description: Good Display GDEP073E01 (Spectra 6, UC8159-class) EPD on UC81xx driver

compatible: gooddisplay,gdep073e01

include: ultrachip,uc81xx-common.yaml
```

## dts/bindings/display/ite,it8951.yaml
```yaml
# Copyright (c) 2026 The Zephyr Project Contributors
# SPDX-License-Identifier: Apache-2.0

title: ITE IT8951 e-paper display controller

description: |
  ITE IT8951 e-paper display controller, communicating via SPI with a custom
  16-bit preamble-based host-interface protocol.

  The controller is suitable for large reflective e-paper panels such as the
  E Ink ED103TC2 (10.3-inch, 1872 × 1404 pixels, 16 grey levels).

  The SPI bus must be configured in mode 0 (CPOL=0, CPHA=0), MSB-first.
  The maximum supported SPI clock frequency is 24 MHz.

  Example board-level DTS fragment (IT8951 driving an ED103TC2 panel):

    #include <zephyr/dt-bindings/display/it8951.h>

    &spi1 {
        epd: it8951@0 {
            compatible = "ite,it8951";
            reg = <0>;
            spi-max-frequency = <12000000>;
            width = <1872>;
            height = <1404>;
            hrdy-gpios = <&gpio0 5 GPIO_ACTIVE_HIGH>;
            reset-gpios = <&gpio0 6 GPIO_ACTIVE_LOW>;
            waveform-mode = <IT8951_WAVEFORM_GC16>;
        };
    };

compatible: "ite,it8951"

include:
  - display-controller.yaml
  - spi-device.yaml

properties:
  hrdy-gpios:
    type: phandle-array
    required: true
    description: |
      Hardware-ready (HRDY) GPIO.

      The IT8951 asserts this pin high when it is ready to accept the next SPI
      transaction and drives it low while processing a command or data.  The
      pin must therefore be configured as GPIO_ACTIVE_HIGH in the devicetree
      node.

  reset-gpios:
    type: phandle-array
    description: |
      Active-low hardware reset GPIO.

      When present the driver toggles this pin during initialization to perform
      a full hardware reset of the IT8951 before issuing any SPI commands.
      When absent the driver skips the hardware-reset step; the IT8951 must
      then already be in a known state at boot (e.g. from a power-on reset).

  waveform-mode:
    type: int
    default: 2
    description: |
      Default waveform (display-update algorithm) mode used when refreshing
      the e-paper panel.  Use the IT8951_WAVEFORM_* defines from
      <zephyr/dt-bindings/display/it8951.h>.

      The default (2 = IT8951_WAVEFORM_GC16) selects the GC16 algorithm,
      which delivers full 16-level grayscale quality.  Choose a faster mode
      such as IT8951_WAVEFORM_DU (1) when display latency matters more than
      image quality, or IT8951_WAVEFORM_INIT (0) to clear the panel to white
      on the first write.

  width:
    default: 1872
    description: |
      Panel width in pixels.  Defaults to 1872, the native horizontal
      resolution of the E Ink ED103TC2 10.3-inch panel.

  height:
    default: 1404
    description: |
      Panel height in pixels.  Defaults to 1404, the native vertical
      resolution of the E Ink ED103TC2 10.3-inch panel.
```

## dts/bindings/display/itead,it8951.yaml
```yaml
# SPDX-License-Identifier: Apache-2.0

title: ITEAD IT8951 e-paper controller

description: |
  IT8951 is a timing controller used by grayscale e-paper display modules.
  The host communicates with the controller over SPI and uploads image data
  into the controller's image buffer before requesting a display refresh.

compatible: "itead,it8951"

include: [spi-device.yaml, display-controller.yaml]

properties:
  busy-gpios:
    type: phandle-array
    required: true
    description: Busy/ready signal from the controller.

  reset-gpios:
    type: phandle-array
    description: Optional reset signal connected to the controller reset pin.

  vcom:
    type: int
    required: true
    description: |
      VCOM voltage in millivolts, expressed as a positive absolute value.
      This is a panel-specific parameter that must match the VCOM rating
      printed on the panel's FPC cable (e.g. -1.45 V is written as 1450).
      Using an incorrect value can permanently damage the e-paper panel.

  update-mode:
    type: int
    default: 2
    enum:
      - 0 # IT8951_DT_UPDATE_MODE_INIT
      - 1 # IT8951_DT_UPDATE_MODE_DU
      - 2 # IT8951_DT_UPDATE_MODE_GC16
      - 3 # IT8951_DT_UPDATE_MODE_GL16
      - 4 # IT8951_DT_UPDATE_MODE_GLR16
    description: |
      Waveform mode used when refreshing the panel.
      GC16 (mode 2) is the default as it delivers full 16-level grayscale
      quality and is suitable for most display content. Use DU for the
      fastest monochrome updates or INIT for a full-screen clear that
      removes ghosting after prolonged use.
      Use the IT8951_DT_UPDATE_MODE_* constants from
      <zephyr/dt-bindings/display/it8951.h>.

examples:
  - |
    #include <zephyr/dt-bindings/display/it8951.h>

    &spi0 {
      it8951: it8951@0 {
        compatible = "itead,it8951";
        reg = <0>;
        spi-max-frequency = <12000000>;
        width = <1872>;
        height = <1404>;
        busy-gpios = <&gpio0 5 GPIO_ACTIVE_HIGH>;
        reset-gpios = <&gpio0 6 GPIO_ACTIVE_LOW>;
        vcom = <1400>;
        update-mode = <IT8951_DT_UPDATE_MODE_GC16>;
      };
    };
```

## dts/bindings/display/led-strip-pov.yaml
```yaml
# SPDX-License-Identifier: Apache-2.0

description: |
  Persistence-of-vision display driven by a single LED strip. The strip is
  refreshed column by column while a tachometer provides rotation speed
  feedback. The configured height must match the LED strip chain length.

compatible: "led-strip-pov"

include: display-controller.yaml

properties:
  led-strip:
    type: phandle
    required: true
    description: |
      Reference to the LED strip device used to emit the column pixels. The
      referenced strip must expose a chain-length property equal to the
      configured display height.

  tachometer:
    type: phandle
    required: true
    description: |
      Tachometer sensor that reports the rotation speed in RPM via the
      SENSOR_CHAN_RPM channel. The driver uses this to adjust the refresh rate.

  pixel-format:
    type: int
    enum:
      - PANEL_PIXEL_FORMAT_RGB_888
      - PANEL_PIXEL_FORMAT_ARGB_8888
    default: PANEL_PIXEL_FORMAT_RGB_888
    description: |
      Pixel format accepted by the driver. Either RGB888 or ARGB8888 buffers are
      supported.

  default-rpm:
    type: int
    description: |
      Default RPM used when the tachometer does not report a valid speed. If not
      provided, the driver falls back to the Kconfig default.

  rpm-timeout-ms:
    type: int
    description: |
      Time window in milliseconds after which a missing tachometer update
      forces the driver to revert to the default RPM.

  sensor-poll-ms:
    type: int
    description: |
      Interval in milliseconds between tachometer polling operations.
```

## dts/bindings/display/solomon,ssd1677.yaml
```yaml
# Copyright (c) 2026
# SPDX-License-Identifier: Apache-2.0

description: |
  Solomon Systech SSD1677 EPD display controller (e.g. Good Display GDEQ0426T82 800x480).

  The SSD1677 uses 16-bit X and Y addressing for RAM window commands and expects the
  driver output gate count to match panel height minus one.

compatible: "solomon,ssd1677"

include: solomon,ssd16xx-common.yaml
```

## dts/bindings/display/ultrachip,uc8159c.yaml
```yaml
# Copyright (c) 2026
# SPDX-License-Identifier: Apache-2.0

description: UltraChip UC8159C EPD controller (color / multi-level, DTM1 packed pixels)

compatible: "ultrachip,uc8159c"

include: ultrachip,uc81xx-common.yaml
```
