## dts/bindings/input/input-keymap.yaml
```yaml
# Copyright 2024 Google LLC
# SPDX-License-Identifier: Apache-2.0

description: |
  Row-column to key mapper

  Listens for row-column events from the parent device and reports key events.
  Optional child nodes can define sparse layers selected by held modifier keys.

compatible: "input-keymap"

properties:
  keymap:
    type: array
    required: true
    description: |
      List of codes, using the MATRIX_KEY() macro.

  row-size:
    type: int
    required: true
    description: |
      The number of rows in the keymap.

  col-size:
    type: int
    required: true
    description: |
      The number of columns in the keymap.

child-binding:
  description: |
    Modifier-activated keymap layer.

  properties:
    modifier-codes:
      type: array
      required: true
      description: |
        Modifier key codes that activate the layer. Supported codes are
        INPUT_KEY_LEFTCTRL, INPUT_KEY_LEFTSHIFT, INPUT_KEY_LEFTALT,
        INPUT_KEY_LEFTMETA, INPUT_KEY_RIGHTCTRL, INPUT_KEY_RIGHTSHIFT,
        INPUT_KEY_RIGHTALT, and INPUT_KEY_RIGHTMETA.

    keymap:
      type: array
      required: true
      description: |
        Sparse list of key codes for this layer, using the MATRIX_KEY() macro.
        If a key is not present, matching falls back to less specific layers and
        then to the base keymap.

examples:
  - |
    #include <zephyr/dt-bindings/input/input-event-codes.h>
    #include <zephyr/dt-bindings/input/keymap.h>

    kbd {
        /* ... */
        keymap {
            compatible = "input-keymap";
            keymap = <
                MATRIX_KEY(0, 0, INPUT_KEY_1)
                MATRIX_KEY(0, 1, INPUT_KEY_2)
                MATRIX_KEY(0, 2, INPUT_KEY_3)
                MATRIX_KEY(1, 0, INPUT_KEY_4)
                MATRIX_KEY(1, 1, INPUT_KEY_5)
                MATRIX_KEY(1, 2, INPUT_KEY_6)
                MATRIX_KEY(2, 0, INPUT_KEY_7)
                MATRIX_KEY(2, 1, INPUT_KEY_8)
                MATRIX_KEY(2, 2, INPUT_KEY_9)
            >;
            row-size = <3>;
            col-size = <3>;

            shift_layer {
                modifier-codes = <INPUT_KEY_LEFTSHIFT INPUT_KEY_RIGHTSHIFT>;
                keymap = <
                    MATRIX_KEY(0, 0, INPUT_KEY_F1)
                    MATRIX_KEY(0, 1, INPUT_KEY_F2)
                >;
            };
        };
    };
```

## dts/bindings/input/lilygo,t-deck-keyboard.yaml
```yaml
# SPDX-FileCopyrightText: Copyright The Zephyr Project Contributors
# SPDX-License-Identifier: Apache-2.0

description: |
  LilyGO T-Deck external keyboard controller.

  The keyboard is implemented by a dedicated microcontroller on the T-Deck base
  board. In the default key mode, each I2C read returns a single byte: the ASCII
  character for the last key press, or 0x00 when no key is pending.

compatible: "lilygo,t-deck-keyboard"

include: i2c-device.yaml

properties:
  polling-interval-ms:
    type: int
    default: 16
    description: |
      Interval between consecutive keyboard polls in milliseconds.
```

## dts/bindings/input/lilygo,tdeck-keyboard.yaml
```yaml
# SPDX-FileCopyrightText: Copyright The Zephyr Project Contributors
# SPDX-License-Identifier: Apache-2.0

description: |
  LilyGO T-Deck keyboard coprocessor.

  The keyboard is exposed over I2C by the onboard keyboard coprocessor firmware.
  This driver switches the keyboard into raw matrix mode and reports row/column
  events through the Zephyr input subsystem.

compatible: "lilygo,tdeck-keyboard"

include:
  - base.yaml
  - i2c-device.yaml

properties:
  polling-interval-ms:
    type: int
    default: 10
    description: |
      Polling interval for reading keyboard matrix state from the coprocessor.

examples:
  - |
    #include <zephyr/dt-bindings/input/input-event-codes.h>
    #include <zephyr/dt-bindings/input/keymap.h>

    &i2c0 {
      status = "okay";

      keyboard@55 {
        compatible = "lilygo,tdeck-keyboard";
        reg = <0x55>;
        polling-interval-ms = <10>;

        keymap {
          compatible = "input-keymap";
          row-size = <7>;
          col-size = <5>;
          keymap = <MATRIX_KEY(3, 3, INPUT_KEY_ENTER)
                    MATRIX_KEY(3, 4, INPUT_KEY_BACKSPACE)
                    MATRIX_KEY(5, 0, INPUT_KEY_SPACE)>;
        };
      };
    };
```

## dts/bindings/input/zephyr,input-double-tap.yaml
```yaml
# Copyright 2024 Kelly Helmut Lord
# SPDX-License-Identifier: Apache-2.0

description: |
  Input double tap pseudo-device

  Transforms key press events into distinct events for single and double taps.
  Listens for key events from an input device and generates output events based
  on tap patterns within a configurable time window.

  Can optionally be associated to a specific device to listen for events
  only from that device.

  Example configuration:

  #include <zephyr/dt-bindings/input/input-event-codes.h>

  double_tap {
          input = <&buttons>;
          compatible = "zephyr,input-double-tap";
          input-codes = <INPUT_KEY_0>, <INPUT_KEY_1>;
          double-tap-codes = <INPUT_KEY_A>, <INPUT_KEY_B>;
          single-tap-codes = <INPUT_KEY_C>, <INPUT_KEY_D>;
          double-tap-delay-ms = <300>;
  };

  Example output:

  # double tap
  input event: dev=buttons          SYN type= 1 code= 11 value=1 # INPUT_KEY_0 press
  input event: dev=buttons          SYN type= 1 code= 11 value=0 # INPUT_KEY_0 release
  # second press within 300ms
  input event: dev=buttons          SYN type= 1 code= 11 value=1 # INPUT_KEY_0 press
  input event: dev=double_tap       SYN type= 1 code= 30 value=1 # INPUT_KEY_A press
  input event: dev=double_tap       SYN type= 1 code= 30 value=0 # INPUT_KEY_A release

  # single tap (when single-tap-codes is configured)
  input event: dev=buttons          SYN type= 1 code= 11 value=1 # INPUT_KEY_0 press
  input event: dev=buttons          SYN type= 1 code= 11 value=0 # INPUT_KEY_0 release
  # no second press within 300ms
  input event: dev=double_tap       SYN type= 1 code= 47 value=1 # INPUT_KEY_C press
  input event: dev=double_tap       SYN type= 1 code= 47 value=0 # INPUT_KEY_C release

compatible: "zephyr,input-double-tap"

properties:
  input:
    type: phandle
    description: |
      Input device phandle, if not specified listen for input from all devices.

  input-codes:
    type: array
    required: true
    description: |
      Array of input event key codes (INPUT_KEY_* or INPUT_BTN_*).

  double-tap-codes:
    type: array
    required: true
    description: |
      Array of key codes to be generated for double taps (INPUT_KEY_* or INPUT_BTN_*).

  single-tap-codes:
    type: array
    description: |
      Array of key codes to be generated for single taps (INPUT_KEY_* or INPUT_BTN_*).
      If specified, a single tap event is generated when a tap is not followed by
      a second tap within the double-tap-delay-ms window.

  double-tap-delay-ms:
    type: int
    required: true
    description: Maximum time delay between taps to register a double tap, in milliseconds.
```

## dts/bindings/input/zephyr,input-sdl-keyboard.yaml
```yaml
description: SDL based emulated keyboard

compatible: "zephyr,input-sdl-keyboard"
```

## dts/bindings/mfd/m5stack,m5pm1.yaml
```yaml
# Copyright (c) 2026 The Zephyr Project Contributors
# SPDX-License-Identifier: Apache-2.0

description: M5Stack M5PM1 PMIC (Power Management Integrated Circuit)

compatible: "m5stack,m5pm1"

include: i2c-device.yaml

bus: m5pm1

properties:
  reg:
    required: true
```

## dts/bindings/misc/epson,escp.yaml
```yaml
# Copyright (c) 2025 Zephyr Project
# SPDX-License-Identifier: Apache-2.0

description: Epson ESC/P printer

compatible: "epson,escp"

include: uart-device.yaml
```

## dts/bindings/misc/epson,escpos.yaml
```yaml
# Copyright (c) 2025 Zephyr Project
# SPDX-License-Identifier: Apache-2.0

description: Epson ESC/POS thermal printer

compatible: "epson,escpos"

include: uart-device.yaml
```

## dts/bindings/misc/feetech,scservo.yaml
```yaml
# Copyright (c) 2026 Your Name
# SPDX-License-Identifier: Apache-2.0

description: FeeeTech SCServo serial bus servo

compatible: "feetech,scservo"

include: uart-device.yaml

properties:
  servo-id:
    type: int
    required: true
    description: |
      The servo ID on the serial bus (0-253).
      ID 254 (0xFE) is the broadcast address.
```

## dts/bindings/pinctrl/pinctrl-provider.yaml
```yaml
# Copyright (c) 2026 The Zephyr Project Contributors
# SPDX-License-Identifier: Apache-2.0

description: Common fields for pinctrl provider devices

properties:
  "pinctrl-provider":
    type: boolean
    required: true
    description: |
      This node can be referenced by provider-backed pinctrl state nodes
      through ``pinctrls`` specifiers.

  "#pinctrl-cells":
    type: int
    required: true
    const: 2
    description: |
      Number of cells expected in a provider-backed pinctrl specifier.
      The standard cell names are ``pin`` and ``value``.
```

## dts/bindings/power-domain/arm,scmi-power-domain.yaml
```yaml
# Copyright 2026 NXP
# SPDX-License-Identifier: Apache-2.0

title: Arm SCMI power domain

description: |
  Power domain managed through the Arm SCMI (System Control and Management Interface)
  power domain management protocol (protocol ID: 0x11). Each instance of this node
  corresponds to an individual power domain identified by a vendor-specific domain ID.

compatible: "arm,scmi-power-domain"

include: power-domain.yaml

properties:
  reg:
    required: true
    description: SCMI power domain ID
```

## dts/bindings/regulator/m5stack,m5pm1-regulator.yaml
```yaml
# Copyright (c) 2026 Benjamin Cabé <benjamin@zephyrproject.org>
# SPDX-License-Identifier: Apache-2.0

title: M5Stack M5PM1 PMIC regulators

description: |
  The PMIC exposes three switchable rails. Children must be named
  exactly "DCDC", "LDO" and "BOOST".

  - DCDC:  5.0 V (5 V DCDC output)
  - LDO:   3.3 V (3.3 V LDO output)
  - BOOST: 5.0 V (Grove 5VINOUT boost)

  Voltages are not adjustable.

compatible: "m5stack,m5pm1-regulator"

include: base.yaml

child-binding:
  include:
    - name: regulator.yaml
      property-allowlist:
        - regulator-name
        - regulator-always-on
        - regulator-boot-on

examples:
  - |
    m5pm1@6e {
      compatible = "m5stack,m5pm1";
      reg = <0x6e>;

      regulators {
        compatible = "m5stack,m5pm1-regulator";

        DCDC {
          regulator-name = "dcdc_5v";
        };
        LDO {
          regulator-name = "ldo_3v3";
          regulator-boot-on;
        };
        BOOST {
          regulator-name = "boost_5v";
        };
      };
    };
```

## dts/bindings/rng/microchip,rng90.yaml
```yaml
# Copyright (c) 2026 The Zephyr Project Contributors
# SPDX-License-Identifier: Apache-2.0

title: Microchip RNG90 I2C entropy source

description: |
  Microchip RNG90 CryptoAuthentication secure random number generator (I2C).

  The device exposes a fixed 7-bit I2C address of 0x40 and provides 256-bit
  random outputs per Random command (see DS40002499A).

compatible: "microchip,rng90"

include: i2c-device.yaml
```

## dts/bindings/sensor/honeywell,mpr-spi.yaml
```yaml
# SPDX-License-Identifier: Apache-2.0

description: |
    Honeywell Digital Pressure Sensor (SPI). For details see here:
    https://sensing.honeywell.com/micropressure-mpr-series

compatible: "honeywell,mpr"

include: [sensor-device.yaml, spi-device.yaml]
```

## dts/bindings/sensor/seeed,grove-multichannel_gas_v2.yaml
```yaml
# Copyright (c) 2019 Nordic Semiconductor ASA
# SPDX-License-Identifier: Apache-2.0

description: Grove Multichannel Gas Sensor V2.0

compatible: "seeed,grove-multichannel-gas-v2"

include: [sensor-device.yaml, i2c-device.yaml]

properties:
  vref-mv:
    required: true
    default: 3300
    description: Corresponds to the voltage used to supply power to the multichannel gas sensor.
```

## dts/bindings/sensor/seeed,mr60bha2.yaml
```yaml
# SPDX-FileCopyrightText: Copyright The Zephyr Project Contributors
# SPDX-License-Identifier: Apache-2.0

description: |
  Seeed Studio MR60BHA2 60 GHz mmWave breathing and heartbeat radar sensor.

compatible: "seeed,mr60bha2"

include: [sensor-device.yaml, uart-device.yaml]
```

## dts/bindings/spi/raspberrypi,pico-spi-pio.yaml
```yaml
# Copyright (c) 2023 Stephen Boylan <stephen.boylan@beechwoods.com>
# SPDX-License-Identifier: Apache-2.0

description: Raspberry Pi Pico SPI via PIO

compatible: "raspberrypi,pico-spi-pio"

include: ["spi-controller.yaml", "raspberrypi,pico-pio-device.yaml", "reset-device.yaml"]

properties:
  clk-gpios:
    type: phandle-array
    required: true
    description: |
      Output pin for SPI clock

  mosi-gpios:
    type: phandle-array
    description: |
      Output pin for Controller Out Peripheral In.

  miso-gpios:
    type: phandle-array
    description: |
      Input pin for Controller In Peripheral Out.

  sio-gpios:
    type: phandle-array
    description: |
      Single I/O gpio info

      GPIO input/output pin for 3-wire mode.

  clocks:
    required: true
```

## dts/bindings/test/vnd,pinctrl-provider-map.yaml
```yaml
# Copyright (c) 2026 The Zephyr Project Contributors
# SPDX-License-Identifier: Apache-2.0

description: Test pinctrl provider-backed state map

compatible: "vnd,pinctrl-provider-map"

include: base.yaml

child-binding:
  properties:
    pinctrls:
      type: phandle-array
      required: true
      specifier-space: pinctrl
```

## dts/bindings/test/vnd,pinctrl-provider.yaml
```yaml
# Copyright (c) 2026 The Zephyr Project Contributors
# SPDX-License-Identifier: Apache-2.0

description: Test pinctrl provider

compatible: "vnd,pinctrl-provider"

include: [base.yaml, pinctrl-provider.yaml]

pinctrl-cells:
  - pin
  - value
```

## lib/homeassistant/Kconfig
```kconfig
# Copyright (c) 2025
# SPDX-License-Identifier: Apache-2.0

menu "Home Assistant Integration"

config HOMEASSISTANT
	bool "Home Assistant integration support [EXPERIMENTAL]"
	select EXPERIMENTAL
	select NET_SOCKETS
	select JSON_LIBRARY
	help
	  Enable Home Assistant integration library for Zephyr.
	  This library provides simple APIs to integrate Zephyr-based
	  IoT devices with Home Assistant using MQTT discovery protocol
	  and REST API.

if HOMEASSISTANT

config HOMEASSISTANT_MQTT_DISCOVERY
	bool "Enable MQTT discovery protocol"
	default y
	select MQTT_LIB
	help
	  Enable MQTT discovery protocol support for automatic device
	  registration with Home Assistant. Devices will publish their
	  configuration to the discovery topic and Home Assistant will
	  automatically detect and configure them.

config HOMEASSISTANT_REST_API
	bool "Enable REST API support"
	default y
	select HTTP_CLIENT if HTTP
	help
	  Enable REST API support for direct communication with
	  Home Assistant. This allows devices to update states and
	  trigger automations via HTTP requests.

config HOMEASSISTANT_DEVICE_NAME_MAX_LEN
	int "Maximum device name length"
	default 64
	help
	  Maximum length of device name string.

config HOMEASSISTANT_ENTITY_ID_MAX_LEN
	int "Maximum entity ID length"
	default 64
	help
	  Maximum length of entity ID string.

config HOMEASSISTANT_MAX_ENTITIES
	int "Maximum number of entities per device"
	default 8
	range 1 32
	help
	  Maximum number of entities (sensors, switches, etc.) that
	  can be registered per device.

module=HOMEASSISTANT
module-dep=LOG
module-str=Log level for Home Assistant integration
module-help=Enables Home Assistant integration debug messages.
source "subsys/logging/Kconfig.template.log_config"

endif # HOMEASSISTANT

endmenu
```
