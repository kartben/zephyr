## dts/bindings/misc/feetech,scs0009.yaml
```yaml
# SPDX-FileCopyrightText: Copyright The Zephyr Project Contributors
# SPDX-License-Identifier: Apache-2.0

title: Feetech SCS0009 serial bus servo

description: |
  Position-controlled servo with a 0-1023 position range that can also be switched to a
  continuous rotation (PWM) mode. Other servos of the SCSCL series share its register map.

compatible: "feetech,scs0009"

on-bus: feetech-scs

include: base.yaml

properties:
  reg:
    required: true
    description: Servo ID on the bus, from 0 to 253.
```

## dts/bindings/pulse-io/nxp,flexio-pulse-io.yaml
```yaml
# SPDX-FileCopyrightText: Copyright The Zephyr Project Contributors
# SPDX-License-Identifier: Apache-2.0

title: NXP FlexIO Pulse IO controller

description: |
  Pulse IO channels built from FlexIO shifters and timers. Each channel
  uses one shifter and one timer of the parent FlexIO, allocated at boot,
  and one FlexIO pin.

  A channel shifts one bit per tick, in either direction: the tick rate
  is the FlexIO clock divided by an even number from 2 to 512, capped by
  CONFIG_PULSE_IO_NXP_FLEXIO_MAX_TICK_RATE. Channels transmit in SYMBOL
  and CELL modes and capture in SYMBOL mode. They have no carrier, loop
  or glitch filter support.

  Channel n uses the FlexIO pin given by entry n of pin-ids. Several
  channels can share a pin, for example to capture what another channel
  transmits.

  The example below provides four channels on FlexIO2 data pins 0 to 3.

compatible: "nxp,flexio-pulse-io"

include: [base.yaml, pinctrl-device.yaml, pulse-io-controller.yaml]

properties:
  pinctrl-0:
    required: true

  pinctrl-names:
    required: true

  pin-ids:
    type: array
    required: true
    description: |
      FlexIO data pin of each channel: entry n is the number 'x' of the
      FXIO_D<x> pin that channel n drives or samples.

examples:
  - |
    &flexio2 {
        status = "okay";

        pulse_io: pulse-io {
            compatible = "nxp,flexio-pulse-io";
            pinctrl-0 = <&pinmux_flexio2_pulse_io>;
            pinctrl-names = "default";
            #pulse-io-cells = <1>;
            pin-ids = <0 1 2 3>;
        };
    };
```

## dts/bindings/pulse-io/st,stm32-pulse-io.yaml
```yaml
# SPDX-FileCopyrightText: Copyright The Zephyr Project Contributors
# SPDX-License-Identifier: Apache-2.0

title: STM32 timer Pulse IO controller

description: |
  Pulse IO controller on the channels of an STM32 timer, for fixed-period
  cells (CELL mode). The channels run in PWM mode and each timer update
  event triggers a DMA burst that loads the duty cycles of the next period.
  The channels share the timer prescaler and period, and the channels of a
  multi-channel transmit start together.

  A channel with a DMA request of its own (ch1 to ch4 in dma-names) can be
  configured half duplex (PULSE_IO_DIR_TX_RX): a receive submitted with
  RTIO after a transmit captures the edges of the reply on the same line.
  The pin then needs a pull to its idle level.

  The node is a child of an st,stm32-timers node, whose other functions
  cannot be used at the same time. The pulse-ios cell is the timer channel
  index, 0 for CH1 to 3 for CH4.

compatible: "st,stm32-pulse-io"

include: [pulse-io-controller.yaml, base.yaml, pinctrl-device.yaml]

properties:
  pinctrl-0:
    required: true

  pinctrl-names:
    required: true

  dmas:
    required: true
    description: |
      DMA channel driven by the update request of the timer (TIMx_UP), and
      optionally, for the receive on a channel, a DMA channel driven by the
      capture/compare request of that channel (TIMx_CH1 to TIMx_CH4).

  dma-names:
    required: true
    description: |
      tx for the update request, ch1 to ch4 for the capture/compare
      requests of the channels.

  "#pulse-io-cells":
    const: 1

  st,max-cells:
    type: int
    default: 256
    description: |
      Maximum number of cells of a transmission, plus one for the idle cell
      that ends it. It sets the size of the DMA buffer, of 4 bytes per cell
      and channel.

  st,max-edges:
    type: int
    default: 32
    description: |
      Maximum number of edges of a receive. It sets the size of the capture
      buffer of each channel, of 4 bytes per edge, which must fill whole
      data cache lines.

examples:
  - |
    #include <zephyr/dt-bindings/dma/stm32_dma.h>

    timers3: timers@40000400 {
      compatible = "st,stm32-timers";
      /* ... */

      pio3: pulse-io {
        compatible = "st,stm32-pulse-io";
        pinctrl-0 = <&tim3_ch4_pb1>;
        pinctrl-names = "default";
        dmas = <&dmamux1 0 27 STM32_DMA_PRIORITY_HIGH>;
        dma-names = "tx";
        #pulse-io-cells = <1>;
      };
    };
```

## dts/bindings/sensor/bosch,bma4xx-common.yaml
```yaml
# Copyright (c) 2023 Google LLC
# SPDX-License-Identifier: Apache-2.0

properties:
  power-mode:
    type: string
    default: "performance"
    enum:
      - "performance"
      - "low-power"
    description: |
      Accelerometer power mode. "performance" samples continuously with the
      filter selected by the bandwidth parameter and supports 12.5 Hz to
      1600 Hz. "low-power" duty-cycles the sensor, averages 2^BWP samples
      taken at 1600 Hz per output and supports 0.78 Hz to 400 Hz at a
      fraction of the supply current; the averaging window must fit in the
      output period. The default is the reset configuration of the chip.

  int1-gpios:
    type: phandle-array
    description: |
      Identifies pin for the INT1 signal on the sensor.  The sensor
      INT2,3,4 signals are not supported by the driver.

      The driver configures INT1 as a push-pull output whose active level
      follows the polarity flag of this property.
```

## dts/bindings/sensor/goertek,spa06-common.yaml
```yaml
# SPDX-FileCopyrightText: Copyright The Zephyr Project Contributors
# SPDX-License-Identifier: Apache-2.0

include: sensor-device.yaml

properties:
  pressure-oversampling:
    type: int
    default: 16
    enum: [1, 2, 4, 8, 16, 32, 64, 128]
    description: |
      Number of pressure samples averaged into one measurement. Higher values
      lower the noise and lengthen the measurement time, from 3.6 ms for 1 to
      206.8 ms for 128. The default is the setting the datasheet calls
      standard precision. It can be changed at run time with
      SENSOR_ATTR_OVERSAMPLING.

  temperature-oversampling:
    type: int
    default: 1
    enum: [1, 2, 4, 8, 16, 32, 64, 128]
    description: |
      Number of temperature samples averaged into one measurement. The default
      is the sensor's power-on setting. It can be changed at run time with
      SENSOR_ATTR_OVERSAMPLING.

  pressure-odr:
    type: int
    enum: [0, 1, 2, 3, 4, 5, 6, 7, 8, 9, 10, 11, 12, 13, 14, 15]
    description: |
      Pressure measurement rate, one of the SPA06_DT_ODR_* values from
      <zephyr/dt-bindings/sensor/spa06.h>. When the property is present, the
      sensor measures pressure and temperature continuously from
      initialization, and a sample fetch returns the latest results. When it
      is absent, each sample fetch starts a measurement and waits for it to
      complete. The rate can be changed at run time with
      SENSOR_ATTR_SAMPLING_FREQUENCY, where 0 returns to on-demand
      measurements.

      The measurement time at each rate must add up to less than one second:
      pressure rate x pressure measurement time + temperature rate x
      temperature measurement time < 1 s. Initialization fails otherwise.

  temperature-odr:
    type: int
    default: 0
    enum: [0, 1, 2, 3, 4, 5, 6, 7, 9, 10, 11, 12, 13, 14, 15]
    description: |
      Temperature measurement rate in continuous mode, one of the
      SPA06_DT_ODR_* values except SPA06_DT_ODR_1_5625. The default is 1 Hz.
      Pressure compensation uses the latest temperature result.
```

## dts/bindings/sensor/goertek,spa06-i2c.yaml
```yaml
# SPDX-FileCopyrightText: Copyright The Zephyr Project Contributors
# SPDX-License-Identifier: Apache-2.0

description: |
  Goertek SPA06-003 barometric pressure and temperature sensor on I2C.

  The I2C address is 0x77, or 0x76 when the SDO pin is pulled low.

compatible: "goertek,spa06"

include: [i2c-device.yaml, "goertek,spa06-common.yaml"]

properties:
  int-gpios:
    type: phandle-array
    description: |
      Interrupt output, on the SDO pin. Its active level depends on the
      address strap: GPIO_ACTIVE_LOW at address 0x77, GPIO_ACTIVE_HIGH at
      address 0x76. Data-ready triggers and streaming need this property and
      a pressure-odr.

examples:
  - |
    #include <zephyr/dt-bindings/gpio/gpio.h>
    #include <zephyr/dt-bindings/sensor/spa06.h>

    &i2c0 {
      spa06@77 {
        compatible = "goertek,spa06";
        reg = <0x77>;
        int-gpios = <&gpio0 5 GPIO_ACTIVE_LOW>;
        pressure-oversampling = <16>;
        pressure-odr = <SPA06_DT_ODR_16>;
      };
    };
```

## dts/bindings/sensor/goertek,spa06-spi.yaml
```yaml
# SPDX-FileCopyrightText: Copyright The Zephyr Project Contributors
# SPDX-License-Identifier: Apache-2.0

description: |
  Goertek SPA06-003 barometric pressure and temperature sensor on 4-wire SPI.

  In this mode the SDO pin is the data output, so the sensor's interrupt
  output is not available.

compatible: "goertek,spa06"

include: [spi-device.yaml, "goertek,spa06-common.yaml"]

examples:
  - |
    &spi0 {
      spa06@0 {
        compatible = "goertek,spa06";
        reg = <0>;
        spi-max-frequency = <10000000>;
      };
    };
```

## dts/bindings/video/zephyr,video-edge264.yaml
```yaml
# Copyright The Zephyr Project Contributors
# SPDX-License-Identifier: Apache-2.0

description: Software H.264 decoder using the edge264 library

compatible: "zephyr,video-edge264"
```

## dts/bindings/wifi/realtek,rtl8720-erpc.yaml
```yaml
# Copyright The Zephyr Project Contributors
# SPDX-License-Identifier: Apache-2.0

description: |
  Realtek RTL8720 Wi-Fi/BLE module running the Seeed eRPC firmware
  (https://github.com/Seeed-Studio/seeed-ambd-firmware), which is the firmware
  Seeed ships on its boards.

  The module runs the IP stack and owns the sockets. The host drives it with
  eRPC 1.7.4 over the UART this node hangs off, so that UART's current-speed
  has to match the rate the firmware was built for, 614400 by default.

compatible: "realtek,rtl8720-erpc"

include: uart-device.yaml

properties:
  power-gpios:
    type: phandle-array
    description: |
      Chip enable line. The module is held in reset while this line is
      inactive.
```

## modules/Kconfig.adi
```kconfig
# Analog Devices MSDK HAL configuration

# SPDX-FileCopyrightText: Copyright The Zephyr Project Contributors
# SPDX-License-Identifier: Apache-2.0

zephyr-module = ADI
zephyr-module-str = adi
source "modules/Kconfig.template.module"

config HAS_MAX32_HAL
	bool
	select ZEPHYR_ADI_MODULE_ACTIVE
	help
	  The MAX32xxx peripheral drivers and register headers. Selected by the
	  SoC family, whose sources and drivers are built against them.
```

## modules/Kconfig.atmel
```kconfig
# Atmel SDK

# Copyright (c) 2016 Piotr Mienkowski
# SPDX-License-Identifier: Apache-2.0

zephyr-module = ATMEL
zephyr-module-str = atmel
source "modules/Kconfig.template.module"

config ASF
	bool
	select HAS_CMSIS_CORE
	depends on SOC_FAMILY_ATMEL_SAM || SOC_FAMILY_ATMEL_SAM0
	select ZEPHYR_ATMEL_MODULE_ACTIVE

config ATMEL_WINC1500
	bool
	select ZEPHYR_ATMEL_MODULE_ACTIVE
```

## modules/Kconfig.chre
```kconfig
# Copyright 2023 Google LLC
# SPDX-License-Identifier: Apache-2.0

zephyr-module = CHRE
zephyr-module-str = chre
source "modules/Kconfig.template.module"
```

## modules/Kconfig.eos_s3
```kconfig
# QuickLogic HAL

# Copyright (c) 2020 Antmicro Ltd <www.antmicro.com>
# SPDX-License-Identifier: Apache-2.0

zephyr-module = QUICKLOGIC
zephyr-module-str = quicklogic
source "modules/Kconfig.template.module"

config EOS_S3_HAL
	bool
	depends on SOC_EOS_S3
	select ZEPHYR_QUICKLOGIC_MODULE_ACTIVE
```

## modules/Kconfig.intel
```kconfig
# Copyright (c) 2023 Intel Corporation
# SPDX-License-Identifier: Apache-2.0

zephyr-module = HAL_INTEL
zephyr-module-str = hal_intel
source "modules/Kconfig.template.module"

config INTEL_HAL
	bool
	select ZEPHYR_HAL_INTEL_MODULE_ACTIVE
	help
	  Build the Intel HAL module during build process.
	  This is selected by the ARCH kconfig automatically.
```

## modules/Kconfig.libmctp
```kconfig
# libmctp configuration

# SPDX-FileCopyrightText: Copyright The Zephyr Project Contributors
# SPDX-License-Identifier: Apache-2.0

zephyr-module = LIBMCTP
zephyr-module-str = libmctp
source "modules/Kconfig.template.module"
```

## modules/Kconfig.libmetal
```kconfig
# Copyright (c) 2018 Linaro Limited
# SPDX-License-Identifier: Apache-2.0

zephyr-module = LIBMETAL
zephyr-module-str = libmetal
source "modules/Kconfig.template.module"

menuconfig LIBMETAL
	bool "libmetal Support"
	select ZEPHYR_LIBMETAL_MODULE_ACTIVE
	help
	  This option enables the libmetal HAL abstraction layer

config LIBMETAL_SRC_PATH
	string "libmetal library source path"
	default "libmetal"
	depends on LIBMETAL
	help
	  This option specifies the path to the source for the libmetal library
```
