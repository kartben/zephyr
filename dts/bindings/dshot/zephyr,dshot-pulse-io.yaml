## dts/bindings/dshot/zephyr,dshot-pulse-io.yaml
```yaml
# SPDX-FileCopyrightText: Copyright The Zephyr Project Contributors
# SPDX-License-Identifier: Apache-2.0

title: DShot ESC outputs driven by Pulse IO channels

description: |
  Electronic speed controllers (ESC) commanded with the DShot protocol,
  each connected to a Pulse IO transmit channel.

  Every entry of pulse-ios is one DShot channel: the first entry is
  channel 0, the second channel 1, and so on. The entries can point to
  different Pulse IO controllers. The driver reserves the Pulse IO
  channels at boot, so no other driver can use them.

  The example below drives four ESCs at DShot600 from the first four
  transmit channels of the ESP32-S3 RMT, whose pins are routed by the RMT
  pinctrl state.

compatible: "zephyr,dshot-pulse-io"

properties:
  pulse-ios:
    type: phandle-array
    required: true
    description: |
      Pulse IO controller and transmit channel of each DShot channel.

  dshot-speed:
    type: int
    default: 600
    enum: [150, 300, 600, 1200]
    description: |
      Bit rate in kbit/s used at boot: DShot150, DShot300, DShot600 or
      DShot1200. Applications can change it with dshot_configure().
      DShot600 is the rate most ESCs support.

examples:
  - |
    / {
          esc: dshot {
              compatible = "zephyr,dshot-pulse-io";
              pulse-ios = <&rmt 0>, <&rmt 1>, <&rmt 2>, <&rmt 3>;
              dshot-speed = <600>;
          };
    };
```

## dts/bindings/gpio/m5stack,m5ioe1-gpio.yaml
```yaml
# SPDX-FileCopyrightText: Copyright The Zephyr Project Contributors
# SPDX-License-Identifier: Apache-2.0

title: M5Stack M5IOE1 GPIO controller

description: |
  The controller has 14 pins, so set ngpios = <14>. GPIO pin n maps to the IOn+1 pin of the
  M5IOE1 (pin 0 is IO1, pin 13 is IO14). Outputs support push-pull and open-drain modes and every
  pin has configurable pull-up and pull-down resistors. Interrupts are not supported.

compatible: "m5stack,m5ioe1-gpio"

include: gpio-controller.yaml

on-bus: m5ioe1

properties:
  "#gpio-cells":
    const: 2

gpio-cells:
  - pin
  - flags
```

## dts/bindings/i2s/st,stm32-i2s.yaml
```yaml
# Copyright (c) 2018, STMicroelectronics
# SPDX-License-Identifier: Apache-2.0

description: STM32 I2S controller

compatible: "st,stm32-i2s"

include: st,stm32-i2s-common.yaml

properties:
  i2s-ext-rx:
    type: boolean
    description: |
      Receive through the I2Sx_ext extension block instead of the data line of
      the main block, which is what boards routing the receive data line to an
      I2Sx_ext_SD pin need. The extension block never drives the clocks, so
      the main block generates them for both directions.

      The node must then carry an "i2s_ext" reg range for the extension block
      and an "ext-rx" entry in dmas, and its pinctrl-0 must list the
      I2Sx_ext_SD pin the receive data line is routed to.
```

## dts/bindings/i2s/virtio,sound.yaml
```yaml
# Copyright (c) 2026 Benjamin Cabé <benjamin@zephyrproject.org>
# SPDX-License-Identifier: Apache-2.0

description: |
  VIRTIO Sound device (virtio device ID 25) exposed through the I2S API.

  The node must be a child of a VIRTIO transport node, either "virtio,pci" or
  "virtio,mmio". One VIRTIO PCM output stream backs I2S_DIR_TX and one input
  stream backs I2S_DIR_RX.

  Example, over MMIO:

      &virtio_mmio4 {
              status = "okay";

              virtio_sound: virtio-sound {
                      compatible = "virtio,sound";
                      status = "okay";
              };
      };

compatible: "virtio,sound"

include: base.yaml

properties:
  stream-direction:
    type: string
    default: "both"
    enum:
      - "rx"
      - "tx"
      - "both"
    description: |
      Directions this node exposes through the I2S API. Defaults to "both". A
      direction with no matching VIRTIO PCM stream is disabled at runtime.

  tx-stream-id:
    type: int
    description: |
      VIRTIO PCM stream ID backing I2S_DIR_TX. When omitted, the first stream
      the device reports as an output stream is used. Initialization fails if
      the given ID does not exist or is not an output stream.

  rx-stream-id:
    type: int
    description: |
      VIRTIO PCM stream ID backing I2S_DIR_RX. When omitted, the first stream
      the device reports as an input stream is used. Initialization fails if
      the given ID does not exist or is not an input stream.
```

## dts/bindings/input/adsemi,tsm12.yaml
```yaml
# SPDX-FileCopyrightText: Copyright The Zephyr Project Contributors
# SPDX-License-Identifier: Apache-2.0

description: |
  AD Semiconductor TSM12 12-channel capacitive touch sensor

  Also covers the register- and pin-compatible Si12T from Nanjing Zhongke
  Microelectronics.

  Each channel with an entry in input-codes reports an INPUT_EV_KEY event,
  pressed as soon as the sensor detects a touch of any strength.

  Example:

    touch@68 {
      compatible = "adsemi,tsm12";
      reg = <0x68>;
      int-gpios = <&gpio0 4 (GPIO_ACTIVE_LOW | GPIO_PULL_UP)>;
      input-codes = <INPUT_BTN_LEFT INPUT_BTN_MIDDLE INPUT_BTN_RIGHT>;
      threshold-windows = "narrow", "narrow", "narrow";
      threshold-midpoints = [03 03 03];
    };

compatible: "adsemi,tsm12"

include: i2c-device.yaml

properties:
  int-gpios:
    type: phandle-array
    description: |
      Interrupt line (open drain, active low), asserted when a channel
      detects a touch. The sensor is polled when this property is absent.

  input-codes:
    type: array
    required: true
    description: |
      Input event key codes (INPUT_KEY_* or INPUT_BTN_*), one per channel
      starting from channel 1. Up to 12 entries; channels without an entry
      are disabled.

  threshold-midpoints:
    type: uint8-array
    required: true
    description: |
      Middle touch threshold of each channel (ChxM[2:0], 0-7), one entry per
      input-codes entry. Higher values raise the threshold and make the
      channel less sensitive. The chip reset value is 3.

  threshold-windows:
    type: string-array
    required: true
    enum:
      - "narrow"
      - "wide"
    description: |
      Spacing of the light and hard touch thresholds around the middle
      threshold (ChxHL), one entry per input-codes entry. A touch is
      reported from the light touch threshold on.

      - "narrow": 20% below and above the middle threshold.
      - "wide": 30% below and above the middle threshold, which reports
        lighter touches. This is the chip reset value.

      Example thresholds (capacitance change) with "narrow":

        Midpoint | Light touch | Middle | Hard touch
        ---------|-------------|--------|-----------
            0    |    0.40%    | 0.50%  |   0.60%
            3    |    0.95%    | 1.20%  |   1.45%
            7    |    2.85%    | 3.55%  |   4.30%
```

## dts/bindings/input/futaba,sbus.yaml
```yaml
# Copyright (c) 2024 NXP Semiconductors
# SPDX-License-Identifier: Apache-2.0

title: Futaba SBUS

description: |
  SBUS is a single-wire inverted serial protocol that can be used to receive
  analog joystick and switch inputs from RC transmitters. Since the signal is
  inverted, you need to use an external signal inverter or set the rx-invert
  flag on the serial controller node (if it supports pin inversion).

  The binding allows mapping of up to 16 SBUS channels to Zephyr input events.
  Each channel can be configured to generate either absolute position events
  (for joysticks) or key events (for switches).

  The receiver state can be reported as key events as well, by setting the
  failsafe-code, frame-lost-code and receiver-lost-code properties. A key
  event is reported when the state changes: value 1 when the condition starts
  and value 0 when it ends. The failsafe and frame lost events of a frame are
  reported before its channel values.


compatible: "futaba,sbus"

include: [base.yaml, uart-device.yaml]

properties:
  failsafe-code:
    type: int
    description: |
      Key code reported for the failsafe flag of the SBUS frames. Receivers
      set this flag when they have lost the transmitter. They keep sending
      frames, and the channel values of these frames are the failsafe values
      configured in the receiver, or the last values received, not the
      position of the transmitter sticks.

  frame-lost-code:
    type: int
    description: |
      Key code reported for the frame lost flag of the SBUS frames. Receivers
      set this flag when they missed a frame from the transmitter. The
      channel values of the frame are the last values received. Unlike the
      failsafe flag, this flag does not mean that the transmitter was lost.

  receiver-lost-code:
    type: int
    description: |
      Key code reported when the receiver stops sending frames: value 1 when
      no frame was received for 20 ms, value 0 when a valid frame is received
      again.

child-binding:
  description: |
    SBUS Channel to input-event-code binding
    INPUT_EV_ABS & INPUT_EV_MSC gives raw input value
    INPUT_EV_KEY emulates a key
  properties:
    channel:
      type: int
      required: true
      description: |
        SBUS input channel
      min: 1
      max: 16
    type:
      type: int
      required: true
      description: Input event types see INPUT_EV_CODES
    zephyr,code:
      type: int
      required: true
      description: Code to emit.

examples:
  - |
    /*
     * Example configuration for 2 joysticks and a button using 5 channels,
     * reporting the receiver state as key events.
     */
    &lpuart6 {
      status = "okay";

      sbus {
          compatible = "futaba,sbus";
          failsafe-code = <INPUT_KEY_F1>;
          frame-lost-code = <INPUT_KEY_F2>;
          receiver-lost-code = <INPUT_KEY_F3>;

          right_stick_x {
              channel = <1>;
              type = <INPUT_EV_ABS>;
              zephyr,code = <INPUT_ABS_RX>;
          };

          right_stick_y {
              channel = <2>;
              type = <INPUT_EV_ABS>;
              zephyr,code = <INPUT_ABS_RY>;
          };

          left_stick_x {
              channel = <3>;
              type = <INPUT_EV_ABS>;
              zephyr,code = <INPUT_ABS_X>;
          };

          left_stick_y {
              channel = <4>;
              type = <INPUT_EV_ABS>;
              zephyr,code = <INPUT_ABS_Y>;
          };

          kill_switch {
              channel = <5>;
              type = <INPUT_EV_KEY>;
              zephyr,code = <INPUT_KEY_0>;
          };
      };
    };
```

## dts/bindings/input/zephyr,input-sensor-encoder.yaml
```yaml
# Copyright 2026 Benjamin Cabé
# SPDX-License-Identifier: Apache-2.0

description: |
  Sensor based encoder input device

  Implement an input device generating relative axis event reports from any
  sensor device exposing a rotation or a quadrature encoder count channel,
  such as a hardware quadrature decoder peripheral or a magnetic angle
  sensor.

  The driver periodically samples the configured channel of the backing
  sensor device, computes the difference from the previous sample and
  reports it as a relative input event.

compatible: "zephyr,input-sensor-encoder"

include: base.yaml

properties:
  sensor:
    type: phandle
    required: true
    description: |
      Sensor device to read the encoder position from. Must support the
      channel specified in the channel property.

  channel:
    type: string
    default: "rotation"
    enum:
      - "rotation"
      - "encoder-count"
    description: |
      Sensor channel to sample:

      - "rotation" reads SENSOR_CHAN_ROTATION, an absolute angle. The raw
        value is scaled to millidegrees.
      - "encoder-count" reads SENSOR_CHAN_ENCODER_COUNT, the raw decoder
        counter value. The raw value is used as-is, in counts.

      Defaults to "rotation", which is the channel supported by the widest
      range of sensor drivers.

  zephyr,axis:
    type: int
    required: true
    description: |
      The input code for the axis to report for the device, typically any of
      INPUT_REL_*.

  poll-period-ms:
    type: int
    default: 20
    description: |
      How often to sample the sensor channel, in milliseconds. Defaults to
      20ms if unspecified.

  steps-per-period:
    type: int
    default: 1
    description: |
      How many raw units to accumulate before reporting an input event, and
      the value each reported event unit corresponds to.

      The unit depends on the channel property: counts for "encoder-count",
      millidegrees for "rotation". For example an encoder with 16 detents
      per revolution read through the "rotation" channel would use 22500
      (22.5 degrees per detent), and the same encoder read through the
      "encoder-count" channel with a single count per detent would use 1.

      Any remainder is carried over to the next sample, so no movement is
      lost. Defaults to 1 if unspecified.

  rollover:
    type: int
    description: |
      Modulus of the raw value, in the same unit as steps-per-period, used to
      detect and correct counter wrap around.

      If non zero, a difference between two samples larger than half the
      modulus is interpreted as a wrap around, so that for instance a
      rotation going from 359 to 1 degrees is reported as a positive two
      degrees movement rather than a negative 358 degrees one.

      Defaults to 360000 (360 degrees expressed in millidegrees) for the
      "rotation" channel and to 0, no wrap around detection, for the
      "encoder-count" channel. Set it explicitly for a counter that wraps at
      a known value, for example 65536 for a 16 bit counter.

  invert-direction:
    type: boolean
    description: |
      Invert the reported direction.

examples:
  - |
    #include <zephyr/dt-bindings/input/input-event-codes.h>

    encoder {
            compatible = "zephyr,input-sensor-encoder";
            sensor = <&qdec0>;
            channel = "rotation";
            steps-per-period = <22500>;
            zephyr,axis = <INPUT_REL_WHEEL>;
            poll-period-ms = <20>;
    };
```

## dts/bindings/mfd/m5stack,m5ioe1.yaml
```yaml
# SPDX-FileCopyrightText: Copyright The Zephyr Project Contributors
# SPDX-License-Identifier: Apache-2.0

title: M5Stack M5IOE1 I/O expander

description: |
  The M5IOE1 is a PY32 microcontroller running M5Stack firmware that provides 14 GPIOs, four of
  which can be used as ADC inputs and four as PWM outputs, and a WS2812-style LED driver on IO14.
  Its I2C address is selected between 0x6f and 0x76 by the level of IO7 at power-on.

compatible: "m5stack,m5ioe1"

include: i2c-device.yaml

bus: m5ioe1

properties:
  reg:
    required: true

examples:
  - |
    &i2c0 {
      m5ioe1: io-expander@6f {
        compatible = "m5stack,m5ioe1";
        reg = <0x6f>;

        m5ioe1_gpio: gpio {
          compatible = "m5stack,m5ioe1-gpio";
          gpio-controller;
          #gpio-cells = <2>;
          ngpios = <14>;
        };
      };
    };
```

## dts/bindings/misc/feetech,scs-bus.yaml
```yaml
# SPDX-FileCopyrightText: Copyright The Zephyr Project Contributors
# SPDX-License-Identifier: Apache-2.0

description: |
  Feetech SCS serial servo bus

  Half-duplex UART bus shared by Feetech SCS series serial bus servos. The node is a child of the
  UART the bus is wired to, and each servo on the bus is a child node whose unit address is its
  servo ID.

  Example:

    &uart1 {
      current-speed = <1000000>;

      servo-bus {
        compatible = "feetech,scs-bus";
        #address-cells = <1>;
        #size-cells = <0>;

        servo@1 {
          compatible = "feetech,scs0009";
          reg = <1>;
        };
      };
    };

compatible: "feetech,scs-bus"

include: uart-device.yaml

bus: feetech-scs

properties:
  "#address-cells":
    required: true
    const: 1

  "#size-cells":
    required: true
    const: 0
```
