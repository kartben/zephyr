## boards/nxp/lpc8n04_devboard/Kconfig.lpc8n04_devboard
```kconfig
# SPDX-FileCopyrightText: Copyright The Zephyr Project Contributors
# SPDX-License-Identifier: Apache-2.0

config BOARD_LPC8N04_DEVBOARD
	select SOC_LPC8N04
```

## boards/nxp/lpc8n04_devboard/board.yml
```yaml
# SPDX-FileCopyrightText: Copyright The Zephyr Project Contributors
# SPDX-License-Identifier: Apache-2.0

board:
  name: lpc8n04_devboard
  full_name: LPC8N04 Development Board
  vendor: nxp
  socs:
    - name: lpc8n04
```

## drivers/clock_control/Kconfig.lpc8n04
```kconfig
# SPDX-FileCopyrightText: Copyright The Zephyr Project Contributors
# SPDX-License-Identifier: Apache-2.0

config CLOCK_CONTROL_LPC8N04
	bool "NXP LPC8N04 SYSCON clock controller driver"
	default y
	depends on DT_HAS_NXP_LPC8N04_SYSCON_ENABLED
	help
	  Enable the clock control driver for the NXP LPC8N04 SYSCON block.
```

## drivers/gpio/Kconfig.lpc8n04
```kconfig
# SPDX-FileCopyrightText: Copyright The Zephyr Project Contributors
# SPDX-License-Identifier: Apache-2.0

config GPIO_LPC8N04
	bool "NXP LPC8N04 GPIO driver"
	default y
	depends on DT_HAS_NXP_LPC8N04_GPIO_ENABLED
	help
	  Enable the GPIO driver for the NXP LPC8N04 GPIO port.
```

## drivers/rfid/Kconfig.nt3h2x11
```kconfig
# SPDX-FileCopyrightText: Copyright The Zephyr Project Contributors
# SPDX-License-Identifier: Apache-2.0

config RFID_NT3H2X11
	bool "NXP NTAG I2C plus (NT3H2111/NT3H2211) driver"
	default y
	depends on DT_HAS_NXP_NT3H2111_ENABLED
	select I2C
	select GPIO if $(dt_compat_any_has_prop,$(DT_COMPAT_NXP_NT3H2111),fd-gpios)
	help
	  Enable the driver for the NXP NTAG I2C plus connected NFC tag. The
	  tag acts as an ISO/IEC 14443-3 Type A target and exchanges data with
	  the reader through its SRAM in pass-through mode.

config EMUL_NT3H2X11
	bool "NXP NTAG I2C plus emulator"
	default y
	depends on RFID_NT3H2X11
	depends on EMUL
	help
	  Enable the I2C emulator for the NXP NTAG I2C plus, which models the
	  session registers and the SRAM pass-through handshake.
```

## dts/bindings/clock/nxp,lpc8n04-syscon.yaml
```yaml
# SPDX-FileCopyrightText: Copyright The Zephyr Project Contributors
# SPDX-License-Identifier: Apache-2.0

description: |
  NXP LPC8N04 system configuration block (SYSCON) clock controller.

  The clock specifier cell is the peripheral's bit in SYSAHBCLKCTRL, see
  include/zephyr/dt-bindings/clock/lpc8n04-clock.h. All peripheral clocks run
  at the system clock rate set by the cpu node's clock-frequency.

compatible: "nxp,lpc8n04-syscon"

include: [clock-controller.yaml, base.yaml]

properties:
  reg:
    required: true

  "#clock-cells":
    const: 1

clock-cells:
  - name
```

## dts/bindings/gpio/nxp,lpc8n04-gpio.yaml
```yaml
# SPDX-FileCopyrightText: Copyright The Zephyr Project Contributors
# SPDX-License-Identifier: Apache-2.0

description: |
  NXP GPIO port of the LPC11xx type, as found on the LPC8N04.

  The data register is accessed through a pin mask in the address
  (GPIODATA), and the direction and interrupt registers (DIR, IS, IBE, IEV,
  IMSC, RIS, MIS, IC) follow at offset 0x8000. All pin interrupts share one
  interrupt line.

  Configuring a pin selects its GPIO function in IOCON, which must have one
  register per pin in pin order, and sets its pull resistors there. Pins
  listed in nxp,i2c-pads are open-drain I2C pads: their GPIO mode is set
  through the I2CMODE field, they have no pull resistors, and as outputs they
  need GPIO_OPEN_DRAIN.

compatible: "nxp,lpc8n04-gpio"

include: [gpio-controller.yaml, base.yaml]

properties:
  reg:
    required: true

  interrupts:
    required: true

  clocks:
    required: true

  nxp,iocon:
    type: phandle
    required: true
    description: IOCON node holding the configuration registers of the port pins.

  nxp,i2c-pads:
    type: array
    description: Pin numbers of the open-drain I2C pads of the port.

  "#gpio-cells":
    const: 2

gpio-cells:
  - pin
  - flags
```

## dts/bindings/pinctrl/nxp,lpc8n04-pinctrl.yaml
```yaml
# SPDX-FileCopyrightText: Copyright The Zephyr Project Contributors
# SPDX-License-Identifier: Apache-2.0

description: |
  NXP LPC8N04 pin controller (IOCON).

  Each IOCON register selects the pin function and its electrical
  configuration. Pin functions are listed in
  include/zephyr/dt-bindings/pinctrl/lpc8n04-pinctrl.h. Example:

  &pinctrl {
    i2c0_default: i2c0_default {
      group0 {
        pinmux = <PIO0_4_I2C_SCL>, <PIO0_5_I2C_SDA>;
      };
    };
  };

  bias-pull-up, bias-pull-down and bias-bus-hold (repeater mode) set the MODE
  field and nxp,low-pass-filter sets LPF. PIO0_4 and PIO0_5 are open-drain
  I2C pads without MODE or LPF fields; these properties are ignored on them.

compatible: "nxp,lpc8n04-pinctrl"

include: base.yaml

child-binding:
  description: LPC8N04 pin controller pin group
  child-binding:
    description: LPC8N04 pin controller pin configuration node

    include:
      - name: pincfg-node.yaml
        property-allowlist:
          - bias-pull-up
          - bias-pull-down
          - bias-bus-hold

    properties:
      pinmux:
        required: true
        type: array
        description: |
          Pin function selection for this group, from lpc8n04-pinctrl.h.

      nxp,low-pass-filter:
        type: boolean
        description: Enable the input low-pass filter (LPF bit).
```

## dts/bindings/rfid/nxp,nt3h2111.yaml
```yaml
# SPDX-FileCopyrightText: Copyright The Zephyr Project Contributors
# SPDX-License-Identifier: Apache-2.0

description: |
  NXP NTAG I2C plus connected NFC tag (NT3H2111, 1k EEPROM)

  NFC Forum Type 2 Tag with an I2C target interface. The NFC side is an
  ISO/IEC 14443-3 Type A target; the host exchanges data with the reader
  through the 64-byte SRAM in pass-through mode.

  The 2k variant (NT3H2211) uses the same driver:

    compatible = "nxp,nt3h2211", "nxp,nt3h2111";

compatible: "nxp,nt3h2111"

include: i2c-device.yaml

properties:
  fd-gpios:
    type: phandle-array
    description: |
      Field detection (FD) output. The pin is open-drain and pulled low by the
      tag on an NFC event, so it is usually GPIO_ACTIVE_LOW with a pull-up.
      Without it, the driver polls the session registers.

examples:
  - |
    i2c {
      #address-cells = <1>;
      #size-cells = <0>;

      nfc@55 {
        compatible = "nxp,nt3h2111";
        reg = <0x55>;
        fd-gpios = <&gpio0 4 (GPIO_ACTIVE_LOW | GPIO_PULL_UP)>;
      };
    };
```

## soc/nxp/lpc/lpc8n04/Kconfig
```kconfig
# SPDX-FileCopyrightText: Copyright The Zephyr Project Contributors
# SPDX-License-Identifier: Apache-2.0

config SOC_SERIES_LPC8N04
	select CPU_CORTEX_M0PLUS
	select CPU_CORTEX_M_HAS_SYSTICK
	select CPU_CORTEX_M_HAS_VTOR
	select HAS_MCUX
	select SOC_EARLY_INIT_HOOK
```

## soc/nxp/lpc/lpc8n04/Kconfig.defconfig
```kconfig
# SPDX-FileCopyrightText: Copyright The Zephyr Project Contributors
# SPDX-License-Identifier: Apache-2.0

if SOC_SERIES_LPC8N04

config NUM_IRQS
	default 32

config SYS_CLOCK_HW_CYCLES_PER_SEC
	default $(dt_node_int_prop_int,/cpus/cpu@0,clock-frequency)

endif # SOC_SERIES_LPC8N04
```

## soc/nxp/lpc/lpc8n04/Kconfig.soc
```kconfig
# SPDX-FileCopyrightText: Copyright The Zephyr Project Contributors
# SPDX-License-Identifier: Apache-2.0

config SOC_SERIES_LPC8N04
	bool
	select SOC_FAMILY_LPC
	help
	  Enable support for the NXP LPC8N04 series: Cortex-M0+ MCUs with an
	  integrated NFC Forum Type 2 tag interface.

config SOC_SERIES
	default "lpc8n04" if SOC_SERIES_LPC8N04

config SOC_LPC8N04
	bool
	select SOC_SERIES_LPC8N04
	select SOC_PART_NUMBER_LPC8N04FHI24

config SOC_PART_NUMBER_LPC8N04FHI24
	bool

config SOC_PART_NUMBER
	default "LPC8N04FHI24" if SOC_PART_NUMBER_LPC8N04FHI24

config SOC
	default "lpc8n04" if SOC_LPC8N04
```
