## boards/micoair/micoair743_lite/Kconfig.defconfig
```kconfig
# SPDX-FileCopyrightText: Copyright The Zephyr Project Contributors
# SPDX-License-Identifier: Apache-2.0

if BOARD_MICOAIR743_LITE

source "boards/common/usb/Kconfig.cdc_acm_serial.defconfig"

endif # BOARD_MICOAIR743_LITE
```

## boards/micoair/micoair743_lite/Kconfig.micoair743_lite
```kconfig
# SPDX-FileCopyrightText: Copyright The Zephyr Project Contributors
# SPDX-License-Identifier: Apache-2.0

config BOARD_MICOAIR743_LITE
	select SOC_STM32H743XX
```

## boards/micoair/micoair743_lite/board.yml
```yaml
# SPDX-FileCopyrightText: Copyright The Zephyr Project Contributors
# SPDX-License-Identifier: Apache-2.0

board:
  name: micoair743_lite
  full_name: MicoAir743-Lite
  vendor: micoair
  socs:
    - name: stm32h743xx
```

## boards/seeed/reterminal_sticky/Kconfig
```kconfig
# SPDX-FileCopyrightText: Copyright The Zephyr Project Contributors
# SPDX-License-Identifier: Apache-2.0

config HEAP_MEM_POOL_ADD_SIZE_BOARD
	int
	default 4096 if BOARD_RETERMINAL_STICKY_ESP32S3_PROCPU
	default 256 if BOARD_RETERMINAL_STICKY_ESP32S3_APPCPU

config RETERMINAL_STICKY_POWER_OFF_KEY
	bool "Power off on long press of the power button"
	default y
	depends on BOARD_RETERMINAL_STICKY_ESP32S3_PROCPU
	depends on INPUT_LONGPRESS
	help
	  Clear the power latch when the power_longpress devicetree node
	  reports a long press of the power button. When running from the
	  battery, the system then switches off once the button is released.
	  USB power keeps the system on regardless of the latch.
```

## boards/seeed/reterminal_sticky/Kconfig.defconfig
```kconfig
# SPDX-FileCopyrightText: Copyright The Zephyr Project Contributors
# SPDX-License-Identifier: Apache-2.0

if BOARD_RETERMINAL_STICKY_ESP32S3_PROCPU

if LVGL

choice LV_COLOR_DEPTH
	default LV_COLOR_DEPTH_1
endchoice

endif # LVGL

endif # BOARD_RETERMINAL_STICKY_ESP32S3_PROCPU
```

## boards/seeed/reterminal_sticky/Kconfig.reterminal_sticky
```kconfig
# SPDX-FileCopyrightText: Copyright The Zephyr Project Contributors
# SPDX-License-Identifier: Apache-2.0

config BOARD_RETERMINAL_STICKY
	select SOC_ESP32S3
	select SOC_ESP32S3_PROCPU if BOARD_RETERMINAL_STICKY_ESP32S3_PROCPU
	select SOC_ESP32S3_APPCPU if BOARD_RETERMINAL_STICKY_ESP32S3_APPCPU
```

## boards/seeed/reterminal_sticky/board.yml
```yaml
board:
  name: reterminal_sticky
  full_name: reTerminal Sticky
  vendor: seeed
  socs:
  - name: esp32s3
```

## drivers/dshot/Kconfig
```kconfig
# SPDX-FileCopyrightText: Copyright The Zephyr Project Contributors
# SPDX-License-Identifier: Apache-2.0

menuconfig DSHOT
	bool "DShot electronic speed controller drivers"
	help
	  Enable drivers that control brushless motor electronic speed
	  controllers (ESC) with the DShot protocol.

if DSHOT

config DSHOT_INIT_PRIORITY
	int "DShot init priority"
	default 90
	help
	  System initialization priority for DShot drivers. DShot devices
	  initialize after the devices that generate their signals, such as
	  Pulse IO controllers.

module = DSHOT
module-str = dshot
source "subsys/logging/Kconfig.template.log_config"

# zephyr-keep-sorted-start
source "drivers/dshot/Kconfig.pulse_io"
# zephyr-keep-sorted-stop

endif # DSHOT
```

## drivers/dshot/Kconfig.pulse_io
```kconfig
# SPDX-FileCopyrightText: Copyright The Zephyr Project Contributors
# SPDX-License-Identifier: Apache-2.0

config DSHOT_PULSE_IO
	bool "DShot over Pulse IO"
	default y
	depends on DT_HAS_ZEPHYR_DSHOT_PULSE_IO_ENABLED
	select PULSE_IO
	help
	  Enable the DShot driver that generates frames with Pulse IO
	  transmit channels, in CELL mode when the controller supports duty
	  cycles and in SYMBOL mode otherwise.
```

## drivers/gpio/Kconfig.m5ioe1
```kconfig
# SPDX-FileCopyrightText: Copyright The Zephyr Project Contributors
# SPDX-License-Identifier: Apache-2.0

config GPIO_M5IOE1
	bool "M5Stack M5IOE1 GPIO driver"
	default y
	depends on DT_HAS_M5STACK_M5IOE1_GPIO_ENABLED
	select MFD
	help
	  Enable the GPIO controller driver for the M5Stack M5IOE1 I/O
	  expander.
```

## drivers/i2s/Kconfig.virtio_sound
```kconfig
# Copyright (c) 2026 Benjamin Cabé <benjamin@zephyrproject.org>
# SPDX-License-Identifier: Apache-2.0

menuconfig I2S_VIRTIO_SOUND
	bool "VIRTIO sound device driver"
	default y
	depends on DT_HAS_VIRTIO_SOUND_ENABLED
	select VIRTIO
	help
	  Expose a VIRTIO sound device (virtio device ID 25) through the I2S
	  API. One PCM output stream backs I2S_DIR_TX and one PCM input stream
	  backs I2S_DIR_RX.

	  Note that the memory slab passed to i2s_configure() must be
	  statically defined: buffer addresses are translated with
	  k_mem_phys_addr(), which requires the kernel's permanent RAM mapping.

if I2S_VIRTIO_SOUND

config I2S_VIRTIO_SOUND_TX_BLOCKS
	int "Maximum number of TX blocks in flight"
	default 16
	range 2 64
	help
	  Upper bound on the number of blocks that can be queued for
	  transmission at the same time. The effective value is clamped to
	  what the device's transmit virtqueue can hold.

	  This sets how much audio the device buffers, since the driver asks
	  for a buffer of this many periods. Applications using small blocks
	  need a high value to survive scheduling delays.

config I2S_VIRTIO_SOUND_RX_BLOCKS
	int "Number of RX blocks kept posted to the device"
	default 16
	range 2 64
	help
	  Number of blocks handed to the device for capture. The effective
	  value is clamped to what the device's receive virtqueue can hold,
	  and to half of the memory slab so that an application sharing one
	  slab between capture and playback still has blocks to work with.

config I2S_VIRTIO_SOUND_RX_QUEUE_SIZE
	int "Depth of the RX block queue handed to the application"
	default 4
	range 1 32
	help
	  Number of received blocks that can wait for i2s_read() before an
	  overrun is reported. The RX memory slab should hold at least
	  I2S_VIRTIO_SOUND_RX_BLOCKS plus this many blocks.

config I2S_VIRTIO_SOUND_MAX_STREAMS
	int "Maximum number of PCM streams queried at initialization"
	default 8
	range 1 32
	help
	  Streams beyond this index are not considered when looking for the
	  streams backing I2S_DIR_TX and I2S_DIR_RX.

config I2S_VIRTIO_SOUND_EVENTQ
	bool "Handle the VIRTIO sound event virtqueue"
	default y
	help
	  Post buffers to the event virtqueue so that the device can report
	  buffer underruns and overruns. Note that QEMU does not implement
	  this queue, so transmit underruns go unreported there. Receive
	  overruns are always detected, since they are observed locally when
	  the application stops reading.

config I2S_VIRTIO_SOUND_EVENT_BUFFERS
	int "Number of event buffers"
	default 4
	range 1 16
	depends on I2S_VIRTIO_SOUND_EVENTQ
	help
	  Number of buffers kept posted to the event virtqueue.

config I2S_VIRTIO_SOUND_CTL_TIMEOUT_MS
	int "Control queue transaction timeout (ms)"
	default 1000
	help
	  How long to wait for the device to answer a control request. A
	  request that times out leaves the device unusable, since the virtio
	  core provides no way to reclaim the descriptors.

config I2S_VIRTIO_SOUND_WORKQ_STACK_SIZE
	int "Deferred control workqueue stack size"
	default 1024
	help
	  Stack size of the thread issuing the control requests that the
	  virtqueue callbacks cannot issue themselves.

config I2S_VIRTIO_SOUND_WORKQ_PRIORITY
	int "Deferred control workqueue thread priority"
	default 5
	help
	  Priority of the deferred control workqueue thread.

endif # I2S_VIRTIO_SOUND
```

## drivers/input/Kconfig.sensor_encoder
```kconfig
# Copyright 2026 Benjamin Cabé
# SPDX-License-Identifier: Apache-2.0

config INPUT_SENSOR_ENCODER
	bool "Sensor based encoder input driver"
	default y
	depends on DT_HAS_ZEPHYR_INPUT_SENSOR_ENCODER_ENABLED
	depends on MULTITHREADING
	select SENSOR
	help
	  Input driver generating relative axis events from a sensor device
	  exposing a rotation or a quadrature encoder count channel, such as a
	  hardware quadrature decoder peripheral or a magnetic angle sensor.

if INPUT_SENSOR_ENCODER

config INPUT_SENSOR_ENCODER_THREAD_STACK_SIZE
	int "Stack size for the sensor encoder thread"
	default 1024
	help
	  Size of the stack used for the sensor encoder polling thread. The
	  default leaves room for sensor drivers sampling over a bus such as
	  I2C or SPI.

config INPUT_SENSOR_ENCODER_THREAD_PRIORITY
	int "Priority for the sensor encoder thread"
	default 0
	help
	  Priority level of the sensor encoder polling thread.

endif # INPUT_SENSOR_ENCODER
```

## drivers/mfd/Kconfig.m5ioe1
```kconfig
# SPDX-FileCopyrightText: Copyright The Zephyr Project Contributors
# SPDX-License-Identifier: Apache-2.0

config MFD_M5IOE1
	bool "M5Stack M5IOE1 I/O expander"
	default y
	depends on DT_HAS_M5STACK_M5IOE1_ENABLED
	select I2C
	help
	  Enable the M5Stack M5IOE1 multi-function I/O expander driver.

config MFD_M5IOE1_BOOT_TIMEOUT_MS
	int "Time to wait for the M5IOE1 to answer at initialization"
	depends on MFD_M5IOE1
	default 1000
	help
	  The M5IOE1 firmware can take several hundred milliseconds to start
	  answering on I2C after power-on. The driver polls the device for
	  up to this many milliseconds before failing to initialize.
```

## drivers/misc/feetech_scs/Kconfig
```kconfig
# SPDX-FileCopyrightText: Copyright The Zephyr Project Contributors
# SPDX-License-Identifier: Apache-2.0

config FEETECH_SCS
	bool "Feetech SCS serial bus servo driver"
	default y
	depends on DT_HAS_FEETECH_SCS_BUS_ENABLED
	depends on SERIAL_SUPPORT_INTERRUPT
	select UART_INTERRUPT_DRIVEN
	help
	  Enable the driver for Feetech SCS series serial bus servos.

if FEETECH_SCS

config FEETECH_SCS_INIT_PRIORITY
	int "Feetech SCS driver initialization priority"
	default KERNEL_INIT_PRIORITY_DEVICE
	help
	  Initialization priority of the servo bus and servo devices. It
	  must be greater than or equal to the UART driver priority.

config FEETECH_SCS_RESPONSE_TIMEOUT_MS
	int "Servo response timeout in milliseconds"
	default 10
	help
	  Time to wait for a servo to answer a command before failing
	  with -ETIMEDOUT.

module = FEETECH_SCS
module-str = feetech_scs
source "subsys/logging/Kconfig.template.log_config"

endif # FEETECH_SCS
```

## drivers/pulse_io/Kconfig.nxp_flexio
```kconfig
# SPDX-FileCopyrightText: Copyright The Zephyr Project Contributors
# SPDX-License-Identifier: Apache-2.0

config PULSE_IO_NXP_FLEXIO
	bool "NXP FlexIO Pulse IO backend"
	default y
	depends on DT_HAS_NXP_FLEXIO_PULSE_IO_ENABLED
	depends on CLOCK_CONTROL
	select MCUX_FLEXIO
	select PINCTRL
	help
	  Enable the Pulse IO backend that generates and captures pulse
	  streams with NXP FlexIO shifters and timers.

config PULSE_IO_NXP_FLEXIO_MAX_TICK_RATE
	int "Highest FlexIO Pulse IO tick rate"
	depends on PULSE_IO_NXP_FLEXIO
	default 16000000
	range 1000 100000000
	help
	  Highest tick rate, in Hz, a channel accepts. A channel that
	  transmits or captures interrupts the CPU once every 32 ticks to
	  refill or drain its shifter, every 2 us at 16 MHz. Lower it when
	  the CPU cannot service the interrupt that fast: a late interrupt
	  makes the transfer fail with -EIO.
```

## drivers/pulse_io/Kconfig.stm32
```kconfig
# SPDX-FileCopyrightText: Copyright The Zephyr Project Contributors
# SPDX-License-Identifier: Apache-2.0

config PULSE_IO_STM32_TIMER
	bool "STM32 timer Pulse IO driver"
	default y
	depends on DT_HAS_ST_STM32_PULSE_IO_ENABLED
	select USE_STM32_LL_TIM
	select DMA
	select CACHE_MANAGEMENT if DCACHE
	help
	  Enable the Pulse IO driver for STM32 timers. It transmits fixed-period
	  cells on timer channels in PWM mode, a DMA burst loading the duty
	  cycles of each period, and with RTIO receives the reply that follows
	  a transmit on a channel with a capture DMA.
```

## drivers/sensor/emul/Kconfig
```kconfig
# SPDX-FileCopyrightText: Copyright The Zephyr Project Contributors
# SPDX-License-Identifier: Apache-2.0

menuconfig SENSOR_EMUL_REGMAP
	bool "Register table sensor emulators"
	depends on EMUL && I2C
	help
	  Enable deterministic I2C register models for LPS22HB, MPU6050,
	  P3T1755, TCN75A and TMP11X sensors on emulated I2C buses.

if SENSOR_EMUL_REGMAP

config SENSOR_EMUL_TMP116
	bool "Emulate TMP116 instead of TMP117"
	depends on DT_HAS_TI_TMP11X_ENABLED
	help
	  Select TMP116 register behavior for ti,tmp11x nodes. The default
	  model is TMP117.

endif
```

## drivers/sensor/goertek/Kconfig
```kconfig
# SPDX-FileCopyrightText: Copyright The Zephyr Project Contributors
# SPDX-License-Identifier: Apache-2.0

# zephyr-keep-sorted-start
source "drivers/sensor/goertek/spa06/Kconfig"
# zephyr-keep-sorted-stop
```

## drivers/sensor/goertek/spa06/Kconfig
```kconfig
# SPDX-FileCopyrightText: Copyright The Zephyr Project Contributors
# SPDX-License-Identifier: Apache-2.0

config SPA06
	bool "Goertek SPA06-003 pressure and temperature sensor"
	default y
	depends on DT_HAS_GOERTEK_SPA06_ENABLED
	select I2C if $(dt_compat_on_bus,$(DT_COMPAT_GOERTEK_SPA06),i2c)
	select SPI if $(dt_compat_on_bus,$(DT_COMPAT_GOERTEK_SPA06),spi)
	help
	  Enable the driver for the Goertek SPA06-003 barometric pressure and
	  temperature sensor.

if SPA06

choice SPA06_TRIGGER_MODE
	prompt "Trigger mode"
	default SPA06_TRIGGER_GLOBAL_THREAD
	help
	  Context in which the sensor's interrupt is handled, for data-ready
	  triggers and streaming.

config SPA06_TRIGGER_NONE
	bool "No trigger"

config SPA06_TRIGGER_GLOBAL_THREAD
	bool "Use global thread"
	depends on GPIO
	depends on $(dt_compat_any_has_prop,$(DT_COMPAT_GOERTEK_SPA06),int-gpios)
	select SPA06_TRIGGER

config SPA06_TRIGGER_OWN_THREAD
	bool "Use own thread"
	depends on GPIO
	depends on $(dt_compat_any_has_prop,$(DT_COMPAT_GOERTEK_SPA06),int-gpios)
	select SPA06_TRIGGER

endchoice

config SPA06_TRIGGER
	bool

config SPA06_THREAD_PRIORITY
	int "Thread priority"
	depends on SPA06_TRIGGER_OWN_THREAD
	default 10
	help
	  Priority of the thread that handles the interrupt.

config SPA06_THREAD_STACK_SIZE
	int "Thread stack size"
	depends on SPA06_TRIGGER_OWN_THREAD
	default 1024
	help
	  Stack size of the thread that handles the interrupt.

config SPA06_STREAM
	bool "Streaming mode"
	default y
	depends on SENSOR_ASYNC_API
	depends on SPA06_TRIGGER
	help
	  Stream data-ready and FIFO-full events through the asynchronous
	  sensor API. The interrupt is handled in the context selected by the
	  trigger mode.

config EMUL_SPA06
	bool "Emulator for the SPA06-003"
	default y
	depends on EMUL
	help
	  Enable the emulator for the SPA06-003, used to test the driver
	  without hardware.

endif # SPA06
```

## drivers/spi/Kconfig.virtio
```kconfig
# Copyright (c) 2026 Benjamin Cabé <benjamin@zephyrproject.org>
# SPDX-License-Identifier: Apache-2.0

config SPI_VIRTIO
	bool "VIRTIO SPI controller driver"
	default y
	depends on DT_HAS_VIRTIO_SPI_ENABLED
	select VIRTIO
	help
	  Enable driver for the VIRTIO SPI controller device, giving access to
	  a SPI controller exposed by the host.
```

## drivers/video/Kconfig.edge264
```kconfig
# Copyright The Zephyr Project Contributors
# SPDX-License-Identifier: Apache-2.0

config VIDEO_EDGE264
	bool "edge264 H.264 decoder driver"
	default y
	depends on DT_HAS_ZEPHYR_VIDEO_EDGE264_ENABLED
	select EDGE264
	select VIDEO_DECODER_H264
	help
	  Software H.264 decoder using the edge264 library. Input is Annex-B
	  H.264 (VIDEO_PIX_FMT_H264). Output is planar YUV 4:2:0 or RGB565.

if VIDEO_EDGE264

config VIDEO_EDGE264_MAX_WIDTH
	int "Maximum decoded frame width"
	default 320
	help
	  Upper bound advertised by the driver. Streams wider than this are
	  rejected when setting the output format.

config VIDEO_EDGE264_MAX_HEIGHT
	int "Maximum decoded frame height"
	default 240
	help
	  Upper bound advertised by the driver. Streams taller than this are
	  rejected when setting the output format.

config VIDEO_EDGE264_STACK_SIZE
	int "edge264 decode workqueue stack size"
	default 32768
	help
	  Stack for the dedicated decode workqueue. The decoder places a large
	  Edge264Context on the worker stack.

endif # VIDEO_EDGE264
```
