## boards/m5stack/stackchan/Kconfig.sysbuild
```kconfig
# Copyright (c) 2025 Benjamin Cabé <benjamin@zephyrproject.org>
# SPDX-License-Identifier: Apache-2.0

config BOARD_STACKCHAN
	bool
	default y
	depends on BOARD_STACKCHAN_ESP32S3_PROCPU || BOARD_STACKCHAN_ESP32S3_APPCPU
```

## boards/m5stack/stackchan/board.yml
```yaml
board:
  name: stackchan
  full_name: StackChan
  vendor: m5stack
  socs:
  - name: esp32s3
```

## boards/m5stack/stackchan/stackchan_appcpu_defconfig
```kconfig
# Copyright (c) 2025 Benjamin Cabé <benjamin@zephyrproject.org>
# SPDX-License-Identifier: Apache-2.0

CONFIG_CONSOLE=n
CONFIG_GPIO=y
```

## boards/nuvoton/npcm400_evb/board.yml
```yaml
board:
  name: npcm400_evb
  full_name: NPCM400 EVB
  vendor: nuvoton
  socs:
  - name: npcm400
```

## boards/nuvoton/npcx4m8f_evb/board.yml
```yaml
board:
  name: npcx4m8f_evb
  full_name: NPCX4M8F EVB
  vendor: nuvoton
  socs:
  - name: npcx4m8f
```

## boards/nuvoton/npcx7m6fb_evb/board.yml
```yaml
board:
  name: npcx7m6fb_evb
  full_name: NPCX7M6FB EVB
  vendor: nuvoton
  socs:
  - name: npcx7m6fb
```

## boards/nuvoton/npcx9m6f_evb/board.yml
```yaml
board:
  name: npcx9m6f_evb
  full_name: NPCX9M6F EVB
  vendor: nuvoton
  socs:
  - name: npcx9m6f
```

## boards/nuvoton/numaker_gai_m55m1/board.yml
```yaml
board:
  name: numaker_gai_m55m1
  full_name: NuMaker NuGestureAI-M55M1
  vendor: nuvoton
  socs:
  - name: m55m1xxx
```

## boards/nuvoton/numaker_m2l31ki/board.yml
```yaml
board:
  name: numaker_m2l31ki
  full_name: NuMaker M2L31KI
  vendor: nuvoton
  socs:
  - name: m2l31xxx
```

## boards/nuvoton/numaker_m3334ki/board.yml
```yaml
board:
  name: numaker_m3334ki
  full_name: NuMaker M3334KI
  vendor: nuvoton
  socs:
  - name: m333xxx
```

## boards/nuvoton/numaker_m3351ki/board.yml
```yaml
board:
  name: numaker_m3351ki
  full_name: NuMaker M3351KI
  vendor: nuvoton
  socs:
  - name: m335xxx
```

## boards/nuvoton/numaker_m5531/board.yml
```yaml
board:
  name: numaker_m5531
  full_name: NuMaker M5531
  vendor: nuvoton
  socs:
  - name: m55m1xxx
```

## boards/nuvoton/numaker_pfm_m467/board.yml
```yaml
board:
  name: numaker_pfm_m467
  full_name: NuMaker PFM M467
  vendor: nuvoton
  socs:
  - name: m467
```

## boards/nuvoton/numaker_pfm_m487/board.yml
```yaml
board:
  name: numaker_pfm_m487
  full_name: NuMaker PFM M487
  vendor: nuvoton
  socs:
  - name: m487
```

## boards/nxp/imx8mq_evk/board.yml
```yaml
board:
  name: imx8mq_evk
  full_name: i.MX8MQ EVK
  vendor: nxp
  socs:
  - name: mimx8mq6
```

## boards/nxp/lpcxpresso51u68/board.yml
```yaml
board:
  name: lpcxpresso51u68
  full_name: LPCXpresso51U68
  vendor: nxp
  socs:
    - name: lpc51u68
```

## boards/nxp/lpcxpresso54114/board.yml
```yaml
board:
  name: lpcxpresso54114
  full_name: LPCXpresso54114
  vendor: nxp
  socs:
    - name: lpc54114
```

## boards/pine64/pinecil_v2/Kconfig.pinecil_v2
```kconfig
# SPDX-FileCopyrightText: Copyright The Zephyr Project Contributors
# SPDX-License-Identifier: Apache-2.0

config BOARD_PINECIL_V2
select SOC_BL706C00Q2I
```

## boards/pine64/pinecil_v2/board.yml
```yaml
board:
  name: pinecil_v2
  full_name: Pine64 Pinecil V2
  vendor: pine64
  socs:
    - name: bl706c00q2i
```

## boards/rak/rak3272lp_sip/Kconfig.rak3272lp_sip
```kconfig
# Copyright (c) 2021 Thomas Stranger
# SPDX-License-Identifier: Apache-2.0

config BOARD_RAK3272LP_SIP
	select SOC_STM32WLE5XX
```

## boards/seeed/reterminal_e1002/Kconfig.defconfig
```kconfig
# SPDX-FileCopyrightText: Copyright The Zephyr Project Contributors
# SPDX-License-Identifier: Apache-2.0

if BOARD_RETERMINAL_E1002_ESP32S3_PROCPU

if LVGL

config LV_Z_BITS_PER_PIXEL
	default 24

config LV_Z_FULL_REFRESH
	default y

config LV_Z_VDB_CUSTOM_SECTION
	default y

endif # LVGL

choice SPIRAM_MODE
	default SPIRAM_MODE_OCT
endchoice

endif # BOARD_RETERMINAL_E1002_ESP32S3_PROCPU
```

## boards/seeed/reterminal_e1004/Kconfig.defconfig
```kconfig
# SPDX-FileCopyrightText: Copyright The Zephyr Project Contributors
# SPDX-License-Identifier: Apache-2.0

if BOARD_RETERMINAL_E1004_ESP32S3_PROCPU

if FUEL_GAUGE

# Composite fuel gauge gets battery voltage from ADC-based voltage-divider sensor

config ADC
	default y

config SENSOR
	default y

endif # FUEL_GAUGE

if DISPLAY

# The display driver's full-frame conversion buffer (~940 KiB for the
# 1200x1600 panel) does not fit in internal SRAM, place it in PSRAM.

config ESP_SPIRAM
	default y

config ESP_SPIRAM_BSS_RELOC_LIBS_AND_OBJS
	default "libdrivers__display.a"

endif # DISPLAY

if LVGL

choice LV_COLOR_DEPTH
	default LV_COLOR_DEPTH_24
endchoice

config LV_Z_FULL_REFRESH
	default y

config LV_Z_VDB_CUSTOM_SECTION
	default y

config ESP_SPIRAM
	default y

endif # LVGL

choice SPIRAM_MODE
	default SPIRAM_MODE_OCT
endchoice

endif # BOARD_RETERMINAL_E1004_ESP32S3_PROCPU
```

## boards/seeed/xiao_esp32c6/board.yml
```yaml
board:
  name: xiao_esp32c6
  full_name: XIAO ESP32C6
  vendor: seeed
  socs:
  - name: esp32c6
    variants:
    - name: mr60bha2
      cpucluster: hpcore
```
