/*
 * Copyright (c) 2026 Benjamin Cabé <benjamin@zephyrproject.org>
 *
 * SPDX-License-Identifier: Apache-2.0
 */

#include <zephyr/dt-bindings/pinctrl/ch32v00x-pinctrl.h>

&pinctrl {
	usart1_default: usart1_default {
		group1 {
			pinmux = <USART1_TX_PD5_0>;
			output-high;
			drive-push-pull;
		};

		group2 {
			pinmux = <USART1_RX_PD6_0>;
			bias-pull-up;
		};
	};
};
