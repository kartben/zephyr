## drivers/entropy/Kconfig.microchip_rng90
```kconfig
# Microchip RNG90 I2C entropy driver

# Copyright (c) 2026 The Zephyr Project Contributors
# SPDX-License-Identifier: Apache-2.0

config ENTROPY_MICROCHIP_RNG90
	bool "Microchip RNG90 I2C entropy driver"
	default y
	depends on DT_HAS_MICROCHIP_RNG90_ENABLED
	depends on MULTITHREADING
	select ENTROPY_HAS_DRIVER
	depends on I2C
	help
	  Enable the driver for the Microchip RNG90 CryptoAuthentication secure
	  random number generator (I2C, DS40002499A).
```

## drivers/fuel_gauge/Kconfig.shell
```kconfig
# Copyright The Zephyr Project Contributors
# SPDX-License-Identifier: Apache-2.0

config FUEL_GAUGE_SHELL
	bool "Fuel gauge shell"
	default y
	depends on SHELL
	help
	  Enable battery fuel gauge shell commands.
```

## drivers/gpio/Kconfig.sn74hc138
```kconfig
# Copyright (c) 2024 Benjamin Cabé <benjamin@zephyrproject.org>
# SPDX-License-Identifier: Apache-2.0

config GPIO_SN74HC138
	bool "SN74HC138 3-to-8 decoder"
	default y
	depends on DT_HAS_TI_SN74HC138_ENABLED
	help
	  Use SN74HC138 3-to-8 decoder GPIO driver.

if GPIO_SN74HC138

config GPIO_SN74HC138_INIT_PRIORITY
	int "Init priority"
	default 71
	help
	  Device driver initialization priority.

endif
```
