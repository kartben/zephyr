## boards/xtensa/m5stack_atom_lite/Kconfig.board
```kconfig
# M5Stack Atom Lite board configuration

# Copyright (c) 2023 Benjamin Cabé <benjamin@zephyrproject.org>
# SPDX-License-Identifier: Apache-2.0

config BOARD_M5STACK_ATOM_LITE
	bool "M5Stack ATOM Lite Development Board"
	depends on SOC_SERIES_ESP32

choice SOC_PART_NUMBER
	default SOC_ESP32_PICO_D4
endchoice
```

## boards/xtensa/m5stack_atom_lite/Kconfig.defconfig
```kconfig
# M5Stack ATOM Lite board configuration
# Copyright (c) 2023 Benjamin Cabé <benjamin@zephyrproject.org>
# SPDX-License-Identifier: Apache-2.0

if BOARD_M5STACK_ATOM_LITE

config BOARD
	default "m5stack_atom_lite"
	depends on BOARD_M5STACK_ATOM_LITE

config ENTROPY_GENERATOR
	default y

config HEAP_MEM_POOL_SIZE
	default 98304 if WIFI
	default 65536 if BT
	default 4096

choice BT_HCI_BUS_TYPE
	default BT_ESP32 if BT
endchoice

endif # BOARD_M5STACK_ATOM_LITE
```

## boards/xtensa/m5stack_core2/m5stack_core2_defconfig
```kconfig
# SPDX-License-Identifier: Apache-2.0

CONFIG_BOARD_M5STACK_CORE2=y

CONFIG_SOC_SERIES_ESP32=y
CONFIG_GEN_ISR_TABLES=y
CONFIG_XTENSA_USE_CORE_CRT1=n
CONFIG_XTENSA_RESET_VECTOR=n
CONFIG_GEN_IRQ_VECTOR_TABLE=n

CONFIG_MAIN_STACK_SIZE=4096
CONFIG_HEAP_MEM_POOL_SIZE=4096
CONFIG_ESP_HEAP_MEM_POOL_REGION_1_SIZE=0

CONFIG_GPIO=y

CONFIG_REGULATOR=y

CONFIG_CONSOLE=y
CONFIG_SERIAL=y
CONFIG_UART_CONSOLE=y

# for debugging
CONFIG_SHELL=y
```

## boards/xtensa/m5stickc_plus/m5stickc_plus_defconfig
```kconfig
# SPDX-License-Identifier: Apache-2.0

CONFIG_XTENSA_RESET_VECTOR=n

CONFIG_BOARD_M5STICKC_PLUS=y
CONFIG_SOC_ESP32=y

CONFIG_MAIN_STACK_SIZE=2048

CONFIG_CONSOLE=y
CONFIG_SERIAL=y
CONFIG_UART_CONSOLE=y

CONFIG_XTENSA_USE_CORE_CRT1=n

CONFIG_GPIO=y

CONFIG_GEN_ISR_TABLES=y
CONFIG_GEN_IRQ_VECTOR_TABLE=n

CONFIG_I2C=y
CONFIG_CLOCK_CONTROL=y


CONFIG_LOG=y
CONFIG_LOG_MODE_DEFERRED=y
CONFIG_LOG_PRINTK=y
CONFIG_LOG_BACKEND_UART=y
CONFIG_LOG_BUFFER_SIZE=8192

CONFIG_I2C_LOG_LEVEL_DBG=n
CONFIG_I2C_DUMP_MESSAGES=n

# CONFIG_SPI_LOG_LEVEL_DBG=y
#CONFIG_DISPLAY_LOG_LEVEL_DBG=y

CONFIG_SPI=y
```

## boards/xtensa/sensecap_indicator_esp32/Kconfig.board
```kconfig
# XIAO ESP32S3 board configuration

# Copyright (c) 2023 Seeed Studio inc.
# SPDX-License-Identifier: Apache-2.0

config BOARD_SENSECAP_INDICATOR_ESP32S3
	bool "Seeed Studio SenseCAP Indicator (ESP32)"
	depends on SOC_SERIES_ESP32S3

choice SOC_PART_NUMBER
	default SOC_ESP32S3_R8
endchoice
```

## boards/xtensa/sensecap_indicator_esp32/Kconfig.defconfig
```kconfig
# Copyright (c) 2023 Seeed Studio inc.
# SPDX-License-Identifier: Apache-2.0

config BOARD
	default "sensecap_indicator_esp32"
	depends on BOARD_SENSECAP_INDICATOR_ESP32S3

config ENTROPY_GENERATOR
	default y

config HEAP_MEM_POOL_SIZE
	default 98304 if WIFI
	default 40960 if BT
	default 4096

choice BT_HCI_BUS_TYPE
	default BT_ESP32 if BT
endchoice
```

## cmake/toolchain/filc/Kconfig
```kconfig
# Copyright (c) 2025 Intel Corporation
# SPDX-License-Identifier: Apache-2.0

config TOOLCHAIN_FILC_SUPPORTS_THREAD_LOCAL_STORAGE
	depends on RISCV || ARM || ARM64
	def_bool y
	select TOOLCHAIN_SUPPORTS_THREAD_LOCAL_STORAGE

config TOOLCHAIN_FILC_SUPPORTS_GNU_EXTENSIONS
	def_bool y
	select TOOLCHAIN_SUPPORTS_GNU_EXTENSIONS
```

## drivers/audio/Kconfig
```kconfig
# Audio Codec configuration options

# Copyright (c) 2018 Intel Corporation
# SPDX-License-Identifier: Apache-2.0

menuconfig AUDIO
	bool "Audio drivers"
	help
	  Enable support for Audio

if AUDIO
#
# Audio Codec options
#
menuconfig AUDIO_CODEC
	bool "Audio Codec Drivers"
	help
	  Enable Audio Codec Driver Configuration

if AUDIO_CODEC

config AUDIO_CODEC_INIT_PRIORITY
	int "Init priority"
	default 60
	help
	  Audio codec device driver initialization priority.

config AUDIO_CODEC_SHELL
	bool "Audio Codec shell"
	depends on SHELL
	help
	  Enable the Audio Codec shell with Audio Codec related commands.

module = AUDIO_CODEC
module-str = audio codec
source "subsys/logging/Kconfig.template.log_config"

# zephyr-keep-sorted-start
source "drivers/audio/Kconfig.aw88298"
source "drivers/audio/Kconfig.cs43l22"
source "drivers/audio/Kconfig.da7212"
source "drivers/audio/Kconfig.max98091"
source "drivers/audio/Kconfig.pcm1681"
source "drivers/audio/Kconfig.sf32lb"
source "drivers/audio/Kconfig.tas2563"
source "drivers/audio/Kconfig.tas6422dac"
source "drivers/audio/Kconfig.tlv320aic3110"
source "drivers/audio/Kconfig.tlv320dac"
source "drivers/audio/Kconfig.wm8904"
source "drivers/audio/Kconfig.wm8962"
# zephyr-keep-sorted-stop

endif # AUDIO_CODEC

menuconfig AUDIO_DMIC
	bool "Digital Microphone (Audio) Drivers"
	help
	  Enable Digital Microphone Driver Configuration

if AUDIO_DMIC

config AUDIO_DMIC_INIT_PRIORITY
	int "Init priority"
	default 80
	help
	  Audio Digital Microphone device driver initialization priority.

config AUDIO_DMIC_SHELL
	bool "Audio DMIC shell"
	depends on SHELL
	select SHELL_VT100_COMMANDS
	select BASE64
	help
	  Enable the Audio DMIC shell with commands to read audio data, display a live VU meter, and
	  dump captured PCM as base64 from a digital microphonedevice.

	  Captured buffers are allocated from the system heap only while a command runs and freed
	  afterwards, so the idle cost is just a small control block plus a ~2 KB VU-meter thread
	  stack. The heap is reserved via HEAP_MEM_POOL_ADD_SIZE_AUDIO_DMIC_SHELL.

if AUDIO_DMIC_SHELL

config AUDIO_DMIC_SHELL_BLOCK_COUNT
	int "Number of capture buffers"
	default 8
	range 2 16
	help
	  Number of buffers in the capture pool shared with the DMIC driver.
	  At least two are needed so one buffer can be filled while another is processed.
	  "dmic read" and "dmic vu" use this pool while streaming. "dmic dump" also allocates a
	  temporary PCM buffer for the full capture before base64 output.

config HEAP_MEM_POOL_ADD_SIZE_AUDIO_DMIC_SHELL
	int "System heap reserved for the Audio DMIC shell (bytes)"
	default 81920
	help
	  Heap reserved for the shell capture.
	  The default covers the shell pool (16 kHz mono 16-bit, 50 ms blocks: ~12.8 KB).
	  "dmic dump" additionally malloc()s the full recording (2 s default ~64 KB). Raise the
	  system heap for longer dumps or higher rates (e.g. 10 s at 16 kHz mono needs ~320 KB).
	  A request that does not fit fails with a clean error.

config AUDIO_DMIC_SHELL_VU_PEAK_HOLD_MS
	int "Level meter peak-hold time (ms)"
	default 1000
	help
	  How long the "dmic vu" level meter holds the peak-hold tick ('|') flat after a new peak
	  before it starts decaying back toward the floor.

config AUDIO_DMIC_SHELL_VU_CLIP_HOLD_MS
	int "Level meter clip indicator hold time (ms)"
	default 2000
	help
	  How long the "dmic vu" level meter keeps the red clip indicator ('!') lit after the most
	  recent clipped sample.

config AUDIO_DMIC_SHELL_VU_STACK_SIZE
	int "Level meter worker thread stack size (bytes)"
	default 1024
	help
	  Stack size for the background worker thread that runs the "dmic vu" level meter.

endif # AUDIO_DMIC_SHELL

module = AUDIO_DMIC
module-str = audio_dmic
source "subsys/logging/Kconfig.template.log_config"

# zephyr-keep-sorted-start
source "drivers/audio/Kconfig.dmic_ambiq_pdm"
source "drivers/audio/Kconfig.dmic_esp32"
source "drivers/audio/Kconfig.dmic_infineon"
source "drivers/audio/Kconfig.dmic_mcux"
source "drivers/audio/Kconfig.dmic_mpxxdtyy"
source "drivers/audio/Kconfig.dmic_native_sim"
source "drivers/audio/Kconfig.dmic_nxp_micfil"
source "drivers/audio/Kconfig.dmic_pdm_nrfx"
source "drivers/audio/Kconfig.dmic_stm32_dfsdm"
# zephyr-keep-sorted-stop

endif # AUDIO_DMIC

endif # AUDIO
```

## drivers/audio/Kconfig.dmic_esp32
```kconfig
# Copyright (c) 2025 Espressif Systems (Shanghai) CO LTD
# SPDX-License-Identifier: Apache-2.0

config AUDIO_DMIC_ESP32
	bool "ESP32 I2S PDM DMIC driver"
	default y
	depends on DT_HAS_ESPRESSIF_ESP32_I2S_PDM_DMIC_ENABLED
	depends on SOC_I2S_SUPPORTS_PDM2PCM
	select PINCTRL
	select DMA if DT_HAS_ESPRESSIF_ESP32_GDMA_ENABLED
	help
	  Enable ESP32 digital microphone driver using the I2S peripheral in
	  PDM RX mode with hardware PDM-to-PCM conversion.

if AUDIO_DMIC_ESP32

config AUDIO_DMIC_ESP32_DMA_DESC_NUM_MAX
	int "ESP32 DMIC legacy DMA link descriptor count"
	default 10
	depends on !DT_HAS_ESPRESSIF_ESP32_GDMA_ENABLED
	help
	  Number of link descriptors for RX DMA on SoCs without GDMA.

endif
```

## drivers/audio/Kconfig.ns4168
```kconfig
# Copyright (c) 2024 Arduino SA
# SPDX-License-Identifier: Apache-2.0

config AUDIO_CODEC_NS4168
	bool "ChipSourceTek NS4168 mono I2S Class-D amplifier"
	default y
	depends on DT_HAS_CHIPSOURCETEK_NS4168_ENABLED
	help
	  Enable support for the ChipSourceTek NS4168 mono I2S Class-D amplifier.
```

## drivers/auxdisplay/Kconfig.newhaven_serial
```kconfig
# Copyright (c) 2026
# SPDX-License-Identifier: Apache-2.0

config AUXDISPLAY_NEWHAVEN_SERIAL
	bool "Newhaven serial character LCD driver"
	default y
	depends on DT_HAS_NEWHAVEN_SERIAL_CHARACTER_LCD_ENABLED
	select I2C if $(dt_compat_on_bus,$(DT_COMPAT_NEWHAVEN_SERIAL_CHARACTER_LCD),i2c)
	select SPI if $(dt_compat_on_bus,$(DT_COMPAT_NEWHAVEN_SERIAL_CHARACTER_LCD),spi)
	select SERIAL if $(dt_compat_on_bus,$(DT_COMPAT_NEWHAVEN_SERIAL_CHARACTER_LCD),uart)
	help
	  Enable the driver for Newhaven serial character LCD modules.
```

## drivers/biometrics/Kconfig.dfrobot_ai10
```kconfig
# SPDX-FileCopyrightText: Copyright The Zephyr Project Contributors
# SPDX-License-Identifier: Apache-2.0

config BIOMETRICS_DFROBOT_AI10
	bool "DFRobot AI10 face and palm-vein recognition module"
	default y
	depends on DT_HAS_DFROBOT_AI10_ENABLED
	select SERIAL
	select UART_INTERRUPT_DRIVEN
	help
	  Enable driver for the DFRobot AI10 UART face and palm-vein
	  recognition module.

if BIOMETRICS_DFROBOT_AI10

config DFROBOT_AI10_TIMEOUT_MS
	int "Default capture timeout in milliseconds"
	range 3000 20000
	default 10000
	help
	  Default timeout for enrollment and matching captures, used when the
	  application passes K_FOREVER. The module accepts capture timeouts
	  between 3 and 20 seconds.

endif # BIOMETRICS_DFROBOT_AI10
```

## drivers/biometrics/Kconfig.id809
```kconfig
# SPDX-License-Identifier: Apache-2.0
# Copyright (c) 2025 Siratul Islam

config BIOMETRICS_ID809
	bool "DFRobot ID809 Capacitive Fingerprint Sensor"
	default y
	depends on DT_HAS_DFROBOT_ID809_ENABLED || DT_HAS_DFROBOT_ID809_I2C_ENABLED
	select SERIAL if DT_HAS_DFROBOT_ID809_ENABLED
	select UART_INTERRUPT_DRIVEN if DT_HAS_DFROBOT_ID809_ENABLED
	select I2C if DT_HAS_DFROBOT_ID809_I2C_ENABLED
	help
	  Enable driver for the DFRobot ID809 capacitive fingerprint sensor
	  (SEN0348). Supports both UART (interrupt-driven) and I2C bus variants.

if BIOMETRICS_ID809

config ID809_TIMEOUT_MS
	int "Default operation timeout in milliseconds"
	default 10000
	help
	  Default timeout for fingerprint detection, enrollment, and matching
	  operations. Can be overridden at runtime via biometric_attr_set().

endif # BIOMETRICS_ID809
```

## drivers/buzzer/Kconfig.i2s
```kconfig
# SPDX-FileCopyrightText: Copyright The Zephyr Project Contributors
# SPDX-License-Identifier: Apache-2.0

config BUZZER_I2S
	bool "I2S-driven buzzer"
	default y
	depends on DT_HAS_I2S_BUZZER_ENABLED
	select I2S
	help
	  Enable the I2S backend for buzzers connected as I2S TX
	  devices. The driver generates a square wave whose pitch and
	  amplitude are controlled through the generic buzzer API.
```

## drivers/charger/Kconfig.shell
```kconfig
# Copyright The Zephyr Project Contributors
# SPDX-License-Identifier: Apache-2.0

config CHARGER_SHELL
	bool "Charger shell"
	default y
	depends on SHELL
	help
	  Enable battery charger shell commands.
```

## drivers/display/Kconfig.ed2208_gca
```kconfig
# Copyright 2026 The Zephyr Project Contributors
# SPDX-License-Identifier: Apache-2.0

config ED2208_GCA
	bool "ED2208-GCA (EL073TF1) / T133A01 display controller"
	default y
	depends on DT_HAS_EINK_ED2208_GCA_ENABLED || DT_HAS_EINK_T133A01_ENABLED
	select MIPI_DBI
	select DISPLAY_COLOR_PALETTE
	select DISPLAY_COLOR_DITHER_SUPPORTED
	help
	  Enable driver for the ED2208-GCA family of Spectra 6 e-ink display
	  controllers: ED2208-GCA (EL073TF1) single-controller panels and
	  T133A01 dual-controller panels.
```

## drivers/display/Kconfig.gdep073e01
```kconfig
# Copyright (c) 2026 Benjamin Lemouzy
# SPDX-License-Identifier: Apache-2.0

config GDEP073E01
	bool "GDEP073E01 display controller (7.3\" Spectra 6 e-paper)"
	default y
	depends on DT_HAS_GOODDISPLAY_GDEP073E01_ENABLED
	select MIPI_DBI
	help
	  Enable driver for Good Display GDEP073E01 / Waveshare 7.3inch e-Paper (E) controller.
```

## drivers/display/Kconfig.it8951
```kconfig
# Copyright (c) 2026 The Zephyr Project Contributors
# SPDX-License-Identifier: Apache-2.0

config IT8951
	bool "IT8951 e-paper display controller"
	default y
	depends on DT_HAS_ITE_IT8951_ENABLED
	depends on SPI
	help
	  Enable driver for the ITE IT8951 e-paper display controller.
	  The IT8951 is suitable for large reflective e-paper panels such as
	  the E Ink ED103TC2 (10.3-inch, 1872 x 1404, 16 grey levels).
```

## drivers/display/Kconfig.led_strip_pov
```kconfig
config LED_STRIP_POV
	bool "LED strip persistence-of-vision display"
	depends on DT_HAS_LED_STRIP_POV_ENABLED
	depends on SENSOR
	select LED_STRIP
	help
	Enable support for persistence-of-vision displays that use a single LED
	strip with tachometer feedback for rotational speed.

if LED_STRIP_POV

config LED_STRIP_POV_SENSOR_THREAD_STACK_SIZE
	int "Sensor thread stack size"
	default 1024
	help
	Stack size for the worker thread that monitors the tachometer sensor.

config LED_STRIP_POV_SENSOR_THREAD_PRIORITY
	int "Sensor thread priority"
	default 5
	help
	Thread priority used for the tachometer monitoring thread.

config LED_STRIP_POV_SENSOR_POLL_INTERVAL_MS
	int "Sensor poll interval (ms)"
	default 100
	help
	Interval in milliseconds between tachometer samples when determining the
	current rotation speed.

config LED_STRIP_POV_DEFAULT_RPM
	int "Default RPM fallback"
	default 600
	help
	RPM value used to derive refresh timing when the tachometer is unavailable
	or reports zero speed.

endif # LED_STRIP_POV
```

## drivers/display/Kconfig.palette_dither
```kconfig
# SPDX-FileCopyrightText: Copyright The Zephyr Project Contributors
# SPDX-License-Identifier: Apache-2.0

config DISPLAY_PALETTE_DITHER
	bool "Virtual palette dithering display"
	default y
	depends on DT_HAS_ZEPHYR_PALETTE_DITHER_DISPLAY_ENABLED
	select DISPLAY_COLOR_PALETTE
	help
	  Enable a virtual display that wraps a palette-backed display device and
	  exposes I_4, RGB565, RGB565X, and RGB888 input formats. I_4 operations are
	  passed through directly, while non-indexed writes are dithered to the
	  wrapped display's I_4 palette format.

	  The wrapper allocates a conversion buffer sized for the wrapped display's
	  full I_4 frame buffer.
```

## drivers/display/Kconfig.t133a01
```kconfig
# Copyright 2026 The Zephyr Project Contributors
# SPDX-License-Identifier: Apache-2.0

config T133A01
	bool "T133A01 display controller"
	default y
	depends on DT_HAS_EINK_T133A01_ENABLED
	select MIPI_DBI
	select DISPLAY_COLOR_PALETTE
	select DISPLAY_COLOR_DITHER_SUPPORTED
	help
	  Enable driver for the T133A01 dual-controller Spectra 6 e-ink display.
```

## drivers/display/Kconfig.virtio_gpu
```kconfig
# Copyright (c) 2026 The Zephyr Project Contributors
# SPDX-License-Identifier: Apache-2.0

config VIRTIO_GPU_DISPLAY
	bool "VIRTIO GPU display"
	default y
	depends on DT_HAS_VIRTIO_GPU_ENABLED
	select VIRTIO
	help
	  Enable the VIRTIO GPU 2D display driver.

config VIRTIO_GPU_DISPLAY_QUEUE_SIZE
	int "VIRTIO GPU virtqueue size"
	depends on VIRTIO_GPU_DISPLAY
	default 16
	range 2 256
	help
	  Number of descriptors allocated for each VIRTIO GPU virtqueue. This
	  value must be a power of two.
```
