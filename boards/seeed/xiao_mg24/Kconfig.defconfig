## boards/seeed/xiao_mg24/Kconfig.xiao_mg24
```kconfig
# Copyright (c) 2024 The Linux Foundation
# SPDX-License-Identifier: Apache-2.0

config BOARD_XIAO_MG24
	select SOC_PART_NUMBER_EFR32MG24B220F1536IM48
```

## boards/shields/m5stack_cardputer/Kconfig.defconfig
```kconfig
# M5Stack Cardputer shield configuration
# Copyright (c) 2024 Benjamin Cabé <benjamin@zephyrproject.org>
# SPDX-License-Identifier: Apache-2.0

if SHIELD_M5STACK_CARDPUTER

config INPUT
	default y

config LV_COLOR_16_SWAP
	default y if LVGL

endif # SHIELD_M5STACK_CARDPUTER
```

## boards/shields/m5stack_cardputer/Kconfig.shield
```kconfig
# M5Stack Cardputer board configuration

# Copyright (c) 2024 Benjamin Cabé <benjamin@zephyrproject.org>
# SPDX-License-Identifier: Apache-2.0

config SHIELD_M5STACK_CARDPUTER
	def_bool $(shields_list_contains,m5stack_cardputer)
```

## boards/shields/m5stampfly/Kconfig.defconfig
```kconfig
# M5StampFly shield configuration
# Copyright (c) 2024 The Linux Foundation.
# SPDX-License-Identifier: Apache-2.0

if SHIELD_M5STAMPFLY

config PWM
	default y

# config REGULATOR
# 	default y

endif # SHIELD_M5STAMPFLY
```

## boards/shields/m5stampfly/Kconfig.shield
```kconfig
# Copyright (c) 2023 Martin Kiepfer <mrmarteng@teleschirm.org>
# SPDX-License-Identifier: Apache-2.0

config SHIELD_M5STAMPFLY
	def_bool $(shields_list_contains,m5stampfly)
```

## boards/shields/mikroe_10dof_click/Kconfig.shield
```kconfig
# Copyright The Zephyr Project Contributors
# SPDX-License-Identifier: Apache-2.0

config SHIELD_MIKROE_10DOF_CLICK
	def_bool $(shields_list_contains,mikroe_10dof_click)
```

## boards/shields/mikroe_3d_hall_6_click/Kconfig.shield
```kconfig
# Copyright The Zephyr Project Contributors
# SPDX-License-Identifier: Apache-2.0

config SHIELD_MIKROE_3D_HALL_6_CLICK
	def_bool $(shields_list_contains,mikroe_3d_hall_6_click)
```

## boards/shields/mikroe_6dof_imu_2_click/Kconfig.shield
```kconfig
# Copyright The Zephyr Project Contributors
# SPDX-License-Identifier: Apache-2.0

config SHIELD_MIKROE_6DOF_IMU_2_CLICK
	def_bool $(shields_list_contains,mikroe_6dof_imu_2_click)
```

## boards/shields/mikroe_accel_6_click/Kconfig.shield
```kconfig
# Copyright (c) 2024 Benjamin Cabé <benjamin@zephyrproject.org>
# SPDX-License-Identifier: Apache-2.0

config SHIELD_MIKROE_ACCEL_6_CLICK
	def_bool $(shields_list_contains,mikroe_accel_6_click)
```

## boards/shields/mikroe_accel_8_click/Kconfig.shield
```kconfig
# Copyright The Zephyr Project Contributors
# SPDX-License-Identifier: Apache-2.0

config SHIELD_MIKROE_ACCEL_8_CLICK
	def_bool $(shields_list_contains,mikroe_accel_8_click)
```

## boards/shields/mikroe_accel_click/Kconfig.shield
```kconfig
# Copyright The Zephyr Project Contributors
# SPDX-License-Identifier: Apache-2.0

config SHIELD_MIKROE_ACCEL_CLICK
	def_bool $(shields_list_contains,mikroe_accel_click)
```

## boards/shields/mikroe_adc_8_click/Kconfig.shield
```kconfig
# Copyright The Zephyr Project Contributors
# SPDX-License-Identifier: Apache-2.0

config SHIELD_MIKROE_ADC_8_CLICK
	def_bool $(shields_list_contains,mikroe_adc_8_click)
```

## boards/shields/mikroe_air_quality_5_click/Kconfig.shield
```kconfig
# Copyright (c) 2024 Benjamin Cabé <benjamin@zephyrproject.org>
# SPDX-License-Identifier: Apache-2.0

config SHIELD_MIKROE_AIR_QUALITY_5_CLICK
	def_bool $(shields_list_contains,mikroe_air_quality_5_click)
```

## boards/shields/mikroe_altitude_2_click/Kconfig.defconfig
```kconfig
# Copyright (c) 2024 Benjamin Cabé <benjamin@zephyrproject.org>
# SPDX-License-Identifier: Apache-2.0

if SHIELD_MIKROE_ALTITUDE_2_CLICK

config MS5607
	default y

endif # SHIELD_MIKROE_ALTITUDE_2_CLICK
```

## boards/shields/mikroe_altitude_2_click/Kconfig.shield
```kconfig
# Copyright The Zephyr Project Contributors
# SPDX-License-Identifier: Apache-2.0

config SHIELD_MIKROE_ALTITUDE_2_CLICK
	def_bool $(shields_list_contains,mikroe_altitude_2_click)
```

## boards/shields/mikroe_ambient_2_click/Kconfig.defconfig
```kconfig
# Copyright (c) 2024 Benjamin Cabé <benjamin@zephyrproject.org>
# SPDX-License-Identifier: Apache-2.0

if SHIELD_MIKROE_AMBIENT_2_CLICK

config OPT3001
	default y

endif # SHIELD_MIKROE_AMBIENT_2_CLICK
```

## boards/shields/mikroe_environment_click/Kconfig.shield
```kconfig
# Copyright (c) 2024 Benjamin Cabé <benjamin@zephyrproject.org>
# SPDX-License-Identifier: Apache-2.0

config SHIELD_MIKROE_ENVIRONMENT_CLICK
	def_bool $(shields_list_contains,mikroe_environment_click)
```

## boards/shields/mikroe_eth_wiz_click/Kconfig.shield
```kconfig
# Copyright The Zephyr Project Contributors
# SPDX-License-Identifier: Apache-2.0

config SHIELD_MIKROE_ETH_WIZ_CLICK
	def_bool $(shields_list_contains,mikroe_eth_wiz_click)
```

## boards/shields/mikroe_illuminance_click/Kconfig.defconfig
```kconfig
# Copyright (c) 2024 Benjamin Cabé <benjamin@zephyrproject.org>
# SPDX-License-Identifier: Apache-2.0

if SHIELD_MIKROE_ILLUMINANCE_CLICK

config TSL2561
	default y

endif # SHIELD_MIKROE_ILLUMINANCE_CLICK
```

## boards/shields/mikroe_ir_gesture_click/Kconfig.defconfig
```kconfig
# Copyright (c) 2024 Benjamin Cabé <benjamin@zephyrproject.org>
# SPDX-License-Identifier: Apache-2.0

if SHIELD_MIKROE_IR_GESTURE_CLICK

config APDS9960
	default y

endif # SHIELD_MIKROE_IR_GESTURE_CLICK
```

## boards/shields/mikroe_ir_gesture_click/Kconfig.shield
```kconfig
# Copyright (c) 2024 Benjamin Cabé <benjamin@zephyrproject.org>
# SPDX-License-Identifier: Apache-2.0

config SHIELD_MIKROE_IR_GESTURE_CLICK
	def_bool $(shields_list_contains,mikroe_ir_gesture_click)
```

## boards/shields/mikroe_ir_thermo_2_click/Kconfig.defconfig
```kconfig
# Copyright (c) 2024 Benjamin Cabé <benjamin@zephyrproject.org>
# SPDX-License-Identifier: Apache-2.0

if SHIELD_MIKROE_IR_THERMO_2_CLICK

config TMP007
	default y

endif # SHIELD_MIKROE_IR_THERMO_2_CLICK
```

## boards/shields/mikroe_ir_thermo_2_click/Kconfig.shield
```kconfig
# Copyright (c) 2024 Benjamin Cabé <benjamin@zephyrproject.org>
# SPDX-License-Identifier: Apache-2.0

config SHIELD_MIKROE_IR_THERMO_2_CLICK
	def_bool $(shields_list_contains,mikroe_ir_thermo_2_click)
```

## boards/shields/mikroe_lightranger_2_click/Kconfig.defconfig
```kconfig
# Copyright (c) 2024 Benjamin Cabé <benjamin@zephyrproject.org>
# SPDX-License-Identifier: Apache-2.0

if SHIELD_MIKROE_LIGHTRANGER_2_CLICK

config VL53L0X
	default y

endif # SHIELD_MIKROE_LIGHTRANGER_2_CLICK
```
