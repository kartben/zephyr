/*
 * Copyright (c) 2024 Benjamin Cabé <benjamin@zephyrproject.org>
 * SPDX-License-Identifier: Apache-2.0
 */

&mikrobus_spi {
	status = "okay";

	mcp3204@0 {
		compatible = "microchip,mcp3204";
		spi-max-frequency = <1000000>;
		reg = <0>;
		#io-channel-cells = <1>;
	};
};
