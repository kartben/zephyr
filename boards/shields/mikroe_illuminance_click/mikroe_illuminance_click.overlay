/*
 * Copyright The Zephyr Project Contributors
 * SPDX-License-Identifier: Apache-2.0
 */

&mikrobus_i2c {
	status = "okay";

	tsl2561_mikroe_illuminance_click: tsl2561@49 {
		compatible = "ams,tsl2561";
		reg = <0x49>;
		int-gpios = <&mikrobus_header 7 GPIO_ACTIVE_LOW>;
	};
};
