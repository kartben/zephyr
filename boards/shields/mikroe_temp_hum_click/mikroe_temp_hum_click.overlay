/*
 * Copyright The Zephyr Project Contributors
 * SPDX-License-Identifier: Apache-2.0
 */

&mikrobus_i2c {
	status = "okay";

	hts221_mikroe_temp_hum_click: hts221@5f {
		compatible = "st,hts221-common";
		reg = <0x5f>;
		int-gpios = <&mikrobus_header 7 GPIO_ACTIVE_LOW>;
	};
};
