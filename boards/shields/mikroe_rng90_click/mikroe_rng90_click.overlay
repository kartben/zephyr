/*
 * Copyright (c) 2026 The Zephyr Project Contributors
 * SPDX-License-Identifier: Apache-2.0
 *
 * Microchip RNG90 on MikroElektronika RNG90 / RNG 2 Click (I2C).
 */

#include <zephyr/dt-bindings/i2c/i2c.h>

/ {
	chosen {
		zephyr,entropy = &rng90_mikroe_rng90_click;
	};
};

&mikrobus_i2c {
	status = "okay";
	clock-frequency = <I2C_BITRATE_FAST>;

	rng90_mikroe_rng90_click: rng90@40 {
		compatible = "microchip,rng90";
		reg = <0x40>;
		status = "okay";
	};
};
