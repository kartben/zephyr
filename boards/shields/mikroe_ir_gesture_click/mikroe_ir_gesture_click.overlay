/*
 * Copyright (c) 2024 Benjamin Cabé <benjamin@zephyrproject.org>
 * SPDX-License-Identifier: Apache-2.0
 */

&mikrobus_i2c {
	status = "okay";

	apds9960@39 {
		compatible = "avago,apds9960";
		reg = <0x39>;
		int-gpios = <&mikrobus_header 7 (GPIO_ACTIVE_LOW | GPIO_PULL_UP)>;
	};
};
