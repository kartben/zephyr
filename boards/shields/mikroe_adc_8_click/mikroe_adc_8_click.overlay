/*
 * Copyright The Zephyr Project Contributors
 * SPDX-License-Identifier: Apache-2.0
 */

&mikrobus_i2c {
	status = "okay";

	ads1115_mikroe_adc_8_click: ads1115@48 {
		compatible = "ti,ads1115";
		reg = <0x48>;
	};
};
