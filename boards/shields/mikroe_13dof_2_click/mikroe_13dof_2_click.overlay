/*
 * Copyright The Zephyr Project Contributors
 * SPDX-License-Identifier: Apache-2.0
 */

&mikrobus_i2c {
	status = "okay";

	bme680_mikroe_13dof_2_click: bme680@77 {
		compatible = "bosch,bme680";
		reg = <0x77>;
	};
};
