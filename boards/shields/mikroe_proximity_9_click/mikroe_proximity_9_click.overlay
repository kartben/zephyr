/*
 * Copyright (c) 2024 Benjamin Cabé <benjamin@zephyrproject.org>
 * SPDX-License-Identifier: Apache-2.0
 */

&mikrobus_i2c {
	status = "okay";

	vcnl4040@60 {
		compatible = "vishay,vcnl4040";
		reg = <0x60>;
		status = "okay";
	};
};
