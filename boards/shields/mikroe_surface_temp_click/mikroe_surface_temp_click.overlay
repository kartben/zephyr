/*
 * Copyright The Zephyr Project Contributors
 * SPDX-License-Identifier: Apache-2.0
 */

&mikrobus_i2c {
	status = "okay";

	adt7420_mikroe_surface_temp_click: adt7420@48 {
		compatible = "adi,adt7420";
		reg = <0x48>;
		int-gpios = <&mikrobus_header 7 GPIO_ACTIVE_LOW>;
	};
};
