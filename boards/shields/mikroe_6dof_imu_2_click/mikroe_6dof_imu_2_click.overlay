/*
 * Copyright The Zephyr Project Contributors
 * SPDX-License-Identifier: Apache-2.0
 */

&mikrobus_i2c {
	status = "okay";

	bmi160_mikroe_6dof_imu_2_click: bmi160@68 {
		compatible = "bosch,bmi160";
		reg = <0x68>;
		int-gpios = <&mikrobus_header 7 GPIO_ACTIVE_LOW>;
	};
};
