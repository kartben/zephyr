/*
 * Copyright The Zephyr Project Contributors
 * SPDX-License-Identifier: Apache-2.0
 */

&mikrobus_spi {
	status = "okay";

	w5500_mikroe_eth_wiz_click: w5500@0 {
		compatible = "wiznet,w5500";
		reg = <0>;
		spi-max-frequency = <24000000>;
		int-gpios = <&mikrobus_header 7 GPIO_ACTIVE_LOW>;
	};
};
