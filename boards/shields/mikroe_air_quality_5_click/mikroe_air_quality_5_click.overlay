/*
 * Copyright The Zephyr Project Contributors
 * SPDX-License-Identifier: Apache-2.0
 */

&mikrobus_i2c {
	status = "okay";

	ads1015_mikroe_air_quality_5_click: ads1015@48 {
		compatible = "ti,ads1015";
		reg = <0x48>;
	};
};
