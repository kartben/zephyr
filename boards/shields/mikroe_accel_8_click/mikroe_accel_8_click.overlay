/*
 * Copyright The Zephyr Project Contributors
 * SPDX-License-Identifier: Apache-2.0
 */

&mikrobus_i2c {
	status = "okay";

	mpu6050_mikroe_accel_8_click: mpu6050@69 {
		compatible = "invensense,mpu6050";
		reg = <0x69>;
		int-gpios = <&mikrobus_header 7 GPIO_ACTIVE_LOW>;
	};
};
