## boards/shields/mikroe_lsm6dsl_click/Kconfig.defconfig
```kconfig
# Copyright (c) 2024 Benjamin Cabé <benjamin@zephyrproject.org>
# SPDX-License-Identifier: Apache-2.0

if SHIELD_MIKROE_LSM6DSL_CLICK

config LSM6DSL
	default y

endif # SHIELD_MIKROE_LSM6DSL_CLICK
```

## boards/shields/mikroe_pressure_3_click/Kconfig.defconfig
```kconfig
# Copyright (c) 2024 Benjamin Cabé <benjamin@zephyrproject.org>
# SPDX-License-Identifier: Apache-2.0

if SHIELD_MIKROE_PRESSURE_3_CLICK

config DPS310
	default y

endif # SHIELD_MIKROE_PRESSURE_3_CLICK
```

## boards/shields/mikroe_pressure_3_click/Kconfig.shield
```kconfig
# Copyright (c) 2024 Benjamin Cabé <benjamin@zephyrproject.org>
# SPDX-License-Identifier: Apache-2.0

config SHIELD_MIKROE_PRESSURE_3_CLICK
	def_bool $(shields_list_contains,mikroe_pressure_3_click)
```

## boards/shields/mikroe_rng90_click/Kconfig.shield
```kconfig
# Copyright (c) 2026 The Zephyr Project Contributors
# SPDX-License-Identifier: Apache-2.0

config SHIELD_MIKROE_RNG90_CLICK
	def_bool $(shields_list_contains,mikroe_rng90_click)
```

## boards/shields/mikroe_temp_hum_12_click/Kconfig.shield
```kconfig
# Copyright The Zephyr Project Contributors
# SPDX-License-Identifier: Apache-2.0

config SHIELD_MIKROE_TEMP_HUM_12_CLICK
	def_bool $(shields_list_contains,mikroe_temp_hum_12_click)
```

## boards/shields/mikroe_temp_hum_8_click/Kconfig.shield
```kconfig
# Copyright (c) 2024 Benjamin Cabé <benjamin@zephyrproject.org>
# SPDX-License-Identifier: Apache-2.0

config SHIELD_MIKROE_TEMP_HUM_8_CLICK
	def_bool $(shields_list_contains,mikroe_temp_hum_8_click)
```

## boards/shields/mikroe_temp_hum_click/Kconfig.defconfig
```kconfig
# Copyright (c) 2024 Benjamin Cabé <benjamin@zephyrproject.org>
# SPDX-License-Identifier: Apache-2.0

if SHIELD_MIKROE_TEMP_HUM_CLICK

config HTS221
	default y

endif # SHIELD_MIKROE_TEMP_HUM_CLICK
```

## boards/shields/mikroe_temp_hum_click/Kconfig.shield
```kconfig
# Copyright The Zephyr Project Contributors
# SPDX-License-Identifier: Apache-2.0

config SHIELD_MIKROE_TEMP_HUM_CLICK
	def_bool $(shields_list_contains,mikroe_temp_hum_click)
```

## boards/shields/mikroe_thermo_12_click/Kconfig.shield
```kconfig
# Copyright (c) 2024 Benjamin Cabé <benjamin@zephyrproject.org>
# SPDX-License-Identifier: Apache-2.0

config SHIELD_MIKROE_THERMO_12_CLICK
	def_bool $(shields_list_contains,mikroe_thermo_12_click)
```

## boards/shields/mikroe_vibro_motor_click/Kconfig.shield
```kconfig
# Copyright (c) 2024 Common Ground Electronics
# SPDX-License-Identifier: Apache-2.0

config SHIELD_MIKROE_VIBRO_MOTOR_CLICK
	def_bool $(shields_list_contains,mikroe_vibro_motor_click)
```

## boards/shields/seeed_xiao_mr60bha2/Kconfig.shield
```kconfig
# SPDX-FileCopyrightText: Copyright The Zephyr Project Contributors
# SPDX-License-Identifier: Apache-2.0

config SHIELD_SEEED_XIAO_MR60BHA2
	def_bool $(shields_list_contains,seeed_xiao_mr60bha2)
```

## boards/shields/sparkfun_micropressure/Kconfig.shield
```kconfig
# SPDX-License-Identifier: Apache-2.0

config SHIELD_SPARKFUN_MICROPRESSURE
	def_bool $(shields_list_contains,sparkfun_micropressure)
```

## boards/sparkfun/micromod/board.yml
```yaml
board:
  name: micromod
  full_name: SparkFun MicroMod Processor Board
  vendor: sparkfun
  socs:
  - name: nrf52840
```

## boards/viewe/uedx24320028e_wb_a/Kconfig.defconfig
```kconfig
# SPDX-License-Identifier: Apache-2.0

if BOARD_UEDX24320028E_WB_A_ESP32S3_PROCPU

configdefault LV_COLOR_16_SWAP
	default y if LVGL

endif # BOARD_UEDX24320028E_WB_A_ESP32S3_PROCPU
```

## boards/viewe/uedx24320028e_wb_a/uedx24320028e_wb_a_procpu_defconfig
```kconfig
# SPDX-License-Identifier: Apache-2.0

CONFIG_CONSOLE=y
CONFIG_SERIAL=y
CONFIG_UART_CONSOLE=y
CONFIG_GPIO=y
CONFIG_CLOCK_CONTROL=y
CONFIG_I2C=y
CONFIG_SPI=y
CONFIG_DISPLAY=y
CONFIG_MIPI_DBI=y
CONFIG_REGULATOR=y
CONFIG_LED_STRIP=y
CONFIG_GPIO_HOGS=y
CONFIG_INPUT=y
```

## boards/viewe/uedx80480070e_wb_a/Kconfig.defconfig
```kconfig
# SPDX-FileCopyrightText: Copyright The Zephyr Project Contributors
# SPDX-License-Identifier: Apache-2.0

if BOARD_UEDX80480070E_WB_A_ESP32S3_PROCPU

config LV_COLOR_16_SWAP
	default y if LVGL

if DISPLAY

config REGULATOR
	default y

endif # DISPLAY

endif # BOARD_UEDX80480070E_WB_A_ESP32S3_PROCPU
```

## boards/waveshare/esp32s3_rlcd_4_2/Kconfig.defconfig
```kconfig
# SPDX-FileCopyrightText: Copyright The Zephyr Project Contributors
# SPDX-License-Identifier: Apache-2.0

if LVGL

config LV_Z_BITS_PER_PIXEL
	default 1

choice LV_COLOR_DEPTH
	default LV_COLOR_DEPTH_1
endchoice

endif # LVGL
```

## boards/we/ophelia1ev/board.yml
```yaml
board:
  name: we_ophelia1ev
  full_name: Ophelia-I EV nRF52805
  vendor: we
  socs:
  - name: nrf52805
```

## boards/weact/weact_ch32v006/Kconfig.weact_ch32v006
```kconfig
# Copyright (c) 2026 Benjamin Cabé <benjamin@zephyrproject.org>
# SPDX-License-Identifier: Apache-2.0

config BOARD_WEACT_CH32V006
	select SOC_CH32V006
```

## boards/weact/weact_ch32v006/board.yml
```yaml
board:
  name: weact_ch32v006
  full_name: WeAct Studio CH32V006 Core Board
  vendor: weact
  socs:
    - name: ch32v006
```

## boards/xteink/x4/Kconfig.xteink_x4
```kconfig
# Copyright (c) 2026
# SPDX-License-Identifier: Apache-2.0

config BOARD_XTEINK_X4
	select SOC_ESP32C3_FH4
```

## boards/xteink/x4/board.yml
```yaml
board:
  name: xteink_x4
  full_name: Xteink X4 eReader
  vendor: xteink
  socs:
  - name: esp32c3
```

## boards/xteink/x4/xteink_x4_defconfig
```kconfig
# SPDX-License-Identifier: Apache-2.0

CONFIG_CONSOLE=y
CONFIG_SERIAL=y
CONFIG_UART_CONSOLE=y
CONFIG_GPIO=y
CONFIG_SPI=y
CONFIG_DISPLAY=y
CONFIG_SSD16XX=y
CONFIG_MIPI_DBI=y
```

## boards/xteink/xteink_x4/Kconfig.xteink_x4
```kconfig
# Copyright (c) 2025 Xteink
# SPDX-License-Identifier: Apache-2.0

config BOARD_XTEINK_X4
	select SOC_ESP32C3_FN4
```

## boards/xteink/xteink_x4/board.yml
```yaml
board:
  name: xteink_x4
  full_name: Xteink X4
  vendor: xteink
  socs:
  - name: esp32c3
```
