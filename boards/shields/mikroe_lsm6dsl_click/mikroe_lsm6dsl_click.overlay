/*
 * Copyright The Zephyr Project Contributors
 * SPDX-License-Identifier: Apache-2.0
 */

&mikrobus_spi {
	status = "okay";

	lsm6dsl_mikroe_lsm6dsl_click: lsm6dsl@0 {
		compatible = "st,lsm6dsl";
		reg = <0>;
		spi-max-frequency = <1000000>;
		int-gpios = <&mikrobus_header 7 GPIO_ACTIVE_LOW>;
	};
};
