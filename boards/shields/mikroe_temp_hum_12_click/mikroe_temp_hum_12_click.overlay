/*
 * Copyright The Zephyr Project Contributors
 * SPDX-License-Identifier: Apache-2.0
 */

&mikrobus_i2c {
	status = "okay";

	hdc2080_mikroe_temp_hum_12_click: hdc2080@40 {
		compatible = "ti,hdc2080";
		reg = <0x40>;
	};
};
