## boards/aconno/acn52832/board.yml
```yaml
board:
  name: acn52832
  full_name: ACN52832
  vendor: aconno
  socs:
  - name: nrf52832
```

## boards/adafruit/itsybitsy_rp2040/board.yml
```yaml
board:
  name: adafruit_itsybitsy_rp2040
  full_name: ItsyBitsy RP2040
  vendor: adafruit
  socs:
  - name: rp2040
```

## boards/adafruit/macropad_rp2040/Kconfig.defconfig
```kconfig
# Copyright (c) 2025 Benjamin Cabé <benjamin@zephyrproject.org>
# SPDX-License-Identifier: Apache-2.0

if BOARD_ADAFRUIT_MACROPAD_RP2040

if I2C_DW

config I2C_DW_CLOCK_SPEED
	default 125

endif # I2C_DW

config USB_SELF_POWERED
	default n

if LVGL

config LV_Z_VDB_SIZE
	default 64

config LV_DPI_DEF
	default 116

config LV_Z_BITS_PER_PIXEL
	default 1

choice LV_COLOR_DEPTH
	default LV_COLOR_DEPTH_1
endchoice

config LV_USE_THEME_DEFAULT
	default y

endif # LVGL

endif # BOARD_ADAFRUIT_MACROPAD_RP2040
```

## boards/andestech/adp_xc7k_ae350/board.yml
```yaml
board:
  name: adp_xc7k
  full_name: Andes ADP-XC7K AE350
  vendor: andestech
  socs:
  - name: ae350
```

## boards/aspeed/ast1030_evb/board.yml
```yaml
board:
  name: ast1030_evb
  full_name: AST1030 EVB
  vendor: aspeed
  socs:
  - name: ast1030
```

## boards/blues/swan_r5/board.yml
```yaml
board:
  name: swan_r5
  full_name: Blues Wireless Swan
  vendor: blues
  socs:
    - name: stm32l4r5xx
```

## boards/electronut/nrf52840_blip/board.yml
```yaml
board:
  name: nrf52840_blip
  full_name: Electronut Labs Blip
  vendor: electronut
  socs:
  - name: nrf52840
```

## boards/electronut/nrf52840_papyr/board.yml
```yaml
board:
  name: nrf52840_papyr
  full_name: Electronut Labs Papyr
  vendor: electronut
  socs:
  - name: nrf52840
```

## boards/ene/kb1062_evb/board.yml
```yaml
board:
  name: kb1062_evb
  full_name: ENE KB1062 EVB
  vendor: ene
  socs:
  - name: kb1062
```

## boards/ene/kb1200_evb/board.yml
```yaml
board:
  name: kb1200_evb
  full_name: ENE KB1200 EVB
  vendor: ene
  socs:
  - name: kb1200
```

## boards/intel/niosv_g/board.yml
```yaml
board:
  name: niosv_g
  full_name: Intel FPGA Nios V/g
  vendor: intel
  socs:
    - name: niosv_g
```

## boards/intel/niosv_m/board.yml
```yaml
board:
  name: niosv_m
  full_name: Intel FPGA Nios V/m
  vendor: intel
  socs:
    - name: niosv_m
```

## boards/lilygo/t_deck/Kconfig.defconfig
```kconfig
# SPDX-FileCopyrightText: Copyright The Zephyr Project Contributors
# SPDX-License-Identifier: Apache-2.0

if BOARD_T_DECK_ESP32S3_PROCPU

if LVGL

choice LV_COLOR_DEPTH
	default LV_COLOR_DEPTH_16
endchoice

config LV_COLOR_16_SWAP
	default y

endif # LVGL

if BOARD_REVISION_PLUS

if FUEL_GAUGE

# Composite fuel gauge gets battery voltage from ADC-based voltage-divider sensor

config ADC
	default y

config SENSOR
	default y

endif # FUEL_GAUGE

endif # BOARD_REVISION_PLUS

endif # BOARD_T_DECK_ESP32S3_PROCPU
```

## boards/lilygo/t_deck/board.yml
```yaml
# SPDX-FileCopyrightText: Copyright The Zephyr Project Contributors
# SPDX-License-Identifier: Apache-2.0

board:
  name: t_deck
  full_name: LilyGO T-Deck / T-Deck Plus
  vendor: lilygo
  revision:
    format: custom
    default: ""
    revisions:
    - name: ""
    - name: plus
  socs:
  - name: esp32s3
```

## boards/luatos/esp32c3_luatos_core/board.yml
```yaml
board:
  name: esp32c3_luatos_core
  full_name: ESP32C3 LuatOS Core
  vendor: luatos
  socs:
  - name: esp32c3
    variants:
    - name: usb
```

## boards/m5stack/m5stack_paper_color/Kconfig.defconfig
```kconfig
# Copyright (c) 2026 The Zephyr Project Contributors
# SPDX-License-Identifier: Apache-2.0

if BOARD_M5STACK_PAPER_COLOR_ESP32S3_PROCPU

config INPUT
	default y

config GPIO_HOGS_INIT_PRIORITY
	default 83 if GPIO_HOGS

config MIPI_DBI_INIT_PRIORITY
	default 84 if MIPI_DBI

config DISPLAY_INIT_PRIORITY
	default 85 if DISPLAY

endif # BOARD_M5STACK_PAPER_COLOR_ESP32S3_PROCPU
```

## boards/m5stack/m5stack_papercolor/Kconfig
```kconfig
# Copyright (c) 2026 Benjamin Cabé <benjamin@zephyrproject.org>
# SPDX-License-Identifier: Apache-2.0

config HEAP_MEM_POOL_ADD_SIZE_BOARD
	int
	default 4096 if BOARD_M5STACK_PAPERCOLOR_ESP32S3_PROCPU
	default 256 if BOARD_M5STACK_PAPERCOLOR_ESP32S3_APPCPU
```

## boards/m5stack/m5stack_papercolor/Kconfig.defconfig
```kconfig
# M5Stack PaperColor board defconfig
# Copyright (c) 2026 Benjamin Cabé <benjamin@zephyrproject.org>
# SPDX-License-Identifier: Apache-2.0

if BOARD_M5STACK_PAPERCOLOR_ESP32S3_PROCPU

config INPUT
	default y if DT_HAS_GPIO_KEYS_ENABLED

endif # BOARD_M5STACK_PAPERCOLOR_ESP32S3_PROCPU
```

## boards/m5stack/m5stack_papercolor/Kconfig.m5stack_papercolor
```kconfig
# M5Stack PaperColor board configuration
# Copyright (c) 2026 Benjamin Cabé <benjamin@zephyrproject.org>
# SPDX-License-Identifier: Apache-2.0

config BOARD_M5STACK_PAPERCOLOR
	select SOC_ESP32S3
	select SOC_ESP32S3_PROCPU if BOARD_M5STACK_PAPERCOLOR_ESP32S3_PROCPU
	select SOC_ESP32S3_APPCPU if BOARD_M5STACK_PAPERCOLOR_ESP32S3_APPCPU
```

## boards/m5stack/m5stack_papercolor/board.yml
```yaml
board:
  name: m5stack_papercolor
  full_name: PaperColor
  vendor: m5stack
  socs:
  - name: esp32s3
```

## boards/m5stack/m5stack_stackchan/Kconfig
```kconfig
# M5Stack StackChan board configuration
# Copyright (c) 2024 M5Stack
# SPDX-License-Identifier: Apache-2.0

config HEAP_MEM_POOL_ADD_SIZE_BOARD
	int
	default 4096 if BOARD_M5STACK_STACKCHAN_ESP32S3_PROCPU
```

## boards/m5stack/m5stack_stackchan/Kconfig.defconfig
```kconfig
# M5Stack StackChan board default configuration
# Copyright (c) 2024 M5Stack
# SPDX-License-Identifier: Apache-2.0

if BOARD_M5STACK_STACKCHAN

config BOARD
	default "m5stack_stackchan"

endif # BOARD_M5STACK_STACKCHAN
```

## boards/m5stack/m5stack_stackchan/Kconfig.sysbuild
```kconfig
# Copyright (c) 2024 M5Stack
# SPDX-License-Identifier: Apache-2.0

if BOARD_M5STACK_STACKCHAN

choice BOOTLOADER
	default BOOTLOADER_ESP_IDF
endchoice

choice BOOTLOADER_ESP_IDF_BOOTLOADER
	default BOOTLOADER_ESP_IDF_BOOTLOADER_SECURE_V2
endchoice

endif # BOARD_M5STACK_STACKCHAN
```

## boards/m5stack/m5stack_stackchan/m5stack_stackchan_procpu_defconfig
```kconfig
# SPDX-License-Identifier: Apache-2.0

CONFIG_SOC_SERIES_ESP32S3=y
CONFIG_SOC_ESP32S3_PROCPU=y
CONFIG_BOARD_M5STACK_STACKCHAN=y

CONFIG_MAIN_STACK_SIZE=2048
CONFIG_ENTROPY_GENERATOR=y

CONFIG_CONSOLE=y
CONFIG_SERIAL=y
CONFIG_UART_CONSOLE=y

CONFIG_GPIO=y

# Enable I2C
CONFIG_I2C=y

# Enable SPI
CONFIG_SPI=y

# Enable display
CONFIG_DISPLAY=y
CONFIG_MIPI_DBI=y

# Enable touch screen
CONFIG_INPUT=y

# Enable RTC
CONFIG_RTC=y

# Enable PWM (for servo control)
CONFIG_PWM=y

# Enable watchdog
CONFIG_WATCHDOG=y

# Enable Espressif HAL
CONFIG_ESP_SPIRAM=y
```

## boards/m5stack/stackchan/Kconfig.stackchan
```kconfig
# M5Stack StackChan board configuration

# Copyright (c) 2025 Benjamin Cabé <benjamin@zephyrproject.org>
# SPDX-License-Identifier: Apache-2.0

config BOARD_STACKCHAN
	select SOC_ESP32S3
	select SOC_ESP32S3_PROCPU if BOARD_STACKCHAN_ESP32S3_PROCPU
	select SOC_ESP32S3_APPCPU if BOARD_STACKCHAN_ESP32S3_APPCPU
```
