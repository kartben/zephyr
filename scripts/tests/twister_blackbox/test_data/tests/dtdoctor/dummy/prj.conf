## CMakeLists.txt
```
# SPDX-License-Identifier: Apache-2.0

cmake_minimum_required(VERSION 3.20.0)
find_package(Zephyr REQUIRED HINTS $ENV{ZEPHYR_BASE})
project(dtdoctor_blackbox)

target_sources(app PRIVATE src/main.c)
```

## prj.conf
```kconfig
# Intentionally empty: the build should fail from DEVICE_DT_GET() diagnostics.
```

## disabled.overlay
```dts
/ {
	dtdoctor_target: dtdoctor_target {
		compatible = "zephyr,user";
		status = "disabled";
	};
};
```

## no_driver.overlay
```dts
/ {
	dtdoctor_target: dtdoctor_target {
		compatible = "pcie-controller";
		#address-cells = <1>;
		#size-cells = <1>;
		ranges;
		status = "okay";
	};
};
```

## src/main.c
```c
/*
 * Copyright (c) 2026
 *
 * SPDX-License-Identifier: Apache-2.0
 */

#include <zephyr/device.h>
#include <zephyr/devicetree.h>

/*
 * Force a __device_dts_ord_* reference so DT Doctor can diagnose build failures.
 */
static const struct device *const dtdoctor_dev = DEVICE_DT_GET(DT_NODELABEL(dtdoctor_target));

int main(void)
{
	return device_is_ready(dtdoctor_dev) ? 0 : 0;
}
```
