## modules/Kconfig.microchip
```kconfig
# Microchip MEC HAL drivers configuration

# SPDX-License-Identifier: Apache-2.0

zephyr-module = HAL_MICROCHIP
zephyr-module-str = hal_microchip
source "modules/Kconfig.template.module"

config HAS_MEC_HAL
	bool "Microchip MEC HAL drivers support"
	select ZEPHYR_HAL_MICROCHIP_MODULE_ACTIVE

config HAS_MPFS_HAL
	bool "Microchip MPFS HAL drivers support"
	select ZEPHYR_HAL_MICROCHIP_MODULE_ACTIVE

config HAS_MEC5_HAL
	bool "Microchip MEC5 HAL drivers support"
	select ZEPHYR_HAL_MICROCHIP_MODULE_ACTIVE

config MICROCHIP_PIC32C
	bool
	select ZEPHYR_HAL_MICROCHIP_MODULE_ACTIVE

config MICROCHIP_SAM
	bool
	select ZEPHYR_HAL_MICROCHIP_MODULE_ACTIVE
```

## modules/Kconfig.nrf_hw_models
```kconfig
# BabbleSim nRF hardware models configuration

# SPDX-FileCopyrightText: Copyright The Zephyr Project Contributors
# SPDX-License-Identifier: Apache-2.0

zephyr-module = NRF_HW_MODELS
zephyr-module-str = nrf_hw_models
source "modules/Kconfig.template.module"

config ZEPHYR_NRF_HW_MODELS_MODULE_ACTIVE
	depends on ZEPHYR_NRF_HW_MODELS_MODULE
	select ZEPHYR_HAL_NORDIC_MODULE_ACTIVE
	help
	  Simulated nRF peripherals for the BabbleSim boards. The models are
	  built against the nRF HAL, which the module.yml also records.
```

## modules/Kconfig.picolibc
```kconfig
# Copyright 2023 Google LLC
# SPDX-License-Identifier: Apache-2.0

zephyr-module = PICOLIBC
zephyr-module-str = picolibc
source "modules/Kconfig.template.module"
```

## modules/Kconfig.syst
```kconfig
# Copyright (c) 2019 Intel Corporation
# SPDX-License-Identifier: Apache-2.0

zephyr-module = MIPI_SYS_T
zephyr-module-str = mipi-sys-t
source "modules/Kconfig.template.module"

config MIPI_SYST_LIB
	bool "MIPI SyS-T Library Support"
	select ZEPHYR_MIPI_SYS_T_MODULE_ACTIVE
	help
	  This option enables the MIPI SyS-T Library

if MIPI_SYST_LIB

config MIPI_SYST_STP
	bool "STP Transport Layer for MIPI SyS-T"
	help
	  This option enables support for the STP
	  Transport Layer for MIPI SyS-T

config MIPI_SYST_RAW_DATA
	bool "output MIPI SyS-T raw data packet"
	help
	  This option outputs MIPI SyS-T raw data packet

config MIPI_SYST_NO_WHCAR
	bool
	default y if MINIMAL_LIBC
	help
	  Tell MIPI Sys-T library to not build with
	  wchar support.

endif
```

## modules/Kconfig.telink
```kconfig
# Copyright (c) 2021 Telink Semiconductor
# SPDX-License-Identifier: Apache-2.0

zephyr-module = HAL_TELINK
zephyr-module-str = hal_telink
source "modules/Kconfig.template.module"

config HAS_TELINK_DRIVERS
	bool "Telink Drivers"
	select ZEPHYR_HAL_TELINK_MODULE_ACTIVE
	help
	  This option enables Telink Drivers APIs.
```

## modules/Kconfig.xenlib
```kconfig
# zephyr-xenlib configuration

# SPDX-FileCopyrightText: Copyright The Zephyr Project Contributors
# SPDX-License-Identifier: Apache-2.0

zephyr-module = XENLIB
zephyr-module-str = xenlib
source "modules/Kconfig.template.module"
```

## modules/Kconfig.xtensa
```kconfig
# Copyright (c) 2019 Intel Corporation
# SPDX-License-Identifier: Apache-2.0

zephyr-module = XTENSA
zephyr-module-str = xtensa
source "modules/Kconfig.template.module"

config XTENSA_HAL
	bool
	select ZEPHYR_XTENSA_MODULE_ACTIVE
	help
	  Build the Xtensa HAL module during build process.
	  This is selected by the Xtensa ARCH kconfig automatically.
```

## modules/acpica/Kconfig
```kconfig
# Copyright (c) 2023 Intel Corporation.
# SPDX-License-Identifier: Apache-2.0

zephyr-module = ACPICA
zephyr-module-str = acpica
source "modules/Kconfig.template.module"

menu "ACPI driver support"

config ACPI
	bool
	select ZEPHYR_ACPICA_MODULE_ACTIVE

if ACPI

config ACPI_DSDT_SUPPORT
	bool  "Build source code for DSDT ACPICA support"
	default y if PCIE
	help
	  Build source code for DSDT support

endif #ACPI

endmenu
```

## modules/cmsis/Kconfig
```kconfig
# Copyright (c) 2016 Intel Corporation
# SPDX-License-Identifier: Apache-2.0

zephyr-module = CMSIS
zephyr-module-str = cmsis
source "modules/Kconfig.template.module"

config HAS_CMSIS_CORE
	bool
	select HAS_CMSIS_CORE_A if CPU_AARCH32_CORTEX_A
	select HAS_CMSIS_CORE_R if CPU_AARCH32_CORTEX_R
	select ZEPHYR_CMSIS_MODULE_ACTIVE if CPU_AARCH32_CORTEX_A || CPU_AARCH32_CORTEX_R

if HAS_CMSIS_CORE

config HAS_CMSIS_CORE_A
	bool

config HAS_CMSIS_CORE_R
	bool

endif
```

## modules/dhara/Kconfig
```kconfig
# Copyright (c) 2025 Endress+Hauser GmbH+Co. KG
# SPDX-License-Identifier: Apache-2.0

zephyr-module = DHARA
zephyr-module-str = dhara
source "modules/Kconfig.template.module"
```

## modules/edge264/Kconfig
```kconfig
# Copyright The Zephyr Project Contributors
# SPDX-License-Identifier: Apache-2.0

config EDGE264
	bool "edge264 H.264 decoder library"
	help
	  Build the edge264 software H.264/AVC decoder. Requires the
	  edge264 west module (modules/lib/edge264 after west update).
	  On Cortex-M the portable Clang-vector backend is used, with
	  GCC fallbacks for the vector builtins.

if EDGE264

config EDGE264_HEAP_SIZE
	int "edge264 decoder heap size in bytes"
	default 2097152
	help
	  Heap used for the decoder context and reconstructed frames.

config EDGE264_HEAP_ZEPHYR_REGION
	bool "Place the edge264 heap in a Zephyr memory-region"
	help
	  Place the decoder heap in a linker section named by
	  EDGE264_HEAP_ZEPHYR_REGION_NAME.

config EDGE264_HEAP_ZEPHYR_REGION_NAME
	string "Name of the zephyr memory-region for the edge264 heap"
	depends on EDGE264_HEAP_ZEPHYR_REGION
	help
	  Linker section name of a 'zephyr,memory-region' node, for example
	  PSRAM on stm32n6570_dk.

endif # EDGE264
```

## modules/hal_afbr/Kconfig
```kconfig
# Copyright (c) 2025 Croxel Inc.
# Copyright (c) 2025 CogniPilot Foundation
# SPDX-License-Identifier: Apache-2.0

zephyr-module = HAL_AFBR
zephyr-module-str = hal_afbr
source "modules/Kconfig.template.module"

config AFBR_LIB
	bool
	select ZEPHYR_HAL_AFBR_MODULE_ACTIVE
```

## modules/hal_ambiq/Kconfig
```kconfig
# SPDX-License-Identifier: Apache-2.0
#
# Copyright (c) 2023 Antmicro <www.antmicro.com>
# Copyright (c) 2025, Ambiq Micro Inc. <www.ambiq.com>

zephyr-module = HAL_AMBIQ
zephyr-module-str = hal_ambiq
source "modules/Kconfig.template.module"

rsource "Kconfig.hal"
rsource "Kconfig.components"
```

## modules/hal_nxp/Kconfig
```kconfig
#
# Copyright (c) 2021 Linaro, Limited
# Copyright 2025 NXP
#
# SPDX-License-Identifier: Apache-2.0


zephyr-module = HAL_NXP
zephyr-module-str = hal_nxp
source "modules/Kconfig.template.module"

rsource "imx/Kconfig.imx"
rsource "s32/Kconfig.nxp_s32"
rsource "mcux/Kconfig.mcux"
```

## modules/hal_realtek/Kconfig
```kconfig
# Copyright (c) 2026 Realtek Semiconductor Corp.
# SPDX-License-Identifier: Apache-2.0

config ZEPHYR_HAL_REALTEK_MODULE
	bool

config HAS_REALTEK_BEE
	bool
	depends on ZEPHYR_HAL_REALTEK_MODULE

config HAS_REALTEK_AMEBA
	bool
	depends on ZEPHYR_HAL_REALTEK_MODULE

config ZEPHYR_HAL_REALTEK_MODULE_BLOBS
	bool

if HAS_REALTEK_BEE || HAS_REALTEK_AMEBA
osource "$(ZEPHYR_HAL_REALTEK_MODULE_DIR)/Kconfig"
endif

if HAS_REALTEK_BEE
rsource "bee/Kconfig.bee"
endif

if HAS_REALTEK_AMEBA
rsource "ameba/Kconfig.ameba"
endif
```

## modules/hal_rpi_pico/Kconfig
```kconfig
# Copyright (c) 2021 Yonatan Schachter
# SPDX-License-Identifier: Apache-2.0

config ZEPHYR_HAL_RPI_PICO_MODULE
	bool

config HAS_RPI_PICO
	bool
	depends on ZEPHYR_HAL_RPI_PICO_MODULE

config PICOSDK_USE_UART
	bool
	depends on ZEPHYR_HAL_RPI_PICO_MODULE
	help
	  Use the UART driver from pico-sdk

config PICOSDK_USE_GPIO
	bool
	depends on ZEPHYR_HAL_RPI_PICO_MODULE
	help
	  Use the GPIO driver from pico-sdk

config PICOSDK_USE_FLASH
	bool
	depends on ZEPHYR_HAL_RPI_PICO_MODULE
	help
	  Use the flash driver from pico-sdk

config PICOSDK_USE_PWM
	bool
	depends on ZEPHYR_HAL_RPI_PICO_MODULE
	help
	  Use the PWM driver from pico-sdk

config PICOSDK_USE_ADC
	bool
	depends on ZEPHYR_HAL_RPI_PICO_MODULE
	help
	  Use the ADC driver from pico-sdk

config PICOSDK_USE_DMA
	bool
	depends on ZEPHYR_HAL_RPI_PICO_MODULE
	help
	  Use the DMA driver from pico-sdk

config PICOSDK_USE_PIO
	bool
	select PICOSDK_USE_CLAIM
	depends on ZEPHYR_HAL_RPI_PICO_MODULE
	help
	  Use the PIO driver from pico-sdk

config PICOSDK_USE_CLAIM
	bool
	depends on ZEPHYR_HAL_RPI_PICO_MODULE
	help
	  Use the "claim" driver from pico-sdk

config PICOSDK_USE_TIMER
	bool
	depends on ZEPHYR_HAL_RPI_PICO_MODULE
	help
	  Use the TIMER driver from pico-sdk

config PICOSDK_USE_RTC
	bool
	depends on ZEPHYR_HAL_RPI_PICO_MODULE
	help
	  Use the RTC driver from pico-sdk

config PICOSDK_USE_SHA256
	bool
	depends on ZEPHYR_HAL_RPI_PICO_MODULE
	help
	  Use the SHA-256 driver and utilities from pico-sdk

config PICOSDK_USE_RAND
	bool
	depends on ZEPHYR_HAL_RPI_PICO_MODULE
	help
	  Use the "rand" driver from pico-sdk
```

## modules/hal_wch/Kconfig
```kconfig
#
# Copyright (c) 2024 Dhiru Kholia
#
# SPDX-License-Identifier: Apache-2.0
#

zephyr-module = HAL_WCH
zephyr-module-str = hal_wch
source "modules/Kconfig.template.module"

config HAS_WCH_CH32FUN
	bool
	select ZEPHYR_HAL_WCH_MODULE_ACTIVE
	help
	  The ch32fun headers for WCH SoCs. Selected by the SoC family, whose
	  sources and pinctrl drivers are built against them.
```

## modules/hal_wurthelektronik/Kconfig
```kconfig
# Copyright (c) 2026 Embeint Inc
# SPDX-License-Identifier: Apache-2.0

zephyr-module = HAL_WURTHELEKTRONIK
zephyr-module-str = hal_wurthelektronik
source "modules/Kconfig.template.module"
```

## modules/libsbc/Kconfig
```kconfig
# Copyright (c) 2024 NXP
# SPDX-License-Identifier: Apache-2.0

config ZEPHYR_LIBSBC_MODULE
	bool

config LIBSBC
	bool "libsbc Support"
	depends on ZEPHYR_LIBSBC_MODULE
	help
	  This option enables Low Complexity Subband Codec (SBC)
```

## samples/modules/lvgl/accelerometer_chart/Kconfig
```kconfig
# Copyright (c) 2023 Benjamin Cabé <benjamin@zephyrproject.org>
# SPDX-License-Identifier: Apache-2.0

config SAMPLE_CHART_POINTS_PER_SERIES
	int "Number of points per series"
	default 50
	range 10 200
	help
	  Maximum number of points per series in the accelerometer chart.
	  Warning: More points means more memory usage, and slower rendering!

config SAMPLE_ACCEL_SAMPLING_RATE
	int "Accelerometer sampling rate (Hz)"
	default 50
	range 1 100

config SAMPLE_ACCEL_STREAM
	bool "Stream batches of samples from the sensor FIFO"
	depends on SENSOR_ASYNC_API && SENSOR_CLOCK_SYSTEM
	help
	  Start a FIFO watermark stream with sensor_stream() instead of reading
	  one sample per timer tick, so that every sample the sensor produces
	  ends up in the chart whatever the rendering takes. Falls back to
	  polling at runtime when the driver does not support streaming.

config SAMPLE_ACCEL_STREAM_BATCH_MS
	int "Streaming batch duration (ms)"
	depends on SAMPLE_ACCEL_STREAM
	default 50
	range 10 1000
	help
	  Time span covered by one FIFO batch, i.e. how often the chart
	  receives new points.

source "Kconfig.zephyr"
```

## samples/modules/lvgl/accelerometer_chart/boards/twatch_s3_esp32s3_procpu.conf
```kconfig
# SPDX-FileCopyrightText: Copyright The Zephyr Project Contributors
# SPDX-License-Identifier: Apache-2.0

CONFIG_SENSOR_ASYNC_API=y
CONFIG_SAMPLE_ACCEL_STREAM=y
```
