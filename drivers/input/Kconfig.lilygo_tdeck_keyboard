## drivers/input/Kconfig.lilygo_tdeck_keyboard
```kconfig
# SPDX-FileCopyrightText: Copyright The Zephyr Project Contributors
# SPDX-License-Identifier: Apache-2.0

config INPUT_LILYGO_TDECK_KEYBOARD
	bool "LilyGO T-Deck keyboard input"
	default y
	depends on DT_HAS_LILYGO_TDECK_KEYBOARD_ENABLED
	depends on I2C
	help
	  Enable support for the LilyGO T-Deck keyboard coprocessor over I2C.
```

## drivers/input/Kconfig.sdl
```kconfig
# Copyright (c) 2020 Jabil Inc.
# SPDX-License-Identifier: Apache-2.0

config INPUT_SDL_TOUCH
	bool "SDL event filter for touch panel emulation"
	default y
	depends on DT_HAS_ZEPHYR_INPUT_SDL_TOUCH_ENABLED
	depends on HAS_SDL
	help
	  Enable driver for the SDL mouse event filter.

config INPUT_SDL_KEYBOARD
	bool "SDL keyboard input driver"
	default y
	depends on DT_HAS_ZEPHYR_INPUT_SDL_KEYBOARD_ENABLED
	depends on HAS_SDL
	help
	  Enable driver for SDL keyboard events, mapping SDL key
	  events to Zephyr input subsystem key events.
```

## drivers/input/Kconfig.si12t
```kconfig
# SPDX-FileCopyrightText: Copyright The Zephyr Project Contributors
# SPDX-License-Identifier: Apache-2.0

menuconfig INPUT_SI12T
	bool "Si12T touch sensor"
	default y
	depends on DT_HAS_CSMIC_SI12T_ENABLED
	select I2C
	help
	  Enable driver for Nanjing Zhongke Microelectronics Si12T
	  capacitive touch sensor.

if INPUT_SI12T

config INPUT_SI12T_PERIOD_MS
	int "Sample period"
	depends on !INPUT_SI12T_INTERRUPT
	default 50
	help
	  Sample period in milliseconds when in polling mode.

config INPUT_SI12T_INTERRUPT
	bool "Interrupt"
	help
	  Enable interrupt support (requires GPIO).

endif # INPUT_SI12T
```

## drivers/input/Kconfig.t_deck_keyboard
```kconfig
# SPDX-FileCopyrightText: Copyright The Zephyr Project Contributors
# SPDX-License-Identifier: Apache-2.0

config INPUT_LILYGO_T_DECK_KEYBOARD
	bool "LilyGO T-Deck keyboard driver"
	default y
	depends on DT_HAS_LILYGO_T_DECK_KEYBOARD_ENABLED
	select I2C
	help
	  Enable the driver for the external I2C keyboard controller used on the
	  LilyGO T-Deck.
```

## drivers/mfd/Kconfig.m5pm1
```kconfig
# Copyright (c) 2026 Benjamin Cabé <benjamin@zephyrproject.org>
# SPDX-License-Identifier: Apache-2.0

config MFD_M5PM1
	bool "M5Stack M5PM1 power management IC"
	default y
	depends on DT_HAS_M5STACK_M5PM1_ENABLED
	select I2C
	help
	  Enable the M5Stack M5PM1 multi-function PMIC driver. Sub-functions
	  (regulator, GPIO, etc.) are provided by separate child drivers.
```

## drivers/misc/epson_escpos/Kconfig
```kconfig
# Copyright The Zephyr Project Contributors
# SPDX-License-Identifier: Apache-2.0

config EPSON_ESCPOS
	bool "Epson ESC/POS thermal printer driver"
	default y
	depends on DT_HAS_EPSON_ESCPOS_ENABLED
	select SERIAL
	help
	  Enable driver for Epson ESC/POS compatible thermal printers.
	  These printers are commonly used for receipt printing in
	  point-of-sale systems.

if EPSON_ESCPOS

module = EPSON_ESCPOS
module-str = epson_escpos
source "subsys/logging/Kconfig.template.log_config"

endif # EPSON_ESCPOS
```

## drivers/misc/escp_printer/Kconfig
```kconfig
# Copyright (c) 2025 Zephyr Project
# SPDX-License-Identifier: Apache-2.0

config ESCP_PRINTER
	bool "Epson ESC/P printer driver"
	default y
	depends on DT_HAS_EPSON_ESCP_ENABLED
	depends on SERIAL
	help
	  Enable driver support for Epson ESC/P printers connected via UART.

if ESCP_PRINTER

module = ESCP_PRINTER
module-str = escp_printer
source "subsys/logging/Kconfig.template.log_config"

endif # ESCP_PRINTER
```

## drivers/misc/escpos/Kconfig
```kconfig
# Copyright (c) 2025 Zephyr Project
# SPDX-License-Identifier: Apache-2.0

config ESCPOS
	bool "ESC/POS thermal printer driver"
	default y
	depends on DT_HAS_EPSON_ESCPOS_ENABLED
	depends on SERIAL
	help
	  Enable driver support for ESC/POS thermal printers connected via UART.

if ESCPOS

module = ESCPOS
module-str = escpos
source "subsys/logging/Kconfig.template.log_config"

endif # ESCPOS
```

## drivers/misc/scservo/Kconfig
```kconfig
# SPDX-License-Identifier: Apache-2.0

config SCSERVO
	bool "SCServo serial bus servo driver"
	default y
	depends on DT_HAS_FEETECH_SCSERVO_ENABLED
	depends on SERIAL
	help
	  Enable driver for FeeeTech SCServo (SCSCL/STS series) serial
	  bus servos. These smart servos communicate over a half-duplex
	  UART bus and support position control, velocity control,
	  and feedback (position, temperature, voltage, load).

if SCSERVO

config SCSERVO_INIT_PRIORITY
	int "SCServo driver initialization priority"
	default 90
	help
	  SCServo driver initialization priority. Should be lower than
	  the UART driver priority.

config SCSERVO_TIMEOUT_MS
	int "Default communication timeout in milliseconds"
	default 100
	help
	  Default timeout for servo responses. Increase this value if
	  experiencing communication issues on slower buses.

module = SCSERVO
module-str = scservo
source "subsys/logging/Kconfig.template.log_config"

endif # SCSERVO
```

## drivers/regulator/Kconfig.m5pm1
```kconfig
# Copyright (c) 2026 Benjamin Cabé <benjamin@zephyrproject.org>
# SPDX-License-Identifier: Apache-2.0

config REGULATOR_M5PM1
	bool "M5Stack M5PM1 PMIC regulator driver"
	default y
	depends on DT_HAS_M5STACK_M5PM1_REGULATOR_ENABLED
	select I2C
	select MFD
	help
	  Enable the regulator sub-driver for the M5Stack M5PM1 PMIC.
	  It exposes the DCDC 5V, LDO 3.3V and BOOST 5V (Grove) rails
	  through Zephyr's regulator API.

config REGULATOR_M5PM1_INIT_PRIORITY
	int "M5Stack M5PM1 regulator init priority"
	default 85
	depends on REGULATOR_M5PM1
	help
	  Initialization priority for the M5PM1 regulator children.
	  Must be higher (later) than CONFIG_MFD_INIT_PRIORITY so the
	  PMIC parent is ready first, and lower (earlier) than any
	  consumer that needs a rail at boot.
```

## drivers/sensor/grove/Kconfig
```kconfig
# Drivers configuration options for SeeedStudio Grove Devices

# Copyright (c) 2015 Intel Corporation
# SPDX-License-Identifier: Apache-2.0

config GROVE_SENSORS
	bool "Seeed Grove sensors support"
	default y
	depends on DT_HAS_SEEED_GROVE_LIGHT_ENABLED || DT_HAS_SEEED_GROVE_TEMPERATURE_ENABLED
	help
	  Enable Seeed Grove sensors support.

if GROVE_SENSORS

config GROVE_LIGHT_SENSOR
	bool "Seeed Grove Light Sensor"
	default y
	depends on DT_HAS_SEEED_GROVE_LIGHT_ENABLED
	depends on ADC && !MINIMAL_LIBC
	help
	  Enable driver for the Grove Light Sensor.

config GROVE_TEMPERATURE_SENSOR
	bool "Seeed Grove Temperature Sensor"
	default y
	depends on DT_HAS_SEEED_GROVE_TEMPERATURE_ENABLED
	depends on ADC && !MINIMAL_LIBC
	help
	  Enable driver for the Grove Temperature Sensor.

config GROVE_MULTICHANNEL_GAS_SENSOR_V2
	bool "Seeed Grove Multichannel Gas Sensor V2"
	default y
	depends on DT_HAS_SEEED_GROVE_MULTICHANNEL_GAS_V2_ENABLED
	depends on I2C && !MINIMAL_LIBC
	help
	  Enable driver for the Grove Multichannel Gas Sensor V2.

endif # GROVE_SENSORS
```

## drivers/sensor/seeed/Kconfig
```kconfig
# Copyright (c) 2024 Analog Devices, Inc.
# SPDX-License-Identifier: Apache-2.0

# zephyr-keep-sorted-start
source "drivers/sensor/seeed/grove/Kconfig"
source "drivers/sensor/seeed/hm330x/Kconfig"
source "drivers/sensor/seeed/mr60bha2/Kconfig"
# zephyr-keep-sorted-stop
```

## drivers/sensor/seeed/mr60bha2/Kconfig
```kconfig
# SPDX-FileCopyrightText: Copyright The Zephyr Project Contributors
# SPDX-License-Identifier: Apache-2.0

config MR60BHA2
	bool "Seeed Studio MR60BHA2 60 GHz mmWave breathing and heartbeat sensor"
	default y
	depends on DT_HAS_SEEED_MR60BHA2_ENABLED
	depends on UART_INTERRUPT_DRIVEN
	select UART
	help
	  Enable driver for the Seeed Studio MR60BHA2 60 GHz mmWave UART radar
	  that reports human presence, breathing rate, and heartbeat rate.

config MR60BHA2_UART_TIMEOUT_MS
	int "UART frame collection timeout in milliseconds"
	default 500
	depends on MR60BHA2
	help
	  Duration for which UART RX is enabled during sample_fetch to collect
	  multiple frame types from the continuously-streaming sensor. The sensor
	  outputs all frame categories at roughly 10 Hz, so 500 ms is sufficient
	  to receive a complete data set. The semaphore is signalled as soon as
	  all three key frame types (presence, breathing rate, heartbeat rate)
	  are received, so the actual wait is usually much shorter.
```

## dts/bindings/adc/m5stack,m5pm1-adc.yaml
```yaml
# Copyright (c) 2026 The Zephyr Project Contributors
# SPDX-License-Identifier: Apache-2.0

description: M5Stack M5PM1 ADC

compatible: "m5stack,m5pm1-adc"

include: adc-controller.yaml

on-bus: m5pm1

properties:
  "#io-channel-cells":
    const: 1

io-channel-cells:
  - input
```

## dts/bindings/audio/chipsourcetek,ns4168.yaml
```yaml
# Copyright (c) 2024 Arduino SA
# SPDX-License-Identifier: Apache-2.0

description: ChipSourceTek NS4168 mono I2S Class-D amplifier

compatible: "chipsourcetek,ns4168"

include: base.yaml

properties:
  enable-gpios:
    type: phandle-array
    description: |
      GPIO connected to the CTRL pin of the NS4168. The CTRL pin enables
      normal amplifier operation when driven high and puts the device into
      shutdown when driven low.
```

## dts/bindings/audio/espressif,esp32-dmic.yaml
```yaml
# Copyright (c) 2026 Espressif Systems (Shanghai) PTE LTD
# SPDX-License-Identifier: Apache-2.0

description: ESP32 DMIC frontend using an I2S controller in RX mode

compatible: "espressif,esp32-dmic"

include: base.yaml

on-bus: i2s
```

## dts/bindings/audio/espressif,esp32-i2s-pdm-dmic.yaml
```yaml
# Copyright (c) 2025 Espressif Systems (Shanghai) CO LTD
# SPDX-License-Identifier: Apache-2.0

description: |
  ESP32 I2S peripheral in PDM RX mode with hardware PDM-to-PCM decimation.

  Use this compatible on an existing I2S controller node (for example i2s0) via a
  board overlay. Do not enable the espressif,esp32-i2s driver on the same node.

  On ESP32-S3 and ESP32-P4, hardware PDM-to-PCM is only available on I2S unit 0.

  On ESP32 (I2S HW v1), the PDM bit clock is output on the I2S WS signal. Board
  pinctrl must use an I2S ``*_WS`` pinmux for the clock GPIO (not ``*_BCK``), as
  used by the M5StickC Plus built-in SPM1423 microphone (GPIO0 = CLK, GPIO34 = DATA).

compatible: "espressif,esp32-i2s-pdm-dmic"

include: [base.yaml, pinctrl-device.yaml]

properties:
  reg:
    required: true

  pinctrl-0:
    required: true

  pinctrl-names:
    required: true

  clocks:
    required: true

  interrupts:
    required: true

  interrupt-parent:
    required: true

  unit:
    type: int
    required: true
    description: I2S unit number (0 or 1 depending on SoC).

  queue-size:
    type: int
    default: 4
    description: Number of completed RX buffers queued for dmic_read().

  dmas:
    description: Optional GDMA channel for RX (required on GDMA-capable SoCs).

  dma-names:
    description: Must include "rx" when dmas is present.

child-binding:
  description: Optional PDM microphone configuration
  include: ["pdm-dmic.yaml"]
```

## dts/bindings/audio/espressif,esp32-i2s-pdm.yaml
```yaml
# Copyright (c) 2026 Espressif Systems (Shanghai) Co., Ltd.
# SPDX-License-Identifier: Apache-2.0

description: |
  ESP32 I2S peripheral in PDM RX mode (digital microphone).

  This compatible binds the ESP32 I2S controller to Zephyr's DMIC API so an
  attached PDM microphone can be read through dmic_configure() /
  dmic_trigger() / dmic_read(). The same I2S controller cannot also be
  exposed via the "espressif,esp32-i2s" compatible at the same time - select
  one compatible per instance in an overlay.

compatible: "espressif,esp32-i2s-pdm"

include: ["base.yaml", "pinctrl-device.yaml"]

properties:
  reg:
    required: true

  clocks:
    required: true

  interrupts:
    required: true

  interrupt-parent:
    required: true

  pinctrl-0:
    required: true

  pinctrl-names:
    required: true

  unit:
    type: int
    required: true
    description: I2S unit index (0 or 1 depending on the SoC).

  dmas:
    description: |
      GDMA RX channel, required on SoCs that expose the
      "espressif,esp32-gdma" controller (ESP32-S3/C3/C5/C6/H2/...).

  dma-names:
    description: |
      Must contain "rx" when "dmas" is set.
```

## dts/bindings/auxdisplay/newhaven,nhd-k3z-common.yaml
```yaml
# Copyright (c) 2026
# SPDX-License-Identifier: Apache-2.0

description: |
  Newhaven NHD K3Z family serial character OLED displays.

  This binding models the transport-facing module interface used by K3Z variants,
  where geometry is configurable through generic `rows` and `columns` properties.

include: auxdisplay-device.yaml

properties:
  command-delay-us:
    type: int
    default: 40
    description: Delay in microseconds to wait after each command write.

  clear-delay-ms:
    type: int
    default: 2
    description: Delay in milliseconds to wait after a clear command.
```

## dts/bindings/auxdisplay/newhaven,nhd-k3z-i2c.yaml
```yaml
# Copyright (c) 2026
# SPDX-License-Identifier: Apache-2.0

description: Newhaven NHD K3Z family serial character OLED displays on I2C bus

compatible: "newhaven,nhd-k3z"

include: [i2c-device.yaml, newhaven,nhd-k3z-common.yaml]
```

## dts/bindings/auxdisplay/newhaven,nhd-k3z-spi.yaml
```yaml
# Copyright (c) 2026
# SPDX-License-Identifier: Apache-2.0

description: Newhaven NHD K3Z family serial character OLED displays on SPI bus

compatible: "newhaven,nhd-k3z"

include: [spi-device.yaml, newhaven,nhd-k3z-common.yaml]
```

## dts/bindings/auxdisplay/newhaven,nhd-k3z-uart.yaml
```yaml
# Copyright (c) 2026
# SPDX-License-Identifier: Apache-2.0

description: Newhaven NHD K3Z family serial character OLED displays on UART bus

compatible: "newhaven,nhd-k3z"

include: [uart-device.yaml, newhaven,nhd-k3z-common.yaml]
```

## dts/bindings/auxdisplay/newhaven,serial-character-lcd-common.yaml
```yaml
# Copyright (c) 2026
# SPDX-License-Identifier: Apache-2.0

description: |
  Newhaven serial character LCD modules with the Newhaven PIC serial bridge.

  This binding is intended for the serial character LCD family that shares the
  same command protocol across multiple mechanical variants, for example:

    - NHD-0216K3Z-*
    - NHD-0220D3Z-*
    - NHD-0420D3Z-*

  Use the columns, rows, and optional line-addresses properties to describe the
  attached module geometry.

include: [auxdisplay-device.yaml]

properties:
  line-addresses:
    type: uint8-array
    default: [0x00, 0x40, 0x14, 0x54]
    description: |
      DDRAM start address for each row. The default matches the standard
      HD44780-compatible layout used by common 1x, 2x, and 4x modules.

  contrast-levels:
    type: int
    default: 50
    description: Maximum supported contrast level.

  default-contrast:
    type: int
    default: 40
    description: Contrast level programmed during driver initialization.

  backlight-levels:
    type: int
    default: 8
    description: Maximum supported backlight brightness level.

  default-backlight-brightness:
    type: int
    default: 8
    description: Backlight brightness level programmed during driver initialization.

  boot-delay-ms:
    type: int
    default: 100
    description: |
      Delay after power-up before the first command is sent. The default matches
      the PIC bridge startup time documented by Newhaven.
```

## dts/bindings/auxdisplay/newhaven,serial-character-lcd-i2c.yaml
```yaml
# Copyright (c) 2026
# SPDX-License-Identifier: Apache-2.0

title: Newhaven serial character LCD on I2C

compatible: "newhaven,serial-character-lcd"

include: ["newhaven,serial-character-lcd-common.yaml", i2c-device.yaml]
```

## dts/bindings/auxdisplay/newhaven,serial-character-lcd-spi.yaml
```yaml
# Copyright (c) 2026
# SPDX-License-Identifier: Apache-2.0

title: Newhaven serial character LCD on SPI

compatible: "newhaven,serial-character-lcd"

include: ["newhaven,serial-character-lcd-common.yaml", spi-device.yaml]

description: |
  Newhaven serial character LCD modules using the SPI serial bridge interface.
  These modules use SPI mode 3.
```
