## CMakeLists.txt
```
# Copyright (c) 2026 zenbedded contributors
# SPDX-License-Identifier: Apache-2.0

cmake_minimum_required(VERSION 3.20.0)

get_filename_component(ZENBEDDED_ROOT "${CMAKE_CURRENT_SOURCE_DIR}/../.." ABSOLUTE)
list(APPEND ZEPHYR_EXTRA_MODULES "${ZENBEDDED_ROOT}")

find_package(Zephyr REQUIRED HINTS $ENV{ZEPHYR_BASE})
project(zenbedded_control_test LANGUAGES C)

target_sources(app PRIVATE
  src/test_common.c
  src/test_joint_table.c
  src/test_setpoint.c
  src/test_state_machine.c
  src/test_park.c
  src/test_resume.c
  src/test_hist.c
)
```

## prj.conf
```kconfig
# Copyright (c) 2026 zenbedded contributors
# SPDX-License-Identifier: Apache-2.0

CONFIG_ZTEST=y
CONFIG_ZTEST_STACK_SIZE=8192

CONFIG_ZENBEDDED=y
CONFIG_ZENBEDDED_PLANT_SIM=y

# These tests drive zb_control_step() directly, in virtual time, rather than
# starting the 1 kHz thread and racing it. Deterministic results are what makes
# asserting on exact failover thresholds worth anything.
CONFIG_ZENBEDDED_CONTROL_AUTOSTART=n

CONFIG_FPU=y
CONFIG_HEAP_MEM_POOL_SIZE=0
CONFIG_TIMING_FUNCTIONS=y
CONFIG_SYS_CLOCK_TICKS_PER_SEC=10000

# The threaded setpoint fuzz test needs the producer and consumer to actually
# interleave.
CONFIG_TIMESLICING=y
CONFIG_TIMESLICE_SIZE=1

CONFIG_ASSERT=y
```

## app.overlay
```dts
/*
 * Copyright (c) 2026 zenbedded contributors
 *
 * SPDX-License-Identifier: Apache-2.0
 *
 * The joint topology. Board-independent: with the simulated plant backend the
 * joint needs no board resources at all, and Phase 4 adds the motor/encoder
 * phandles in a board overlay rather than changing anything here.
 *
 * Adding a second joint is an edit to this file and a rebuild. There is no C to
 * touch: the joint table is generated from these nodes at compile time.
 * (Per SPEC.md, that wait is deliberate — one joint until Phase 4 passes.)
 */

/ {
	robot: robot {
		compatible = "zenbedded,robot";
		robot-id = "arm0";

		joint0: joint0 {
			compatible = "zenbedded,revolute-joint";
			joint-name = "shoulder";
			status = "okay";

			limit-lo-mrad = <(-1570)>;
			limit-hi-mrad = <1570>;
			max-effort-mnm = <400>;
			hold-effort-mnm = <150>;

			pid-kp-milli = <1200>;
			pid-ki-milli = <80>;
			pid-kd-milli = <45>;
		};
	};
};
```

## src/test_common.c
```c
/*
 * Copyright (c) 2026 zenbedded contributors
 *
 * SPDX-License-Identifier: Apache-2.0
 */

#include <math.h>

#include <zephyr/kernel.h>

#include "test_common.h"

void zb_test_init(struct zb_test_ctx *t, float start_pos)
{
	zb_plant_init();
	zb_plant_sim_set_state(ZB_TEST_JOINT, start_pos, 0.0f);
	zb_joint_rt_init(&t->rt, ZB_TEST_JOINT);

	t->now_us = 0;
	t->seq = 0;
	t->prev_effort = 0.0f;
	t->prev_velocity = 0.0f;
	t->have_prev = false;

	zb_test_continuity_reset(t);
}

void zb_test_continuity_reset(struct zb_test_ctx *t)
{
	/*
	 * Zero the maxima but keep the previous sample, so that the very first
	 * step after this call is still measured against the state the joint
	 * was actually in. Clearing prev_* here would silently swallow exactly
	 * the jump a caller is trying to measure.
	 */
	t->max_effort_jump = 0.0f;
	t->max_velocity_jump = 0.0f;
}

void zb_test_step(struct zb_test_ctx *t, uint32_t n)
{
	for (uint32_t i = 0; i < n; i++) {
		t->now_us += ZB_TEST_PERIOD_US;
		zb_control_step(&t->rt, ZB_TEST_JOINT, t->now_us, ZB_TEST_DT);

		if (t->have_prev) {
			float de = fabsf(t->rt.effort - t->prev_effort);
			float dv = fabsf(t->rt.velocity - t->prev_velocity);

			if (de > t->max_effort_jump) {
				t->max_effort_jump = de;
			}
			if (dv > t->max_velocity_jump) {
				t->max_velocity_jump = dv;
			}
		}

		t->prev_effort = t->rt.effort;
		t->prev_velocity = t->rt.velocity;
		t->have_prev = true;
	}
}

void zb_test_cmd(struct zb_test_ctx *t, float position)
{
	struct zb_setpoint sp = {
		.seq = ++t->seq,
		.position = position,
		.velocity = 0.0f,
		.arrival_cycles = k_cycle_get_64(),
	};

	zb_sp_publish(&t->rt.sp, &sp);
}

void zb_test_step_commanding(struct zb_test_ctx *t, uint32_t n, float position,
			     uint32_t every_steps)
{
	for (uint32_t i = 0; i < n; i++) {
		if ((i % every_steps) == 0U) {
			zb_test_cmd(t, position);
		}
		zb_test_step(t, 1);
	}
}
```

## src/test_common.h
```c
/*
 * Copyright (c) 2026 zenbedded contributors
 *
 * SPDX-License-Identifier: Apache-2.0
 */

#ifndef ZB_TEST_COMMON_H_
#define ZB_TEST_COMMON_H_

#include <stdint.h>

#include <zenbedded/control.h>
#include <zenbedded/joint.h>
#include <zenbedded/plant.h>

/** The joint under test. Phase 1 populates exactly one. */
#define ZB_TEST_JOINT 0

#define ZB_TEST_PERIOD_US ((uint64_t)CONFIG_ZENBEDDED_CONTROL_PERIOD_US)
#define ZB_TEST_DT        ((float)CONFIG_ZENBEDDED_CONTROL_PERIOD_US * 1e-6f)

/** Control steps in @p ms milliseconds. */
#define ZB_TEST_STEPS_MS(ms) ((uint32_t)(((uint64_t)(ms) * 1000ULL) / ZB_TEST_PERIOD_US))

/**
 * @brief Harness that drives the control core in virtual time.
 *
 * The control step is a plain function of state and inputs, so the tests call
 * it directly rather than starting the 1 kHz thread and racing it. Every result
 * here is bit-identical run to run, which is what makes a threshold test worth
 * asserting on.
 */
struct zb_test_ctx {
	struct zb_joint_rt rt;
	uint64_t now_us;
	uint32_t seq;

	/* Continuity tracking, updated on every step. */
	float prev_effort;
	float prev_velocity;
	float max_effort_jump;
	float max_velocity_jump;
	bool have_prev;
};

/** Reset plant and controller, placing the joint at @p start_pos at rest. */
void zb_test_init(struct zb_test_ctx *t, float start_pos);

/** Run @p n control steps, advancing virtual time. */
void zb_test_step(struct zb_test_ctx *t, uint32_t n);

/** Publish a position command, as the comms thread would. */
void zb_test_cmd(struct zb_test_ctx *t, float position);

/**
 * @brief Zero the continuity maxima so a later window can be measured alone.
 *
 * The previous sample is kept, so the first step after this call is still
 * compared against the state the joint was in when it was called.
 */
void zb_test_continuity_reset(struct zb_test_ctx *t);

/**
 * @brief Run @p n steps while commanding @p position every @p every_ms.
 *
 * Stands in for a healthy host publishing at ~100 Hz.
 */
void zb_test_step_commanding(struct zb_test_ctx *t, uint32_t n, float position,
			     uint32_t every_steps);

#endif /* ZB_TEST_COMMON_H_ */
```

## src/test_hist.c
```c
/*
 * Copyright (c) 2026 zenbedded contributors
 *
 * SPDX-License-Identifier: Apache-2.0
 */

#include <zephyr/ztest.h>

#include <zenbedded/hist.h>

#include "test_common.h"

static struct zb_hist h;

static void hist_before(void *f)
{
	ARG_UNUSED(f);
	zb_hist_reset(&h);
}

ZTEST_SUITE(zb_hist, NULL, NULL, hist_before, NULL, NULL);

ZTEST(zb_hist, test_empty)
{
	zassert_equal(h.count, 0U);
	zassert_equal(h.overruns, 0U);
	zassert_equal(zb_hist_percentile(&h, 500U), 0U, "an empty histogram has no p50");
}

ZTEST(zb_hist, test_buckets_derive_from_configured_period)
{
	/*
	 * Edges are ratios to the control period, not absolute microseconds, so
	 * retuning the loop rate moves them with it.
	 */
	uint32_t period = CONFIG_ZENBEDDED_CONTROL_PERIOD_US;

	zassert_equal(zb_hist_bucket_edge_us(0), period / 2U, "first edge is 0.5x period");
	zassert_equal(zb_hist_bucket_edge_us(5), period, "the target period is an edge");
	zassert_equal(zb_hist_bucket_edge_us(ZB_HIST_BUCKETS - 1), UINT32_MAX,
		      "the top bucket is open-ended");

	/* Edges must be strictly increasing or percentiles are meaningless. */
	for (uint32_t i = 1; i < ZB_HIST_BUCKETS; i++) {
		zassert_true(zb_hist_bucket_edge_us(i) > zb_hist_bucket_edge_us(i - 1),
			     "bucket edges must increase, broke at %u", i);
	}
}

ZTEST(zb_hist, test_min_max_and_count)
{
	zb_hist_record(&h, 990U);
	zb_hist_record(&h, 1000U);
	zb_hist_record(&h, 1400U);

	zassert_equal(h.count, 3U);
	zassert_equal(h.min_us, 990U);
	zassert_equal(h.max_us, 1400U);
	zassert_equal(h.sum_us, 3390U);
}

ZTEST(zb_hist, test_percentiles_are_conservative)
{
	/* 99 samples on target, one far out in the tail. */
	for (int i = 0; i < 99; i++) {
		zb_hist_record(&h, 1000U);
	}
	zb_hist_record(&h, 9000U);

	uint32_t p50 = zb_hist_percentile(&h, 500U);
	uint32_t p99 = zb_hist_percentile(&h, 990U);
	uint32_t max = h.max_us;

	/* 1000 lands in the [1000, 1020) bucket, whose upper edge is quoted. */
	zassert_equal(p50, 1020U);
	zassert_equal(p99, 1020U, "the single outlier must not move p99");
	zassert_equal(max, 9000U, "but it is visible in max");
	zassert_true(p99 <= max, "percentiles never exceed max");

	/*
	 * The point of reporting these together: p99 and max disagree by almost
	 * 9x here, and either one quoted alone tells a different story.
	 */
	zassert_true(zb_hist_percentile(&h, 999U) >= p99, "p99.9 must not fall below p99");
}

ZTEST(zb_hist, test_overruns_counted_separately)
{
	zb_hist_record(&h, 2000U);
	zb_hist_record_overrun(&h, 1U);
	zb_hist_record_overrun(&h, 3U);

	zassert_equal(h.overruns, 4U);
	zassert_equal(h.count, 1U, "overruns are not samples");
}
```

## src/test_joint_table.c
```c
/*
 * Copyright (c) 2026 zenbedded contributors
 *
 * SPDX-License-Identifier: Apache-2.0
 */

#include <zephyr/ztest.h>

#include "test_common.h"

/*
 * The joint table is the contract between devicetree and the control core. If
 * these break, either a binding changed or a unit conversion is wrong, and
 * every other test in this directory is testing the wrong joint.
 */

ZTEST_SUITE(zb_joint_table, NULL, NULL, NULL, NULL, NULL);

ZTEST(zb_joint_table, test_topology_from_devicetree)
{
	zassert_equal(ZB_JOINT_COUNT, 1, "Phase 1 populates exactly one joint");
	zassert_str_equal(ZB_ROBOT_ID, "arm0");
	zassert_str_equal(zb_joints[ZB_TEST_JOINT].name, "shoulder");
}

ZTEST(zb_joint_table, test_units_converted_from_milli)
{
	const struct zb_joint_cfg *c = &zb_joints[ZB_TEST_JOINT];

	/* Devicetree carries milli-units; the table must hold float SI. */
	zassert_within(c->limit_lo, -1.570f, 1e-6f, "limit-lo-mrad -> rad");
	zassert_within(c->limit_hi, 1.570f, 1e-6f, "limit-hi-mrad -> rad");
	zassert_within(c->max_effort, 0.400f, 1e-6f, "max-effort-mnm -> Nm");
	zassert_within(c->hold_effort, 0.150f, 1e-6f, "hold-effort-mnm -> Nm");
	zassert_within(c->kp, 1.200f, 1e-6f);
	zassert_within(c->ki, 0.080f, 1e-6f);
	zassert_within(c->kd, 0.045f, 1e-6f);
}

ZTEST(zb_joint_table, test_defaults_applied)
{
	const struct zb_joint_cfg *c = &zb_joints[ZB_TEST_JOINT];

	/* Not set in the overlay, so these come from the binding defaults. */
	zassert_within(c->park_target, 0.0f, 1e-6f);
	zassert_within(c->park_rate, 0.300f, 1e-6f);
	zassert_true(c->sim_inertia > 0.0f);
}

ZTEST(zb_joint_table, test_safety_invariants)
{
	const struct zb_joint_cfg *c = &zb_joints[ZB_TEST_JOINT];

	zassert_true(c->hold_effort <= c->max_effort, "hold effort must not exceed max effort");
	zassert_true(c->limit_lo < c->limit_hi);
	zassert_true(c->park_target >= c->limit_lo && c->park_target <= c->limit_hi);
}
```

## src/test_park.c
```c
/*
 * Copyright (c) 2026 zenbedded contributors
 *
 * SPDX-License-Identifier: Apache-2.0
 */

#include <math.h>

#include <zephyr/ztest.h>

#include "test_common.h"

/*
 * PARK is where a joint with no host ends up, so it is the mode that decides
 * whether "the host died" means "the arm settled" or "the arm dropped".
 */

static struct zb_test_ctx t;

/** Raise the joint to @p pos under a healthy host, then go silent. */
static void raise_then_abandon(float pos)
{
	zb_test_init(&t, pos);
	zb_test_cmd(&t, pos);
	zb_test_step(&t, 1);
	zassert_equal(t.rt.mode, ZB_MODE_FOLLOWING);

	zb_test_step_commanding(&t, ZB_TEST_STEPS_MS(1000), pos, ZB_TEST_STEPS_MS(10));
}

ZTEST_SUITE(zb_park, NULL, NULL, NULL, NULL, NULL);

ZTEST(zb_park, test_descent_is_rate_limited)
{
	const struct zb_joint_cfg *c = &zb_joints[ZB_TEST_JOINT];

	raise_then_abandon(1.0f);

	/* Age out into PARK. */
	zb_test_step(&t, ZB_TEST_STEPS_MS(CONFIG_ZENBEDDED_AGE_PARK_MS));
	zassert_equal(t.rt.mode, ZB_MODE_PARK);

	float max_step = c->park_rate * ZB_TEST_DT;
	float worst = 0.0f;
	float prev = t.rt.target;

	for (uint32_t i = 0; i < ZB_TEST_STEPS_MS(8000); i++) {
		zb_test_step(&t, 1);

		float delta = fabsf(t.rt.target - prev);

		if (delta > worst) {
			worst = delta;
		}
		prev = t.rt.target;

		zassert_true(delta <= max_step * 1.001f + 1e-9f,
			     "PARK target moved %f rad in one step, limit is %f rad", (double)delta,
			     (double)max_step);
	}

	TC_PRINT("park: worst target step %f rad (limit %f)\n", (double)worst, (double)max_step);
}

ZTEST(zb_park, test_descent_takes_at_least_the_rate_limited_time)
{
	const struct zb_joint_cfg *c = &zb_joints[ZB_TEST_JOINT];

	raise_then_abandon(1.0f);

	float start = t.rt.position;
	float travel = fabsf(start - c->park_target);
	uint32_t min_ms = (uint32_t)((travel / c->park_rate) * 1000.0f);

	zb_test_step(&t, ZB_TEST_STEPS_MS(CONFIG_ZENBEDDED_AGE_PARK_MS));
	zassert_equal(t.rt.mode, ZB_MODE_PARK);

	/* Halfway through the rate-limited descent it cannot be finished. */
	zb_test_step(&t, ZB_TEST_STEPS_MS(min_ms / 2U));
	zassert_true(fabsf(t.rt.position - c->park_target) > 0.1f,
		     "joint reached park in half the rate-limited time: it fell, it did not "
		     "descend");
	zassert_true(t.rt.driver_enabled, "driver must stay engaged during the descent");
}

ZTEST(zb_park, test_settles_then_disables_the_driver)
{
	const struct zb_joint_cfg *c = &zb_joints[ZB_TEST_JOINT];

	raise_then_abandon(1.0f);

	zb_test_step(&t, ZB_TEST_STEPS_MS(CONFIG_ZENBEDDED_AGE_PARK_MS));
	zb_test_step(&t, ZB_TEST_STEPS_MS(10000));

	zassert_equal(t.rt.mode, ZB_MODE_PARK);
	zassert_true(t.rt.parked, "descent never completed");
	zassert_false(t.rt.driver_enabled, "PARK must end with the driver disabled, coasting");
	zassert_within(t.rt.effort, 0.0f, 1e-9f, "a disabled driver commands no effort");
	zassert_within(t.rt.position, c->park_target, 0.05f, "joint did not come to rest at park");
}

ZTEST(zb_park, test_stays_disabled_once_parked)
{
	raise_then_abandon(1.0f);

	zb_test_step(&t, ZB_TEST_STEPS_MS(CONFIG_ZENBEDDED_AGE_PARK_MS));
	zb_test_step(&t, ZB_TEST_STEPS_MS(10000));
	zassert_true(t.rt.parked);

	/*
	 * The parked state is latched. A joint that drifts a hair after the
	 * driver is cut must not re-energise, chatter, and re-park forever.
	 */
	for (uint32_t i = 0; i < ZB_TEST_STEPS_MS(5000); i++) {
		zb_test_step(&t, 1);
		zassert_false(t.rt.driver_enabled, "driver re-energised after parking, at step %u",
			      i);
	}
}
```

## src/test_resume.c
```c
/*
 * Copyright (c) 2026 zenbedded contributors
 *
 * SPDX-License-Identifier: Apache-2.0
 */

#include <math.h>

#include <zephyr/ztest.h>

#include "test_common.h"

/*
 * The most important tests in the repository.
 *
 * When ros2_control reactivates a hardware interface it will push whatever
 * command was sitting in its buffer. If the joint has spent the last ten
 * seconds sagging to its park position, that buffered command is now half a
 * radian away, and applying it at full gain slams the arm. Everything below
 * exists to prove that cannot happen:
 *
 *   - the MCU refuses a resume command that is not near where it actually is,
 *   - once it accepts one, it ramps the gains rather than snapping to them,
 *   - and across an entire FOLLOWING -> PARK -> resume cycle, neither the
 *     commanded effort nor the joint velocity ever steps discontinuously.
 *
 * A smooth resume is worth more to a robotics audience than the kill itself.
 */

#define ZB_RESUME_EPSILON_RAD ((float)CONFIG_ZENBEDDED_RESUME_EPSILON_MRAD * 1e-3f)

/*
 * Continuity budgets, per 1 ms control step.
 *
 * Scaled off the joint's own effort ceiling rather than written as bare
 * numbers, so retuning the joint in devicetree does not quietly loosen them.
 * A slam looks like effort going to the rail inside one or two steps; these
 * budgets are a small fraction of that.
 */
#define ZB_MAX_EFFORT_STEP_FRAC 0.05f
#define ZB_MAX_VELOCITY_STEP    0.05f /* rad/s per step = 50 rad/s^2 */

static struct zb_test_ctx t;

/** Raise to @p pos under a healthy host, then let it age all the way to parked. */
static void cycle_to_parked(float pos)
{
	zb_test_init(&t, pos);
	zb_test_cmd(&t, pos);
	zb_test_step(&t, 1);
	zb_test_step_commanding(&t, ZB_TEST_STEPS_MS(1000), pos, ZB_TEST_STEPS_MS(10));
	zassert_equal(t.rt.mode, ZB_MODE_FOLLOWING);

	/* Host dies. */
	zb_test_step(&t, ZB_TEST_STEPS_MS(CONFIG_ZENBEDDED_AGE_PARK_MS));
	zb_test_step(&t, ZB_TEST_STEPS_MS(12000));

	zassert_equal(t.rt.mode, ZB_MODE_PARK);
	zassert_true(t.rt.parked, "joint should be fully parked before the resume tests");
}

ZTEST_SUITE(zb_resume, NULL, NULL, NULL, NULL, NULL);

ZTEST(zb_resume, test_stale_far_command_is_rejected)
{
	cycle_to_parked(1.0f);

	uint32_t rejected_before = t.rt.rejected_cmds;
	uint32_t accepted_before = t.rt.accepted_cmds;

	/* Exactly what ros2_control would flush out of a stale buffer. */
	zb_test_cmd(&t, 1.0f);
	zb_test_step(&t, 1);

	zassert_equal(t.rt.rejected_cmds, rejected_before + 1U,
		      "a stale command far from the current position must be rejected");
	zassert_equal(t.rt.accepted_cmds, accepted_before, "and must not be accepted");
	zassert_equal(t.rt.mode, ZB_MODE_PARK, "a rejected command does not resume the joint");
	zassert_false(t.rt.driver_enabled, "and does not re-energise the driver");
}

ZTEST(zb_resume, test_stale_command_rejected_repeatedly)
{
	cycle_to_parked(1.0f);

	/* A host that keeps retrying the stale value gets nowhere, forever. */
	for (uint32_t i = 0; i < ZB_TEST_STEPS_MS(1000); i++) {
		zb_test_cmd(&t, 1.0f);
		zb_test_step(&t, 1);
		zassert_equal(t.rt.mode, ZB_MODE_PARK, "resumed on a stale command at step %u", i);
	}

	zassert_false(t.rt.driver_enabled);
}

ZTEST(zb_resume, test_command_at_reported_position_resumes)
{
	cycle_to_parked(1.0f);

	/*
	 * What on_activate() is supposed to do: seed the command buffer from
	 * the MCU's *reported* position, never from a cached or default value.
	 */
	float reported = t.rt.position;

	zb_test_cmd(&t, reported);
	zb_test_step(&t, 1);

	zassert_equal(t.rt.mode, ZB_MODE_FOLLOWING, "a command at the reported position resumes");
	zassert_true(t.rt.driver_enabled);
	zassert_true(t.rt.ramping, "resume must start a gain ramp");
	zassert_within(t.rt.gain_scale, 0.0f, 0.05f, "gains must start near zero");
}

ZTEST(zb_resume, test_epsilon_is_the_boundary)
{
	cycle_to_parked(1.0f);

	float reported = t.rt.position;

	/* Just outside the window: refused. */
	zb_test_cmd(&t, reported + ZB_RESUME_EPSILON_RAD * 1.5f);
	zb_test_step(&t, 1);
	zassert_equal(t.rt.mode, ZB_MODE_PARK, "command outside the epsilon window was accepted");

	/* Just inside: accepted. */
	zb_test_cmd(&t, reported + ZB_RESUME_EPSILON_RAD * 0.5f);
	zb_test_step(&t, 1);
	zassert_equal(t.rt.mode, ZB_MODE_FOLLOWING,
		      "command inside the epsilon window was refused");
}

ZTEST(zb_resume, test_gains_ramp_to_full)
{
	cycle_to_parked(1.0f);

	float reported = t.rt.position;

	zb_test_cmd(&t, reported);
	zb_test_step(&t, 1);

	float prev = t.rt.gain_scale;

	/* Monotonic, and complete no sooner than the configured ramp. */
	for (uint32_t i = 0; i < ZB_TEST_STEPS_MS(CONFIG_ZENBEDDED_RESUME_RAMP_MS) - 2U; i++) {
		zb_test_cmd(&t, reported);
		zb_test_step(&t, 1);

		zassert_true(t.rt.gain_scale >= prev, "gain ramp went backwards at step %u", i);
		zassert_true(t.rt.gain_scale <= 1.0f, "gain scale exceeded unity");
		prev = t.rt.gain_scale;
	}

	zassert_true(t.rt.ramping, "ramp finished early");

	zb_test_step_commanding(&t, ZB_TEST_STEPS_MS(50), reported, ZB_TEST_STEPS_MS(10));

	zassert_false(t.rt.ramping, "ramp never finished");
	zassert_within(t.rt.gain_scale, 1.0f, 1e-6f, "gains must return to full");
}

ZTEST(zb_resume, test_full_cycle_has_no_discontinuity)
{
	const struct zb_joint_cfg *c = &zb_joints[ZB_TEST_JOINT];
	float effort_budget = c->max_effort * ZB_MAX_EFFORT_STEP_FRAC;

	/*
	 * The whole story, end to end, with continuity measured across every
	 * step of it: healthy tracking, host death, degrade, hold, park, a
	 * stale command refused, then a correct resume.
	 */
	zb_test_init(&t, 1.0f);
	zb_test_cmd(&t, 1.0f);
	zb_test_step(&t, 1);
	zb_test_step_commanding(&t, ZB_TEST_STEPS_MS(1000), 1.0f, ZB_TEST_STEPS_MS(10));
	zassert_equal(t.rt.mode, ZB_MODE_FOLLOWING);

	/* Host dies mid-motion. */
	zb_test_step(&t, ZB_TEST_STEPS_MS(CONFIG_ZENBEDDED_AGE_PARK_MS));
	zb_test_step(&t, ZB_TEST_STEPS_MS(12000));
	zassert_equal(t.rt.mode, ZB_MODE_PARK);
	zassert_true(t.rt.parked);

	/* Host returns and flushes its stale buffer. Refused. */
	zb_test_cmd(&t, 1.0f);
	zb_test_step(&t, 1);
	zassert_equal(t.rt.mode, ZB_MODE_PARK);

	/* Host re-reads the reported position and seeds from it. Accepted. */
	float reported = t.rt.position;

	zb_test_cmd(&t, reported);
	zb_test_step(&t, 1);
	zassert_equal(t.rt.mode, ZB_MODE_FOLLOWING);

	/* Ride the ramp back to full authority. */
	zb_test_step_commanding(&t, ZB_TEST_STEPS_MS(CONFIG_ZENBEDDED_RESUME_RAMP_MS + 500),
				reported, ZB_TEST_STEPS_MS(10));
	zassert_false(t.rt.ramping);

	TC_PRINT("full cycle: worst effort step %f Nm (budget %f), "
		 "worst velocity step %f rad/s (budget %f)\n",
		 (double)t.max_effort_jump, (double)effort_budget, (double)t.max_velocity_jump,
		 (double)ZB_MAX_VELOCITY_STEP);

	zassert_true(t.max_effort_jump <= effort_budget,
		     "effort stepped %f Nm in one 1 ms iteration, budget is %f Nm: "
		     "that is a slam",
		     (double)t.max_effort_jump, (double)effort_budget);
	zassert_true(t.max_velocity_jump <= ZB_MAX_VELOCITY_STEP,
		     "joint velocity stepped %f rad/s in one 1 ms iteration, budget is %f",
		     (double)t.max_velocity_jump, (double)ZB_MAX_VELOCITY_STEP);
}

ZTEST(zb_resume, test_resume_without_the_ramp_would_slam)
{
	/*
	 * A control test that only ever passes is not evidence of anything. This
	 * one establishes that the continuity budget in the test above is tight
	 * enough to catch the failure it is meant to catch: drive the same
	 * resume with the gain ramp already complete, and the joint's response
	 * to being handed authority all at once must blow the budget.
	 */
	const struct zb_joint_cfg *c = &zb_joints[ZB_TEST_JOINT];
	float effort_budget = c->max_effort * ZB_MAX_EFFORT_STEP_FRAC;

	cycle_to_parked(1.0f);

	float reported = t.rt.position;

	zb_test_cmd(&t, reported);
	zb_test_step(&t, 1);

	/* Skip the ramp, exactly as an implementation without one would. */
	t.rt.ramping = false;
	t.rt.gain_scale = 1.0f;
	zb_test_step(&t, 1);

	/* Start measuring from the settled state, just before the bad thing. */
	zb_test_continuity_reset(&t);

	/* Now hand it the far command the epsilon gate would have refused. */
	t.rt.active.position = 1.0f;
	zb_test_step(&t, 2);

	TC_PRINT("unguarded resume: effort step %f Nm against a %f Nm budget\n",
		 (double)t.max_effort_jump, (double)effort_budget);

	zassert_true(t.max_effort_jump > effort_budget,
		     "the continuity budget is too loose to detect a real slam");
}
```

## src/test_setpoint.c
```c
/*
 * Copyright (c) 2026 zenbedded contributors
 *
 * SPDX-License-Identifier: Apache-2.0
 */

#include <math.h>

#include <zephyr/kernel.h>
#include <zephyr/ztest.h>

#include <zenbedded/setpoint.h>

#include "test_common.h"

/*
 * The setpoint channel is the only thing crossing the thread boundary, so it is
 * the only place a torn read can happen. Every setpoint carries redundant,
 * derivable fields, and the tests check them against the sequence number: if a
 * consumer ever sees this frame's position beside the previous frame's velocity,
 * the invariant fails and the channel is broken.
 */

#define ZB_POS_FOR_SEQ(s) ((float)(s) * 1e-3f)
#define ZB_VEL_FOR_SEQ(s) (-2.0f * ZB_POS_FOR_SEQ(s))
#define ZB_CYC_FOR_SEQ(s) ((uint64_t)(s) * 7ULL)

static struct zb_sp_chan chan;

static void fill(struct zb_setpoint *sp, uint32_t seq)
{
	sp->seq = seq;
	sp->position = ZB_POS_FOR_SEQ(seq);
	sp->velocity = ZB_VEL_FOR_SEQ(seq);
	sp->arrival_cycles = ZB_CYC_FOR_SEQ(seq);
}

static void assert_consistent(const struct zb_setpoint *sp)
{
	zassert_within(sp->position, ZB_POS_FOR_SEQ(sp->seq), 1e-9f,
		       "torn read: position does not match seq %u", sp->seq);
	zassert_within(sp->velocity, ZB_VEL_FOR_SEQ(sp->seq), 1e-9f,
		       "torn read: velocity does not match seq %u", sp->seq);
	zassert_equal(sp->arrival_cycles, ZB_CYC_FOR_SEQ(sp->seq),
		      "torn read: arrival_cycles does not match seq %u", sp->seq);
}

/** The three slot indices must always be a permutation of {0,1,2}. */
static void assert_permutation(const struct zb_sp_chan *c)
{
	uint32_t s = (uint32_t)(atomic_get((atomic_t *)&c->shared) & ZB_SP_IDX_MASK);
	uint32_t p = c->producer_idx;
	uint32_t r = c->consumer_idx;

	zassert_true(p < 3U && r < 3U && s < 3U, "slot index out of range");
	zassert_true(p != r && p != s && r != s,
		     "slot indices collided (%u,%u,%u): a writer and a reader can now "
		     "be in the same slot",
		     p, r, s);
}

static void sp_before(void *f)
{
	ARG_UNUSED(f);
	zb_sp_init(&chan);
}

ZTEST_SUITE(zb_setpoint, NULL, NULL, sp_before, NULL, NULL);

ZTEST(zb_setpoint, test_empty_channel_yields_nothing)
{
	struct zb_setpoint out;

	zassert_false(zb_sp_consume(&chan, &out), "a fresh channel has nothing to consume");
	assert_permutation(&chan);
}

ZTEST(zb_setpoint, test_publish_then_consume)
{
	struct zb_setpoint in, out;

	fill(&in, 42U);
	zb_sp_publish(&chan, &in);
	assert_permutation(&chan);

	zassert_true(zb_sp_consume(&chan, &out));
	assert_consistent(&out);
	zassert_equal(out.seq, 42U);

	zassert_false(zb_sp_consume(&chan, &out), "the same setpoint must not be returned twice");
}

ZTEST(zb_setpoint, test_newest_wins)
{
	struct zb_setpoint in, out;

	/*
	 * The control loop wants the newest command, not a backlog. Publishing
	 * over an unconsumed setpoint is correct behaviour, not data loss.
	 */
	for (uint32_t s = 1; s <= 10U; s++) {
		fill(&in, s);
		zb_sp_publish(&chan, &in);
		assert_permutation(&chan);
	}

	zassert_true(zb_sp_consume(&chan, &out));
	assert_consistent(&out);
	zassert_equal(out.seq, 10U, "consumer must see the newest published setpoint");
}

ZTEST(zb_setpoint, test_fuzzed_producer_interleaving)
{
	struct zb_setpoint in, out;
	uint32_t seq = 0;
	uint32_t last_seen = 0;
	uint32_t rng = 0x1234567U;

	/*
	 * Ragged interleaving: bursts of publishes against bursts of consumes,
	 * driven by a fixed LCG so a failure is reproducible.
	 */
	for (int round = 0; round < 20000; round++) {
		rng = rng * 1103515245U + 12345U;

		uint32_t pubs = (rng >> 16) & 0x3U;
		uint32_t cons = (rng >> 20) & 0x3U;

		for (uint32_t i = 0; i < pubs; i++) {
			fill(&in, ++seq);
			zb_sp_publish(&chan, &in);
			assert_permutation(&chan);
		}

		for (uint32_t i = 0; i < cons; i++) {
			if (zb_sp_consume(&chan, &out)) {
				assert_consistent(&out);
				zassert_true(out.seq > last_seen,
					     "sequence went backwards: %u after %u", out.seq,
					     last_seen);
				last_seen = out.seq;
			}
			assert_permutation(&chan);
		}
	}

	zassert_true(last_seen > 0U, "the fuzz loop never delivered anything");
}

/* -- Preemptive version: a producer that cuts in under the consumer. ------- */

#define ZB_FUZZ_ITERATIONS 20000

static uint32_t fuzz_published;

/*
 * Publishing from a timer callback puts the producer in interrupt context,
 * where it preempts the consumer at genuinely arbitrary points -- including
 * between the atomic_get and the atomic_set inside zb_sp_consume(), which is
 * the one interleaving the whole design has to survive.
 *
 * This is the strongest interleaving available under native_sim: a second
 * thread would not do it, because native_sim's clock only advances when the CPU
 * is idle, so two spinning threads never actually interleave. The consumer
 * below burns a microsecond per iteration precisely so that simulated time
 * advances and the timer can fire underneath it.
 */
static void fuzz_timer_fn(struct k_timer *timer)
{
	struct zb_setpoint in;

	ARG_UNUSED(timer);

	fill(&in, ++fuzz_published);
	zb_sp_publish(&chan, &in);
}

static K_TIMER_DEFINE(fuzz_timer, fuzz_timer_fn, NULL);

ZTEST(zb_setpoint, test_fuzzed_producer_preempts_consumer)
{
	struct zb_setpoint out;
	uint32_t last_seen = 0;
	uint32_t consumed = 0;

	fuzz_published = 0;
	k_timer_start(&fuzz_timer, K_USEC(10), K_USEC(10));

	for (int i = 0; i < ZB_FUZZ_ITERATIONS; i++) {
		if (zb_sp_consume(&chan, &out)) {
			assert_consistent(&out);
			zassert_true(out.seq > last_seen, "sequence went backwards: %u after %u",
				     out.seq, last_seen);
			last_seen = out.seq;
			consumed++;
		}

		k_busy_wait(1);
	}

	k_timer_stop(&fuzz_timer);

	zassert_true(fuzz_published > 0U, "the producer never ran; the test proved nothing");
	zassert_true(consumed > 0U, "the consumer never saw anything");

	TC_PRINT("preemptive fuzz: %u published, %u consumed\n", fuzz_published, consumed);
}
```

## src/test_state_machine.c
```c
/*
 * Copyright (c) 2026 zenbedded contributors
 *
 * SPDX-License-Identifier: Apache-2.0
 */

#include <math.h>

#include <zephyr/ztest.h>

#include "test_common.h"

/*
 * The failover policy, asserted at its exact thresholds. These numbers are the
 * demo: if they drift, the thing on the slide is no longer the thing in the
 * firmware.
 */

#define ZB_DEGRADED_MS CONFIG_ZENBEDDED_AGE_DEGRADED_MS
#define ZB_HOLDING_MS  CONFIG_ZENBEDDED_AGE_HOLDING_MS
#define ZB_PARK_MS     CONFIG_ZENBEDDED_AGE_PARK_MS

static struct zb_test_ctx t;

/** Bring the joint from cold start into FOLLOWING at @p pos. */
static void enter_following(float pos)
{
	zb_test_init(&t, pos);

	zassert_equal(t.rt.mode, ZB_MODE_PARK, "a joint that has never heard a host is parked");

	zb_test_cmd(&t, pos);
	zb_test_step(&t, 1);

	zassert_equal(t.rt.mode, ZB_MODE_FOLLOWING, "a command at the current position resumes");
}

ZTEST_SUITE(zb_state_machine, NULL, NULL, NULL, NULL, NULL);

ZTEST(zb_state_machine, test_cold_start_is_parked_and_unpowered)
{
	zb_test_init(&t, 0.0f);
	zb_test_step(&t, 10);

	zassert_equal(t.rt.mode, ZB_MODE_PARK);
	zassert_false(t.rt.driver_enabled, "never energise a motor on no information");
	zassert_within(t.rt.effort, 0.0f, 1e-9f);
	zassert_false(t.rt.ever_accepted);
}

ZTEST(zb_state_machine, test_transitions_fire_at_thresholds)
{
	enter_following(0.0f);

	/* One step short of the DEGRADED threshold. */
	zb_test_step(&t, ZB_TEST_STEPS_MS(ZB_DEGRADED_MS) - 1U);
	zassert_equal(t.rt.mode, ZB_MODE_FOLLOWING, "still FOLLOWING at %d ms - 1 step",
		      ZB_DEGRADED_MS);

	zb_test_step(&t, 1);
	zassert_equal(t.rt.mode, ZB_MODE_DEGRADED, "DEGRADED exactly at %d ms", ZB_DEGRADED_MS);

	zb_test_step(&t, ZB_TEST_STEPS_MS(ZB_HOLDING_MS - ZB_DEGRADED_MS) - 1U);
	zassert_equal(t.rt.mode, ZB_MODE_DEGRADED, "still DEGRADED at %d ms - 1 step",
		      ZB_HOLDING_MS);

	zb_test_step(&t, 1);
	zassert_equal(t.rt.mode, ZB_MODE_HOLDING, "HOLDING exactly at %d ms", ZB_HOLDING_MS);

	zb_test_step(&t, ZB_TEST_STEPS_MS(ZB_PARK_MS - ZB_HOLDING_MS) - 1U);
	zassert_equal(t.rt.mode, ZB_MODE_HOLDING, "still HOLDING at %d ms - 1 step", ZB_PARK_MS);

	zb_test_step(&t, 1);
	zassert_equal(t.rt.mode, ZB_MODE_PARK, "PARK exactly at %d ms", ZB_PARK_MS);
}

ZTEST(zb_state_machine, test_fresh_commands_keep_it_following)
{
	enter_following(0.0f);

	/* A healthy host at ~100 Hz: the joint must never leave FOLLOWING. */
	for (uint32_t i = 0; i < ZB_TEST_STEPS_MS(2000); i++) {
		if ((i % ZB_TEST_STEPS_MS(10)) == 0U) {
			zb_test_cmd(&t, 0.0f);
		}
		zb_test_step(&t, 1);
		zassert_equal(t.rt.mode, ZB_MODE_FOLLOWING, "dropped out of FOLLOWING at step %u",
			      i);
	}
}

ZTEST(zb_state_machine, test_age_keys_off_arrival_not_link_state)
{
	enter_following(0.0f);

	/*
	 * Nothing here ever tells the state machine the link is down. A host
	 * that holds its socket open and publishes nothing looks exactly like a
	 * pulled cable, which is the entire point.
	 */
	zb_test_step(&t, ZB_TEST_STEPS_MS(ZB_PARK_MS));
	zassert_equal(t.rt.mode, ZB_MODE_PARK);
}

ZTEST(zb_state_machine, test_effort_ceiling_by_mode)
{
	const struct zb_joint_cfg *c = &zb_joints[ZB_TEST_JOINT];

	/* Out at an angle, where holding station actually costs torque. */
	enter_following(1.0f);
	zb_test_step_commanding(&t, ZB_TEST_STEPS_MS(1000), 1.0f, ZB_TEST_STEPS_MS(10));

	zassert_true(fabsf(t.rt.effort) <= c->max_effort + 1e-6f, "FOLLOWING exceeded max effort");

	/* Go silent and walk through the modes, checking the ceiling in force. */
	zb_test_step(&t, ZB_TEST_STEPS_MS(ZB_DEGRADED_MS));
	zassert_equal(t.rt.mode, ZB_MODE_DEGRADED);
	zassert_true(fabsf(t.rt.effort) <= c->max_effort + 1e-6f, "DEGRADED exceeded max effort");

	zb_test_step(&t, ZB_TEST_STEPS_MS(ZB_HOLDING_MS - ZB_DEGRADED_MS));
	zassert_equal(t.rt.mode, ZB_MODE_HOLDING);

	for (uint32_t i = 0; i < ZB_TEST_STEPS_MS(ZB_PARK_MS - ZB_HOLDING_MS) - 1U; i++) {
		zb_test_step(&t, 1);
		zassert_true(fabsf(t.rt.effort) <= c->hold_effort + 1e-6f,
			     "HOLDING drew %f Nm, above the %f Nm clamp",
			     (double)fabsf(t.rt.effort), (double)c->hold_effort);
	}
}

ZTEST(zb_state_machine, test_holding_actually_holds)
{
	/*
	 * The HOLDING clamp is only a sane policy if it leaves enough torque to
	 * resist gravity. If this fails, the joint is sagging through HOLDING
	 * and the PARK descent that follows is a fall, not a descent.
	 */
	enter_following(1.0f);
	zb_test_step_commanding(&t, ZB_TEST_STEPS_MS(1000), 1.0f, ZB_TEST_STEPS_MS(10));

	/* One final command, so that silence starts from a known age of zero. */
	zb_test_cmd(&t, 1.0f);
	zb_test_step(&t, 1);

	float held = t.rt.position;

	zb_test_step(&t, ZB_TEST_STEPS_MS(ZB_PARK_MS) - 1U);
	zassert_equal(t.rt.mode, ZB_MODE_HOLDING);

	zassert_within(t.rt.position, held, 0.05f,
		       "joint drifted %f rad while HOLDING; hold-effort-mnm is too low for "
		       "sim-gravity-mnm",
		       (double)fabsf(t.rt.position - held));
}
```
