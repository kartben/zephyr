## CMakeLists.txt
```
# SPDX-License-Identifier: Apache-2.0

cmake_minimum_required(VERSION 3.20.0)
find_package(Zephyr REQUIRED HINTS $ENV{ZEPHYR_BASE})
project(meshtastic_tests)

target_sources(app PRIVATE
  src/main.c
  src/test_channels.c
  src/header_core_only.c
  src/header_gnss_only.c
  src/header_nodedb_only.c
  src/header_nodeinfo_only.c
  src/header_telemetry_only.c
)
target_include_directories(app PRIVATE
  ${ZEPHYR_BASE}/subsys/meshtastic
  ${CMAKE_BINARY_DIR}/zephyr/subsys/meshtastic/proto
)
```

## prj.conf
```kconfig
CONFIG_ZTEST=y
CONFIG_MESHTASTIC=y
CONFIG_MESHTASTIC_DEVICE_METRICS=y
CONFIG_MESHTASTIC_DEVICE_METRICS_AUTO_SEND=n
CONFIG_MESHTASTIC_NODEDB=y
CONFIG_MESHTASTIC_NODEINFO=y
CONFIG_MESHTASTIC_NODEINFO_AUTO_SEND=n
CONFIG_MESHTASTIC_SHELL=y
CONFIG_LOG=y
CONFIG_SHELL=y
CONFIG_SHELL_BACKEND_DUMMY=y
CONFIG_MAIN_STACK_SIZE=4096
CONFIG_ZTEST_STACK_SIZE=4096
```

## env.conf
```kconfig
CONFIG_SENSOR=y
CONFIG_MESHTASTIC_ENVIRONMENT_METRICS=y
CONFIG_MESHTASTIC_ENVIRONMENT_METRICS_AUTO_SEND=n
```

## serial.conf
```kconfig
CONFIG_SERIAL=y
CONFIG_UART_INTERRUPT_DRIVEN=y
CONFIG_MESHTASTIC_SERIAL=y
CONFIG_MESHTASTIC_SERIAL_FROMRADIO_QUEUE_SIZE=8
CONFIG_MESHTASTIC_SERIAL_RX_BUF_SIZE=128
CONFIG_MESHTASTIC_SERIAL_WORK_STACK_SIZE=2048
```

## settings.conf
```kconfig
CONFIG_MESHTASTIC_SETTINGS=y
CONFIG_SETTINGS_RUNTIME=y

CONFIG_SERIAL=y
CONFIG_UART_INTERRUPT_DRIVEN=y
CONFIG_MESHTASTIC_SERIAL=y
CONFIG_MESHTASTIC_SERIAL_FROMRADIO_QUEUE_SIZE=8
CONFIG_MESHTASTIC_SERIAL_RX_BUF_SIZE=128
CONFIG_MESHTASTIC_SERIAL_WORK_STACK_SIZE=2048
```

## env.overlay
```dts
/* SPDX-License-Identifier: Apache-2.0 */

/ {
	env0: env-sensor {
		compatible = "vnd,env-sensor";
		status = "okay";
	};

	aliases {
		ambient-temp0 = &env0;
		humidity0 = &env0;
		pressure-sensor = &env0;
		gas-sensor = &env0;
		light-sensor = &env0;
	};
};
```

## serial.overlay
```dts
&uart1 {
	status = "okay";
};

/ {
	chosen {
		zephyr,meshtastic-uart = &uart1;
	};
};
```

## dts/bindings/vnd,env-sensor.yaml
```yaml
# SPDX-License-Identifier: Apache-2.0

description: Fake environment sensor used by the Meshtastic environment test

compatible: "vnd,env-sensor"

include: base.yaml
```

## src/header_core_only.c
```c
/* SPDX-License-Identifier: Apache-2.0 */

#include <zephyr/meshtastic/meshtastic.h>

uint32_t meshtastic_test_header_core_only(void)
{
	return MESHTASTIC_NODE_BROADCAST;
}
```

## src/header_gnss_only.c
```c
/* SPDX-License-Identifier: Apache-2.0 */

#include <zephyr/meshtastic/gnss.h>

typedef int (*meshtastic_test_send_position_fn)(uint32_t dest);

meshtastic_test_send_position_fn meshtastic_test_header_gnss_only(void)
{
	return meshtastic_send_position;
}
```

## src/header_nodedb_only.c
```c
/* SPDX-License-Identifier: Apache-2.0 */

#include <zephyr/meshtastic/nodedb.h>

typedef size_t (*meshtastic_test_nodedb_count_fn)(void);
typedef int (*meshtastic_test_nodedb_get_fn)(uint32_t node_num,
					     struct meshtastic_nodedb_node *out);
typedef int (*meshtastic_test_nodedb_get_by_index_fn)(size_t index,
						      struct meshtastic_nodedb_node *out);

meshtastic_test_nodedb_count_fn meshtastic_test_header_nodedb_count_only(void)
{
	return meshtastic_nodedb_count;
}

meshtastic_test_nodedb_get_fn meshtastic_test_header_nodedb_get_only(void)
{
	return meshtastic_nodedb_get;
}

meshtastic_test_nodedb_get_by_index_fn meshtastic_test_header_nodedb_get_by_index_only(void)
{
	return meshtastic_nodedb_get_by_index;
}
```

## src/header_nodeinfo_only.c
```c
/* SPDX-License-Identifier: Apache-2.0 */

#include <zephyr/meshtastic/nodeinfo.h>

typedef int (*meshtastic_test_send_node_info_fn)(uint32_t dest);

meshtastic_test_send_node_info_fn meshtastic_test_header_nodeinfo_only(void)
{
	return meshtastic_send_node_info;
}
```

## src/header_telemetry_only.c
```c
/* SPDX-License-Identifier: Apache-2.0 */

#include <zephyr/meshtastic/telemetry.h>

typedef int (*meshtastic_test_send_metrics_fn)(uint32_t dest);

meshtastic_test_send_metrics_fn meshtastic_test_header_telemetry_only(void)
{
	return meshtastic_send_device_metrics;
}
```

## src/test_channels.c
```c
/* SPDX-FileCopyrightText: Copyright The Zephyr Project Contributors
 * SPDX-License-Identifier: Apache-2.0
 */

#include <string.h>
#include <zephyr/ztest.h>

#include "meshtastic_channels.h"

#include <zephyr/meshtastic/meshtastic.h>

ZTEST(meshtastic_channels, test_longfast_hash)
{
	struct meshtastic_config cfg = {
		.psk = meshtastic_default_psk,
		.psk_len = sizeof(meshtastic_default_psk),
		.channel_name = MESHTASTIC_CHANNEL_LONGFAST,
		.frequency = MESHTASTIC_FREQ_US,
	};
	uint8_t h;

	zassert_ok(meshtastic_channels_init_from_config(&cfg));
	h = meshtastic_channels_get_hash(0);
	/* xor("LongFast") ^ xor(default_psk) — stable wire hash for default channel. */
	zassert_not_equal(h, 0U, "primary hash should be non-zero");
}

ZTEST(meshtastic_channels, test_shorthand_psk_expansion)
{
	meshtastic_Channel ch = meshtastic_Channel_init_zero;
	struct meshtastic_channel_key key;

	zassert_ok(meshtastic_channels_init_defaults());

	ch.index = 1;
	ch.role = meshtastic_Channel_Role_SECONDARY;
	ch.has_settings = true;
	strncpy(ch.settings.name, "Test", sizeof(ch.settings.name) - 1U);
	ch.settings.psk.bytes[0] = 1U;
	ch.settings.psk.size = 1U;

	zassert_ok(meshtastic_channels_set_slot(1, &ch));
	zassert_ok(meshtastic_channels_get_key(1, &key));
	zassert_equal(key.len, sizeof(meshtastic_default_psk), NULL);
	zassert_mem_equal(key.bytes, meshtastic_default_psk, key.len, NULL);
}

ZTEST(meshtastic_channels, test_secondary_inherits_primary_psk)
{
	meshtastic_Channel ch = meshtastic_Channel_init_zero;
	struct meshtastic_channel_key primary;
	struct meshtastic_channel_key secondary;

	zassert_ok(meshtastic_channels_init_defaults());

	ch.index = 2;
	ch.role = meshtastic_Channel_Role_SECONDARY;
	ch.has_settings = true;
	strncpy(ch.settings.name, "Inherited", sizeof(ch.settings.name) - 1U);
	ch.settings.psk.size = 0U;

	zassert_ok(meshtastic_channels_set_slot(2, &ch));
	zassert_ok(meshtastic_channels_get_key(0, &primary));
	zassert_ok(meshtastic_channels_get_key(2, &secondary));
	zassert_equal(primary.len, secondary.len, NULL);
	zassert_mem_equal(primary.bytes, secondary.bytes, primary.len, NULL);
}

ZTEST_SUITE(meshtastic_channels, NULL, NULL, NULL, NULL, NULL);
```
