/*
 * SPDX-FileCopyrightText: Copyright (c) 2026 Process Mission
 * SPDX-License-Identifier: Apache-2.0
 */

&virtio_blk_pci {
	status = "okay";
};

&virtio_blk0 {
	status = "okay";
};

/* QEMU is given no virtio-input device here, so its transport would not probe. */
&virtio_input_pci {
	status = "disabled";
};
