## CMakeLists.txt
```
# SPDX-License-Identifier: Apache-2.0

cmake_minimum_required(VERSION 3.20.0)
find_package(Zephyr REQUIRED HINTS $ENV{ZEPHYR_BASE})
project(freertos_compat_test)

target_include_directories(app PRIVATE ${ZEPHYR_BASE}/include/zephyr/portability/freertos)
FILE(GLOB app_sources src/*.c)
target_sources(app PRIVATE ${app_sources})
```

## prj.conf
```kconfig
CONFIG_ZTEST=y
CONFIG_FREERTOS_COMPAT=y
CONFIG_THREAD_NAME=y
CONFIG_NUM_PREEMPT_PRIORITIES=7
CONFIG_HEAP_MEM_POOL_SIZE=4096
CONFIG_IRQ_OFFLOAD=y
CONFIG_MP_MAX_NUM_CPUS=1
CONFIG_FREERTOS_TASK_MAX_COUNT=20
CONFIG_FREERTOS_SEMAPHORE_MAX_COUNT=15
```

## src/test_kernel.c
```c
/*
 * Copyright (c) 2025 The Zephyr Project Contributors
 *
 * SPDX-License-Identifier: Apache-2.0
 */

#include <zephyr/ztest.h>
#include <zephyr/kernel.h>
#include <FreeRTOS.h>
#include <task.h>

/* --- Tick Count Tests --- */

ZTEST(freertos_kernel, test_tick_count_increases)
{
	TickType_t t1 = xTaskGetTickCount();

	k_msleep(50);

	TickType_t t2 = xTaskGetTickCount();

	zassert_true(t2 > t1, "Tick count did not increase");
}

ZTEST(freertos_kernel, test_tick_count_nonzero)
{
	/* Tick count should be nonzero after boot */
	TickType_t t = xTaskGetTickCount();

	zassert_true(t > 0, "Tick count should be nonzero");
}

/* --- Scheduler Start (No-op) --- */

ZTEST(freertos_kernel, test_start_scheduler_noop)
{
	/* Should not crash or block */
	vTaskStartScheduler();
}

/* --- Constants --- */

ZTEST(freertos_kernel, test_constants)
{
	zassert_equal(pdTRUE, 1);
	zassert_equal(pdFALSE, 0);
	zassert_equal(pdPASS, 1);
	zassert_equal(pdFAIL, 0);
	zassert_equal(portMAX_DELAY, UINT32_MAX);
}

/* --- Config Macros --- */

ZTEST(freertos_kernel, test_config_macros)
{
	zassert_equal(configMAX_PRIORITIES, CONFIG_FREERTOS_MAX_PRIORITIES);
	zassert_equal(configMINIMAL_STACK_SIZE,
		      CONFIG_FREERTOS_TASK_DEFAULT_STACK_SIZE);
	zassert_equal(configTICK_RATE_HZ, CONFIG_SYS_CLOCK_TICKS_PER_SEC);
}

/* --- pdMS_TO_TICKS --- */

ZTEST(freertos_kernel, test_ms_to_ticks)
{
	TickType_t ticks = pdMS_TO_TICKS(1000);

	/* Should equal configTICK_RATE_HZ for 1000ms */
	zassert_true(ticks > 0, "pdMS_TO_TICKS(1000) should be > 0");
}

/* --- Critical Sections --- */

ZTEST(freertos_kernel, test_critical_section)
{
	volatile int val = 0;

	taskENTER_CRITICAL();
	val = 42;
	taskEXIT_CRITICAL();

	zassert_equal(val, 42, "Value not set in critical section");
}

/* --- taskYIELD --- */

ZTEST(freertos_kernel, test_yield)
{
	/* Should not crash or block */
	taskYIELD();
}

ZTEST_SUITE(freertos_kernel, NULL, NULL, NULL, NULL, NULL);
```

## src/test_queue.c
```c
/*
 * Copyright (c) 2025 The Zephyr Project Contributors
 *
 * SPDX-License-Identifier: Apache-2.0
 */

#include <zephyr/ztest.h>
#include <zephyr/kernel.h>
#include <FreeRTOS.h>
#include <task.h>
#include <queue.h>
#include <semphr.h>

/* --- Basic Queue Tests --- */

ZTEST(freertos_queue, test_queue_create)
{
	QueueHandle_t q = xQueueCreate(5, sizeof(uint32_t));

	zassert_not_null(q, "Queue creation failed");
	zassert_equal(uxQueueMessagesWaiting(q), 0, "New queue should be empty");
	zassert_equal(uxQueueSpacesAvailable(q), 5, "New queue should have 5 spaces");

	vQueueDelete(q);
}

ZTEST(freertos_queue, test_queue_create_invalid)
{
	QueueHandle_t q;

	q = xQueueCreate(0, sizeof(uint32_t));
	zassert_is_null(q, "Zero-length queue should fail");

	q = xQueueCreate(5, 0);
	zassert_is_null(q, "Zero-size items should fail");
}

ZTEST(freertos_queue, test_queue_send_receive)
{
	QueueHandle_t q = xQueueCreate(3, sizeof(uint32_t));

	zassert_not_null(q);

	uint32_t send_val = 42;
	uint32_t recv_val = 0;

	zassert_equal(xQueueSend(q, &send_val, 0), pdTRUE,
		      "Send should succeed");
	zassert_equal(uxQueueMessagesWaiting(q), 1);

	zassert_equal(xQueueReceive(q, &recv_val, 0), pdTRUE,
		      "Receive should succeed");
	zassert_equal(recv_val, 42, "Received wrong value");
	zassert_equal(uxQueueMessagesWaiting(q), 0);

	vQueueDelete(q);
}

ZTEST(freertos_queue, test_queue_send_to_back)
{
	QueueHandle_t q = xQueueCreate(3, sizeof(uint32_t));

	zassert_not_null(q);

	uint32_t vals[] = {1, 2, 3};
	uint32_t recv;

	for (int i = 0; i < 3; i++) {
		zassert_equal(xQueueSendToBack(q, &vals[i], 0), pdTRUE);
	}

	/* Should receive in FIFO order */
	for (int i = 0; i < 3; i++) {
		zassert_equal(xQueueReceive(q, &recv, 0), pdTRUE);
		zassert_equal(recv, vals[i], "FIFO order broken at %d", i);
	}

	vQueueDelete(q);
}

ZTEST(freertos_queue, test_queue_full)
{
	QueueHandle_t q = xQueueCreate(2, sizeof(uint32_t));

	zassert_not_null(q);

	uint32_t val = 1;

	zassert_equal(xQueueSend(q, &val, 0), pdTRUE);
	val = 2;
	zassert_equal(xQueueSend(q, &val, 0), pdTRUE);

	/* Queue is full */
	zassert_equal(uxQueueSpacesAvailable(q), 0);
	val = 3;
	zassert_equal(xQueueSend(q, &val, 0), errQUEUE_FULL,
		      "Send to full queue should fail");

	vQueueDelete(q);
}

ZTEST(freertos_queue, test_queue_empty_receive)
{
	QueueHandle_t q = xQueueCreate(2, sizeof(uint32_t));

	zassert_not_null(q);

	uint32_t recv;

	zassert_equal(xQueueReceive(q, &recv, 0), pdFALSE,
		      "Receive from empty queue should fail");

	vQueueDelete(q);
}

/* --- Timeout Tests --- */

ZTEST(freertos_queue, test_queue_receive_timeout)
{
	QueueHandle_t q = xQueueCreate(2, sizeof(uint32_t));

	zassert_not_null(q);

	uint32_t recv;
	TickType_t start = xTaskGetTickCount();

	zassert_equal(xQueueReceive(q, &recv, pdMS_TO_TICKS(100)), pdFALSE);

	TickType_t elapsed = xTaskGetTickCount() - start;

	zassert_true(elapsed >= pdMS_TO_TICKS(80),
		     "Timeout too short: %u", elapsed);

	vQueueDelete(q);
}

ZTEST(freertos_queue, test_queue_send_timeout)
{
	QueueHandle_t q = xQueueCreate(1, sizeof(uint32_t));

	zassert_not_null(q);

	uint32_t val = 1;

	/* Fill the queue */
	xQueueSend(q, &val, 0);

	TickType_t start = xTaskGetTickCount();

	val = 2;
	zassert_equal(xQueueSend(q, &val, pdMS_TO_TICKS(100)), errQUEUE_FULL);

	TickType_t elapsed = xTaskGetTickCount() - start;

	zassert_true(elapsed >= pdMS_TO_TICKS(80),
		     "Send timeout too short: %u", elapsed);

	vQueueDelete(q);
}

/* --- Multi-item Type Tests --- */

struct test_msg {
	uint32_t id;
	uint8_t data[8];
};

ZTEST(freertos_queue, test_queue_struct_items)
{
	QueueHandle_t q = xQueueCreate(3, sizeof(struct test_msg));

	zassert_not_null(q);

	struct test_msg send = {.id = 7};

	memset(send.data, 0xAB, sizeof(send.data));

	zassert_equal(xQueueSend(q, &send, 0), pdTRUE);

	struct test_msg recv = {0};

	zassert_equal(xQueueReceive(q, &recv, 0), pdTRUE);
	zassert_equal(recv.id, 7);
	zassert_mem_equal(recv.data, send.data, sizeof(send.data));

	vQueueDelete(q);
}

/* --- NULL Handle Tests --- */

ZTEST(freertos_queue, test_queue_null_handle)
{
	uint32_t val = 0;

	zassert_equal(xQueueSend(NULL, &val, 0), errQUEUE_FULL);
	zassert_equal(xQueueReceive(NULL, &val, 0), pdFALSE);
	zassert_equal(uxQueueMessagesWaiting(NULL), 0);
	zassert_equal(uxQueueSpacesAvailable(NULL), 0);
	/* Should not crash */
	vQueueDelete(NULL);
}

/* --- Multi-task Queue Test --- */

static QueueHandle_t mt_queue;
static SemaphoreHandle_t qt_done_sem;

static void queue_producer(void *pvParameters)
{
	for (uint32_t i = 0; i < 5; i++) {
		xQueueSend(mt_queue, &i, portMAX_DELAY);
		vTaskDelay(pdMS_TO_TICKS(10));
	}
	vTaskDelete(NULL);
}

static void queue_consumer(void *pvParameters)
{
	uint32_t recv;

	for (int i = 0; i < 5; i++) {
		zassert_equal(xQueueReceive(mt_queue, &recv, portMAX_DELAY),
			      pdTRUE);
		zassert_equal(recv, (uint32_t)i, "Queue value mismatch");
	}
	xSemaphoreGive(qt_done_sem);
	vTaskDelete(NULL);
}

ZTEST(freertos_queue, test_queue_multitask)
{
	mt_queue = xQueueCreate(5, sizeof(uint32_t));
	qt_done_sem = xSemaphoreCreateBinary();
	zassert_not_null(mt_queue);
	zassert_not_null(qt_done_sem);

	xTaskCreate(queue_consumer, "QCons", configMINIMAL_STACK_SIZE,
		    NULL, 3, NULL);
	xTaskCreate(queue_producer, "QProd", configMINIMAL_STACK_SIZE,
		    NULL, 2, NULL);

	xSemaphoreTake(qt_done_sem, portMAX_DELAY);

	vQueueDelete(mt_queue);
	vSemaphoreDelete(qt_done_sem);
}

/* --- xQueueSendToFront (limited) --- */

ZTEST(freertos_queue, test_queue_send_to_front)
{
	QueueHandle_t q = xQueueCreate(3, sizeof(uint32_t));

	zassert_not_null(q);

	uint32_t val = 1;

	/* xQueueSendToFront maps to SendToBack with a warning */
	BaseType_t ret = xQueueSendToFront(q, &val, 0);

	zassert_equal(ret, pdTRUE, "SendToFront should succeed (maps to back)");

	uint32_t recv;

	xQueueReceive(q, &recv, 0);
	zassert_equal(recv, 1);

	vQueueDelete(q);
}

/* --- Max Allocation --- */

ZTEST(freertos_queue, test_queue_max_allocation)
{
	QueueHandle_t queues[CONFIG_FREERTOS_QUEUE_MAX_COUNT + 1];
	int i;

	for (i = 0; i <= CONFIG_FREERTOS_QUEUE_MAX_COUNT; i++) {
		queues[i] = xQueueCreate(2, sizeof(uint32_t));
		if (i == CONFIG_FREERTOS_QUEUE_MAX_COUNT) {
			zassert_is_null(queues[i],
					"Should fail after max count");
		} else {
			zassert_not_null(queues[i],
					 "Allocation %d should succeed", i);
		}
	}

	for (i = 0; i < CONFIG_FREERTOS_QUEUE_MAX_COUNT; i++) {
		vQueueDelete(queues[i]);
	}
}

ZTEST_SUITE(freertos_queue, NULL, NULL, NULL, NULL, NULL);
```

## src/test_semaphore.c
```c
/*
 * Copyright (c) 2025 The Zephyr Project Contributors
 *
 * SPDX-License-Identifier: Apache-2.0
 */

#include <zephyr/ztest.h>
#include <zephyr/kernel.h>
#include <FreeRTOS.h>
#include <task.h>
#include <semphr.h>

/* --- Binary Semaphore Tests --- */

ZTEST(freertos_semaphore, test_binary_semaphore_create)
{
	SemaphoreHandle_t sem = xSemaphoreCreateBinary();

	zassert_not_null(sem, "Binary semaphore creation failed");

	/* Binary semaphore starts at count 0 */
	BaseType_t ret = xSemaphoreTake(sem, 0);

	zassert_equal(ret, pdFALSE, "Binary sem should start empty");

	vSemaphoreDelete(sem);
}

ZTEST(freertos_semaphore, test_binary_semaphore_give_take)
{
	SemaphoreHandle_t sem = xSemaphoreCreateBinary();

	zassert_not_null(sem);

	/* Give then take */
	zassert_equal(xSemaphoreGive(sem), pdTRUE, "Give failed");
	zassert_equal(xSemaphoreTake(sem, 0), pdTRUE, "Take failed after give");

	/* Take again should fail (empty) */
	zassert_equal(xSemaphoreTake(sem, 0), pdFALSE, "Take should fail when empty");

	vSemaphoreDelete(sem);
}

ZTEST(freertos_semaphore, test_binary_semaphore_max_count)
{
	SemaphoreHandle_t sem = xSemaphoreCreateBinary();

	zassert_not_null(sem);

	/* Give twice - binary sem max is 1, second give should still succeed
	 * (k_sem_give is idempotent at max) but sem count stays at 1
	 */
	xSemaphoreGive(sem);
	xSemaphoreGive(sem);

	/* Should be able to take once */
	zassert_equal(xSemaphoreTake(sem, 0), pdTRUE);
	/* Second take should fail */
	zassert_equal(xSemaphoreTake(sem, 0), pdFALSE);

	vSemaphoreDelete(sem);
}

/* --- Counting Semaphore Tests --- */

ZTEST(freertos_semaphore, test_counting_semaphore_create)
{
	SemaphoreHandle_t sem = xSemaphoreCreateCounting(5, 3);

	zassert_not_null(sem, "Counting semaphore creation failed");

	/* Should be able to take 3 times (initial count) */
	for (int i = 0; i < 3; i++) {
		zassert_equal(xSemaphoreTake(sem, 0), pdTRUE,
			      "Take %d should succeed", i);
	}
	/* 4th take should fail */
	zassert_equal(xSemaphoreTake(sem, 0), pdFALSE,
		      "Take should fail when empty");

	vSemaphoreDelete(sem);
}

ZTEST(freertos_semaphore, test_counting_semaphore_max)
{
	SemaphoreHandle_t sem = xSemaphoreCreateCounting(3, 0);

	zassert_not_null(sem);

	/* Give 3 times (up to max) */
	for (int i = 0; i < 3; i++) {
		xSemaphoreGive(sem);
	}

	/* Take 3 times */
	for (int i = 0; i < 3; i++) {
		zassert_equal(xSemaphoreTake(sem, 0), pdTRUE);
	}
	/* Next take should fail */
	zassert_equal(xSemaphoreTake(sem, 0), pdFALSE);

	vSemaphoreDelete(sem);
}

/* --- Mutex Tests --- */

ZTEST(freertos_semaphore, test_mutex_create)
{
	SemaphoreHandle_t mtx = xSemaphoreCreateMutex();

	zassert_not_null(mtx, "Mutex creation failed");

	/* Mutex starts in "given" state, so first take should succeed */
	zassert_equal(xSemaphoreTake(mtx, 0), pdTRUE, "Mutex take failed");

	/* Release it */
	zassert_equal(xSemaphoreGive(mtx), pdTRUE, "Mutex give failed");

	vSemaphoreDelete(mtx);
}

ZTEST(freertos_semaphore, test_mutex_recursive_take)
{
	SemaphoreHandle_t mtx = xSemaphoreCreateMutex();

	zassert_not_null(mtx);

	/* Zephyr k_mutex supports recursive locking */
	zassert_equal(xSemaphoreTake(mtx, 0), pdTRUE);
	zassert_equal(xSemaphoreTake(mtx, 0), pdTRUE);

	/* Must give twice */
	zassert_equal(xSemaphoreGive(mtx), pdTRUE);
	zassert_equal(xSemaphoreGive(mtx), pdTRUE);

	vSemaphoreDelete(mtx);
}

/* --- Timeout Tests --- */

ZTEST(freertos_semaphore, test_semaphore_take_timeout)
{
	SemaphoreHandle_t sem = xSemaphoreCreateBinary();

	zassert_not_null(sem);

	TickType_t start = xTaskGetTickCount();
	BaseType_t ret = xSemaphoreTake(sem, pdMS_TO_TICKS(100));
	TickType_t elapsed = xTaskGetTickCount() - start;

	zassert_equal(ret, pdFALSE, "Should have timed out");
	zassert_true(elapsed >= pdMS_TO_TICKS(80),
		     "Timeout too short: %u ticks", elapsed);

	vSemaphoreDelete(sem);
}

ZTEST(freertos_semaphore, test_semaphore_take_forever)
{
	SemaphoreHandle_t sem = xSemaphoreCreateBinary();

	zassert_not_null(sem);

	/* Give first so the blocking take succeeds */
	xSemaphoreGive(sem);

	BaseType_t ret = xSemaphoreTake(sem, portMAX_DELAY);

	zassert_equal(ret, pdTRUE, "portMAX_DELAY take should succeed");

	vSemaphoreDelete(sem);
}

/* --- NULL Handle Tests --- */

ZTEST(freertos_semaphore, test_semaphore_null_handle)
{
	zassert_equal(xSemaphoreTake(NULL, 0), pdFALSE);
	zassert_equal(xSemaphoreGive(NULL), pdFALSE);
	/* vSemaphoreDelete(NULL) should not crash */
	vSemaphoreDelete(NULL);
}

/* --- Multi-task Semaphore Synchronization --- */

static SemaphoreHandle_t sync_sem;
static volatile int sync_value;

static void sem_producer(void *pvParameters)
{
	for (int i = 0; i < 5; i++) {
		sync_value = i;
		xSemaphoreGive(sync_sem);
		vTaskDelay(pdMS_TO_TICKS(20));
	}
	vTaskDelete(NULL);
}

static SemaphoreHandle_t test_complete_sem;

static void sem_consumer(void *pvParameters)
{
	for (int i = 0; i < 5; i++) {
		xSemaphoreTake(sync_sem, portMAX_DELAY);
		zassert_equal(sync_value, i, "Sync value mismatch at %d", i);
	}
	xSemaphoreGive(test_complete_sem);
	vTaskDelete(NULL);
}

ZTEST(freertos_semaphore, test_semaphore_multitask_sync)
{
	sync_sem = xSemaphoreCreateBinary();
	test_complete_sem = xSemaphoreCreateBinary();
	zassert_not_null(sync_sem);
	zassert_not_null(test_complete_sem);

	/* Consumer at higher priority waits on semaphore */
	xTaskCreate(sem_consumer, "Consumer", configMINIMAL_STACK_SIZE,
		    NULL, 3, NULL);
	xTaskCreate(sem_producer, "Producer", configMINIMAL_STACK_SIZE,
		    NULL, 2, NULL);

	xSemaphoreTake(test_complete_sem, portMAX_DELAY);

	vSemaphoreDelete(sync_sem);
	vSemaphoreDelete(test_complete_sem);
}

/* --- Max Allocation Tests --- */

ZTEST(freertos_semaphore, test_semaphore_max_allocation)
{
	SemaphoreHandle_t sems[CONFIG_FREERTOS_SEMAPHORE_MAX_COUNT + 1];
	int i;

	for (i = 0; i <= CONFIG_FREERTOS_SEMAPHORE_MAX_COUNT; i++) {
		sems[i] = xSemaphoreCreateBinary();
		if (i == CONFIG_FREERTOS_SEMAPHORE_MAX_COUNT) {
			zassert_is_null(sems[i],
					"Should fail after max count");
		} else {
			zassert_not_null(sems[i],
					 "Allocation %d should succeed", i);
		}
	}

	/* Cleanup */
	for (i = 0; i < CONFIG_FREERTOS_SEMAPHORE_MAX_COUNT; i++) {
		vSemaphoreDelete(sems[i]);
	}
}

ZTEST_SUITE(freertos_semaphore, NULL, NULL, NULL, NULL, NULL);
```

## src/test_task.c
```c
/*
 * Copyright (c) 2025 The Zephyr Project Contributors
 *
 * SPDX-License-Identifier: Apache-2.0
 */

#include <zephyr/ztest.h>
#include <zephyr/kernel.h>
#include <FreeRTOS.h>
#include <task.h>
#include <semphr.h>

static volatile int task_ran;
static SemaphoreHandle_t task_done_sem;

static void simple_task(void *pvParameters)
{
	task_ran = (int)(intptr_t)pvParameters;
	xSemaphoreGive(task_done_sem);
	vTaskDelete(NULL);
}

ZTEST(freertos_task, test_task_create_delete)
{
	TaskHandle_t handle = NULL;
	BaseType_t ret;

	task_done_sem = xSemaphoreCreateBinary();
	zassert_not_null(task_done_sem, "Failed to create semaphore");

	task_ran = 0;
	ret = xTaskCreate(simple_task, "TestTask", configMINIMAL_STACK_SIZE,
			  (void *)42, 2, &handle);
	zassert_equal(ret, pdPASS, "xTaskCreate failed");
	zassert_not_null(handle, "Task handle should be non-NULL");

	/* Wait for task to complete */
	xSemaphoreTake(task_done_sem, portMAX_DELAY);
	zassert_equal(task_ran, 42, "Task parameter not passed correctly");

	vSemaphoreDelete(task_done_sem);
}

ZTEST(freertos_task, test_task_create_null_handle)
{
	BaseType_t ret;

	task_done_sem = xSemaphoreCreateBinary();
	zassert_not_null(task_done_sem, "Failed to create semaphore");

	task_ran = 0;
	ret = xTaskCreate(simple_task, "NoHandle", configMINIMAL_STACK_SIZE,
			  (void *)99, 1, NULL);
	zassert_equal(ret, pdPASS, "xTaskCreate with NULL handle should succeed");

	xSemaphoreTake(task_done_sem, portMAX_DELAY);
	zassert_equal(task_ran, 99, "Task did not run");

	vSemaphoreDelete(task_done_sem);
}

ZTEST(freertos_task, test_task_create_null_function)
{
	BaseType_t ret;

	ret = xTaskCreate(NULL, "BadTask", configMINIMAL_STACK_SIZE,
			  NULL, 1, NULL);
	zassert_equal(ret, pdFAIL, "NULL task function should fail");
}

static volatile int delay_task_done;

static void delay_task(void *pvParameters)
{
	TickType_t start = xTaskGetTickCount();

	vTaskDelay(pdMS_TO_TICKS(100));

	TickType_t elapsed = xTaskGetTickCount() - start;

	/* Should have delayed at least ~100ms worth of ticks */
	zassert_true(elapsed >= pdMS_TO_TICKS(80),
		     "vTaskDelay too short: %u ticks", elapsed);

	delay_task_done = 1;
	xSemaphoreGive(task_done_sem);
	vTaskDelete(NULL);
}

ZTEST(freertos_task, test_task_delay)
{
	task_done_sem = xSemaphoreCreateBinary();
	zassert_not_null(task_done_sem);

	delay_task_done = 0;
	xTaskCreate(delay_task, "DelayTask", configMINIMAL_STACK_SIZE,
		    NULL, 2, NULL);

	xSemaphoreTake(task_done_sem, portMAX_DELAY);
	zassert_equal(delay_task_done, 1, "Delay task did not complete");

	vSemaphoreDelete(task_done_sem);
}

ZTEST(freertos_task, test_task_delay_zero_yields)
{
	/* vTaskDelay(0) should yield, not block */
	vTaskDelay(0);
	/* If we get here, it worked (didn't hang) */
}

static void delay_until_task(void *pvParameters)
{
	TickType_t last_wake = xTaskGetTickCount();
	int i;

	for (i = 0; i < 3; i++) {
		xTaskDelayUntil(&last_wake, pdMS_TO_TICKS(50));
	}

	xSemaphoreGive(task_done_sem);
	vTaskDelete(NULL);
}

ZTEST(freertos_task, test_task_delay_until)
{
	task_done_sem = xSemaphoreCreateBinary();
	zassert_not_null(task_done_sem);

	TickType_t start = xTaskGetTickCount();

	xTaskCreate(delay_until_task, "DelayUntil", configMINIMAL_STACK_SIZE,
		    NULL, 2, NULL);

	xSemaphoreTake(task_done_sem, portMAX_DELAY);

	TickType_t elapsed = xTaskGetTickCount() - start;

	/* 3 iterations * 50ms = ~150ms */
	zassert_true(elapsed >= pdMS_TO_TICKS(120),
		     "DelayUntil total too short: %u", elapsed);

	vSemaphoreDelete(task_done_sem);
}

static void priority_task(void *pvParameters)
{
	UBaseType_t prio = uxTaskPriorityGet(NULL);

	zassert_equal(prio, 3, "Initial priority wrong: %u", prio);

	vTaskPrioritySet(NULL, 5);
	prio = uxTaskPriorityGet(NULL);
	zassert_equal(prio, 5, "Priority after set wrong: %u", prio);

	xSemaphoreGive(task_done_sem);
	vTaskDelete(NULL);
}

ZTEST(freertos_task, test_task_priority)
{
	task_done_sem = xSemaphoreCreateBinary();
	zassert_not_null(task_done_sem);

	xTaskCreate(priority_task, "PrioTask", configMINIMAL_STACK_SIZE,
		    NULL, 3, NULL);

	xSemaphoreTake(task_done_sem, portMAX_DELAY);
	vSemaphoreDelete(task_done_sem);
}

ZTEST(freertos_task, test_task_priority_get_set_by_handle)
{
	TaskHandle_t handle;

	task_done_sem = xSemaphoreCreateBinary();
	zassert_not_null(task_done_sem);

	xTaskCreate(simple_task, "HandlePrio", configMINIMAL_STACK_SIZE,
		    (void *)1, 4, &handle);

	UBaseType_t prio = uxTaskPriorityGet(handle);

	zassert_equal(prio, 4, "Priority via handle wrong: %u", prio);

	vTaskPrioritySet(handle, 2);
	prio = uxTaskPriorityGet(handle);
	zassert_equal(prio, 2, "Priority after set via handle wrong: %u", prio);

	xSemaphoreTake(task_done_sem, portMAX_DELAY);
	vSemaphoreDelete(task_done_sem);
}

ZTEST(freertos_task, test_task_get_tick_count)
{
	TickType_t t1 = xTaskGetTickCount();

	k_msleep(50);

	TickType_t t2 = xTaskGetTickCount();

	zassert_true(t2 > t1, "Tick count should increase over time");
}

ZTEST(freertos_task, test_task_start_scheduler_noop)
{
	/* Should not crash or block */
	vTaskStartScheduler();
}

static void self_deleting_task(void *pvParameters)
{
	xSemaphoreGive(task_done_sem);
	vTaskDelete(NULL);
	/* Should never reach here */
}

ZTEST(freertos_task, test_task_delete_self)
{
	task_done_sem = xSemaphoreCreateBinary();
	zassert_not_null(task_done_sem);

	xTaskCreate(self_deleting_task, "SelfDel", configMINIMAL_STACK_SIZE,
		    NULL, 2, NULL);

	xSemaphoreTake(task_done_sem, portMAX_DELAY);
	/* Small delay to let the task actually delete itself */
	k_msleep(50);

	vSemaphoreDelete(task_done_sem);
}

static void long_running_task(void *pvParameters)
{
	while (1) {
		vTaskDelay(pdMS_TO_TICKS(1000));
	}
}

ZTEST(freertos_task, test_task_delete_by_handle)
{
	TaskHandle_t handle;

	BaseType_t ret = xTaskCreate(long_running_task, "LongTask",
				     configMINIMAL_STACK_SIZE, NULL, 1, &handle);
	zassert_equal(ret, pdPASS);

	k_msleep(10);
	vTaskDelete(handle);
	/* If we get here without hanging, deletion worked */
}

ZTEST_SUITE(freertos_task, NULL, NULL, NULL, NULL, NULL);
```

## src/test_timer.c
```c
/*
 * Copyright (c) 2025 The Zephyr Project Contributors
 *
 * SPDX-License-Identifier: Apache-2.0
 */

#include <zephyr/ztest.h>
#include <zephyr/kernel.h>
#include <FreeRTOS.h>
#include <task.h>
#include <timers.h>
#include <semphr.h>

static volatile int timer_callback_count;

static void test_timer_cb(TimerHandle_t xTimer)
{
	timer_callback_count++;
}

/* --- Basic Timer Tests --- */

ZTEST(freertos_timer, test_timer_create)
{
	TimerHandle_t timer = xTimerCreate("TestTimer", pdMS_TO_TICKS(100),
					   pdTRUE, NULL, test_timer_cb);

	zassert_not_null(timer, "Timer creation failed");

	xTimerDelete(timer, 0);
}

ZTEST(freertos_timer, test_timer_create_null_callback)
{
	TimerHandle_t timer = xTimerCreate("BadTimer", pdMS_TO_TICKS(100),
					   pdTRUE, NULL, NULL);

	zassert_is_null(timer, "NULL callback should fail");
}

ZTEST(freertos_timer, test_timer_periodic)
{
	timer_callback_count = 0;

	TimerHandle_t timer = xTimerCreate("Periodic", pdMS_TO_TICKS(50),
					   pdTRUE, NULL, test_timer_cb);

	zassert_not_null(timer);

	zassert_equal(xTimerStart(timer, 0), pdPASS);

	/* Wait for ~250ms - should get ~5 callbacks */
	k_msleep(275);

	xTimerStop(timer, 0);

	int count = timer_callback_count;

	zassert_true(count >= 4, "Too few callbacks: %d", count);
	zassert_true(count <= 7, "Too many callbacks: %d", count);

	xTimerDelete(timer, 0);
}

ZTEST(freertos_timer, test_timer_one_shot)
{
	timer_callback_count = 0;

	TimerHandle_t timer = xTimerCreate("OneShot", pdMS_TO_TICKS(50),
					   pdFALSE, NULL, test_timer_cb);

	zassert_not_null(timer);

	zassert_equal(xTimerStart(timer, 0), pdPASS);

	k_msleep(200);

	/* One-shot should fire exactly once */
	zassert_equal(timer_callback_count, 1,
		      "One-shot fired %d times", timer_callback_count);

	xTimerDelete(timer, 0);
}

ZTEST(freertos_timer, test_timer_stop)
{
	timer_callback_count = 0;

	TimerHandle_t timer = xTimerCreate("StopTest", pdMS_TO_TICKS(50),
					   pdTRUE, NULL, test_timer_cb);

	zassert_not_null(timer);

	xTimerStart(timer, 0);
	k_msleep(75);

	zassert_equal(xTimerStop(timer, 0), pdPASS);

	int count_at_stop = timer_callback_count;

	k_msleep(150);

	/* No more callbacks after stop */
	zassert_equal(timer_callback_count, count_at_stop,
		      "Timer continued after stop");

	xTimerDelete(timer, 0);
}

ZTEST(freertos_timer, test_timer_reset)
{
	timer_callback_count = 0;

	TimerHandle_t timer = xTimerCreate("ResetTest", pdMS_TO_TICKS(100),
					   pdFALSE, NULL, test_timer_cb);

	zassert_not_null(timer);

	xTimerStart(timer, 0);

	/* Reset before it fires */
	k_msleep(50);
	xTimerReset(timer, 0);

	/* After reset, should fire ~100ms from now */
	k_msleep(50);
	zassert_equal(timer_callback_count, 0, "Timer fired too early after reset");

	k_msleep(75);
	zassert_equal(timer_callback_count, 1, "Timer should have fired after reset period");

	xTimerDelete(timer, 0);
}

ZTEST(freertos_timer, test_timer_change_period)
{
	timer_callback_count = 0;

	TimerHandle_t timer = xTimerCreate("ChangePeriod", pdMS_TO_TICKS(200),
					   pdTRUE, NULL, test_timer_cb);

	zassert_not_null(timer);

	xTimerStart(timer, 0);

	/* Change to shorter period */
	xTimerChangePeriod(timer, pdMS_TO_TICKS(50), 0);

	k_msleep(275);
	xTimerStop(timer, 0);

	/* With 50ms period over 275ms, expect ~5 callbacks */
	zassert_true(timer_callback_count >= 4,
		     "Too few after period change: %d", timer_callback_count);

	xTimerDelete(timer, 0);
}

/* --- Timer ID Tests --- */

ZTEST(freertos_timer, test_timer_id)
{
	int my_data = 42;

	TimerHandle_t timer = xTimerCreate("IDTest", pdMS_TO_TICKS(100),
					   pdFALSE, &my_data, test_timer_cb);

	zassert_not_null(timer);

	void *id = pvTimerGetTimerID(timer);

	zassert_equal(id, &my_data, "Timer ID mismatch");
	zassert_equal(*(int *)id, 42, "Timer ID data mismatch");

	xTimerDelete(timer, 0);
}

ZTEST(freertos_timer, test_timer_id_null)
{
	zassert_is_null(pvTimerGetTimerID(NULL));
}

/* --- Timer Callback Receives Handle --- */

static TimerHandle_t cb_received_handle;

static void handle_check_cb(TimerHandle_t xTimer)
{
	cb_received_handle = xTimer;
}

ZTEST(freertos_timer, test_timer_callback_receives_handle)
{
	cb_received_handle = NULL;

	TimerHandle_t timer = xTimerCreate("HandleCB", pdMS_TO_TICKS(50),
					   pdFALSE, NULL, handle_check_cb);

	zassert_not_null(timer);

	xTimerStart(timer, 0);
	k_msleep(100);

	zassert_equal(cb_received_handle, timer,
		      "Callback did not receive correct handle");

	xTimerDelete(timer, 0);
}

/* --- NULL Handle Tests --- */

ZTEST(freertos_timer, test_timer_null_handle)
{
	zassert_equal(xTimerStart(NULL, 0), pdFAIL);
	zassert_equal(xTimerStop(NULL, 0), pdFAIL);
	zassert_equal(xTimerDelete(NULL, 0), pdFAIL);
	zassert_equal(xTimerChangePeriod(NULL, 100, 0), pdFAIL);
	zassert_equal(xTimerReset(NULL, 0), pdFAIL);
}

/* --- Delete Active Timer --- */

ZTEST(freertos_timer, test_timer_delete_while_active)
{
	timer_callback_count = 0;

	TimerHandle_t timer = xTimerCreate("DelActive", pdMS_TO_TICKS(50),
					   pdTRUE, NULL, test_timer_cb);

	zassert_not_null(timer);

	xTimerStart(timer, 0);
	k_msleep(75);

	/* Delete while running - should stop and free */
	zassert_equal(xTimerDelete(timer, 0), pdPASS);

	int count_at_delete = timer_callback_count;

	k_msleep(150);
	zassert_equal(timer_callback_count, count_at_delete,
		      "Timer continued after delete");
}

/* --- Max Allocation --- */

ZTEST(freertos_timer, test_timer_max_allocation)
{
	TimerHandle_t timers[CONFIG_FREERTOS_TIMER_MAX_COUNT + 1];
	int i;

	for (i = 0; i <= CONFIG_FREERTOS_TIMER_MAX_COUNT; i++) {
		timers[i] = xTimerCreate("MaxTest", pdMS_TO_TICKS(1000),
					 pdFALSE, NULL, test_timer_cb);
		if (i == CONFIG_FREERTOS_TIMER_MAX_COUNT) {
			zassert_is_null(timers[i],
					"Should fail after max count");
		} else {
			zassert_not_null(timers[i],
					 "Allocation %d should succeed", i);
		}
	}

	for (i = 0; i < CONFIG_FREERTOS_TIMER_MAX_COUNT; i++) {
		xTimerDelete(timers[i], 0);
	}
}

ZTEST_SUITE(freertos_timer, NULL, NULL, NULL, NULL, NULL);
```
