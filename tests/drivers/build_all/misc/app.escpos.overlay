/*
 * SPDX-FileCopyrightText: Copyright The Zephyr Project Contributors
 * SPDX-License-Identifier: Apache-2.0
 */

/ {
	test {
		#address-cells = <1>;
		#size-cells = <1>;

		test_uart: uart@55556666 {
			compatible = "vnd,serial";
			reg = <0x55556666 0x100>;
			status = "okay";
			current-speed = <9600>;

			escpos0: escpos {
				compatible = "epson,escpos";
				status = "okay";
			};
		};
	};
};
