## prj.conf
```kconfig
CONFIG_OTP=y
```

## app.overlay
```dts
/*
 * Copyright (c) 2026 Benjamin Cabé <benjamin@zephyrproject.org>
 * SPDX-License-Identifier: Apache-2.0
 */

/ {
	test {
		test_otp_emul: otp-emul {
			compatible = "zephyr,otp-emul";
			size = <64>;
			status = "okay";
		};
	};
};
```

## src/main.c
```c
/*
 * Copyright (c) 2026 Benjamin Cabé <benjamin@zephyrproject.org>
 * SPDX-License-Identifier: Apache-2.0
 */

/* Build-only coverage for OTP drivers. */
```
