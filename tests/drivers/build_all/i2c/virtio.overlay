/*
 * SPDX-FileCopyrightText: Copyright The Zephyr Project Contributors
 *
 * SPDX-License-Identifier: Apache-2.0
 *
 * Application overlay for testing the VIRTIO I2C driver build
 */

&virtio_mmio6 {
	status = "okay";
};

&virtio_i2c0 {
	status = "okay";
};
