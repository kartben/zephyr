/*
 * Copyright The Zephyr Project Contributors
 *
 * SPDX-License-Identifier: Apache-2.0
 */

#include <zephyr/dt-bindings/gpio/gpio.h>
#include <zephyr/dt-bindings/sensor/adxl372.h>

&spi0 {
	adxl372: adxl372@0 {
		compatible = "adi,adxl372";
		reg = <0x0>;
		spi-max-frequency = <1000000>;
		int1-gpios = <&gpio0 1 GPIO_ACTIVE_HIGH>;
		fifo-mode = <ADXL372_FIFO_MODE_STREAMED>;
	};
};
