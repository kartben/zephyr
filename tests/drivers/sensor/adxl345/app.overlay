/*
 * Copyright The Zephyr Project Contributors
 *
 * SPDX-License-Identifier: Apache-2.0
 */

#include <zephyr/dt-bindings/gpio/gpio.h>

&i2c0 {
	adxl345: adxl345@53 {
		compatible = "adi,adxl345";
		reg = <0x53>;
		int1-gpios = <&gpio0 1 GPIO_ACTIVE_HIGH>;
		fifo-watermark = <16>;
	};
};
