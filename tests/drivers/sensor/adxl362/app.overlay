/*
 * Copyright The Zephyr Project Contributors
 *
 * SPDX-License-Identifier: Apache-2.0
 */

#include <zephyr/dt-bindings/gpio/gpio.h>

&spi0 {
	adxl362: adxl362@0 {
		compatible = "adi,adxl362";
		reg = <0x0>;
		spi-max-frequency = <1000000>;
		int1-gpios = <&gpio0 1 GPIO_ACTIVE_HIGH>;
	};
};
