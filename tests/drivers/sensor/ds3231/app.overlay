/*
 * Copyright The Zephyr Project Contributors
 *
 * SPDX-License-Identifier: Apache-2.0
 */

&i2c0 {
	ds3231: ds3231@68 {
		compatible = "maxim,ds3231-mfd";
		reg = <0x68>;

		ds3231_sensor: ds3231_sensor {
			compatible = "maxim,ds3231-sensor";
		};
	};
};
