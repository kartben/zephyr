## tests/drivers/audio/dmic_api/boards/m5stickc_plus_esp32_procpu.conf
```kconfig
CONFIG_AUDIO=y
CONFIG_AUDIO_DMIC=y
CONFIG_AUDIO_DMIC_ESP32=y
CONFIG_TEST_SMALL_BUFFER=y
CONFIG_WIFI=n
CONFIG_BT=n
```

## tests/drivers/biometrics/biometrics_id809/testcase.yaml
```yaml
# SPDX-License-Identifier: Apache-2.0

tests:
  drivers.biometrics.biometrics_id809.build:
    build_only: true
    integration_platforms:
      - native_sim
    platform_allow:
      - native_sim
      - native_sim/native/64
    tags:
      - biometrics
      - drivers
```

## tests/drivers/build_all/display/testcase.yaml
```yaml
common:
  build_only: true
  tags:
    - drivers
    - display

tests:
  drivers.display.build.default:
    integration_platforms:
      - native_sim
      - native_sim/native/64
    depends_on: display

  drivers.display.build.dither:
    platform_allow:
      - native_sim/native/64
    extra_args:
      - EXTRA_DTC_OVERLAY_FILE=boards/native_sim_dither.overlay
    extra_configs:
      - CONFIG_DISPLAY_COLOR_PALETTE=y
      - CONFIG_DISPLAY_COLOR_PALETTE_MAX_SIZE=16
      - CONFIG_DISPLAY_COLOR_DITHER=y
      - CONFIG_DISPLAY_COLOR_DITHER_INPUT_RGB565=y
      - CONFIG_DISPLAY_COLOR_DITHER_INPUT_RGB888=y
      - CONFIG_DISPLAY_COLOR_DITHER_DEFAULT_RGB888=y
    depends_on: display

  drivers.display.build.bflb_dbi:
    platform_allow:
      - ai_m62_12f_kit

  drivers.display.build.sf32lb_dbi:
    platform_allow:
      - sf32lb52_devkit_lcd
```

## tests/drivers/buzzer/rttl/testcase.yaml
```yaml
# SPDX-FileCopyrightText: Copyright The Zephyr Project Contributors
# SPDX-License-Identifier: Apache-2.0

tests:
  drivers.buzzer.rttl:
    tags:
      - buzzer
      - drivers
```

## tests/drivers/display/display_dithering/testcase.yaml
```yaml
common:
  tags:
    - drivers
    - display
  harness: ztest
tests:
  drivers.display.dithering.sdl:
    platform_allow:
      - native_sim/native/64
    extra_args:
      - DTC_OVERLAY_FILE=native_sim_i4.overlay
```

## tests/kernel/cache/testcase.yaml
```yaml
tests:
  kernel.cache.api:
    tags:
      - kernel
      - cache
    filter: CONFIG_CACHE_MANAGEMENT
    platform_exclude:
      - bcm958402m2/bcm58402/m7
      - bcm958401m2
      # nRF54L NS boards have a HAL issue with nrf_cache_data_unit_validity_check
      - nrf54l15dk/nrf54l10/cpuapp/ns
      - nrf54l15dk/nrf54l15/cpuapp/ns
      - nrf54lm20dk/nrf54lm20a/cpuapp/ns
      - panb611evb/nrf54l15/cpuapp/ns
      - raytac_an54lq_db_15/nrf54l15/cpuapp/ns
      - bl54l15_dvk/nrf54l10/cpuapp/ns
      - bl54l15_dvk/nrf54l15/cpuapp/ns
      - bl54l15u_dvk/nrf54l15/cpuapp/ns
    integration_platforms:
      - qemu_xtensa/dc233c
      - qemu_cortex_a53
      - nsim/nsim_em
      - qemu_x86
      - qemu_x86_64
  kernel.cache.api.minimallibc:
    tags:
      - kernel
      - cache
      - libc
    filter: CONFIG_CACHE_MANAGEMENT and CONFIG_MINIMAL_LIBC_SUPPORTED
    platform_exclude:
      - bcm958402m2/bcm58402/m7
      - bcm958401m2
      # nRF54L NS boards have a HAL issue with nrf_cache_data_unit_validity_check
      - nrf54l15dk/nrf54l10/cpuapp/ns
      - nrf54l15dk/nrf54l15/cpuapp/ns
      - nrf54lm20dk/nrf54lm20a/cpuapp/ns
      - panb611evb/nrf54l15/cpuapp/ns
      - raytac_an54lq_db_15/nrf54l15/cpuapp/ns
      - bl54l15_dvk/nrf54l10/cpuapp/ns
      - bl54l15_dvk/nrf54l15/cpuapp/ns
      - bl54l15u_dvk/nrf54l15/cpuapp/ns
    integration_platforms:
      - qemu_xtensa/dc233c
      - qemu_cortex_a53
      - nsim/nsim_em
      - qemu_x86
      - qemu_x86_64
    extra_configs:
      - CONFIG_MINIMAL_LIBC=y
```

## tests/misc/dtdoctor/testcase.yaml
```yaml
common:
  harness: build
  build_only: true
  platform_allow:
    - reel_board
  integration_platforms:
    - reel_board

tests:
  dtdoctor.build_ok: {}
  dtdoctor.node_disabled:
    extra_args:
      - ZEPHYR_SCA_VARIANT=dtdoctor
      - DTC_OVERLAY_FILE=disable_gpio0.overlay
    harness_config:
      expect_failure: true
      type: multi_line
      ordered: true
      regex:
        - "gpio0: /soc/gpio@50000000' is disabled in ./disable_gpio0.overlay:2"
        - "The following nodes depend on it"
        - "/leds/led_0"
        - "Try enabling the node by setting its 'status' property to 'okay'."
  dtdoctor.node_enabled_but_subsystem_disabled:
    extra_args:
      - ZEPHYR_SCA_VARIANT=dtdoctor
    extra_configs:
      - CONFIG_GPIO=n
    harness_config:
      expect_failure: true
      type: multi_line
      regex:
        - "DT Doctor"
        - "gpio0: /soc/gpio@50000000' is enabled but no driver appears to be available for it."
        - "Try enabling these Kconfig options:"
        - "- CONFIG_GPIO=y"
```

## tests/net/lib/webrtc/testcase.yaml
```yaml
common:
  depends_on: netif
  min_ram: 80
  min_flash: 200
  tags:
    - net
    - webrtc
  integration_platforms:
    - native_sim
    - qemu_x86
tests:
  net.webrtc:
    platform_allow:
      - native_sim
      - qemu_x86
```

## tests/subsys/meshtastic/testcase.yaml
```yaml
tests:
  subsys.meshtastic.core:
    tags:
      - meshtastic
      - lora
    platform_allow:
      - native_sim
    integration_platforms:
      - native_sim
  subsys.meshtastic.environment:
    tags:
      - meshtastic
      - lora
      - sensor
    platform_allow:
      - native_sim
    integration_platforms:
      - native_sim
    extra_args:
      - EXTRA_CONF_FILE=env.conf
      - DTC_OVERLAY_FILE=env.overlay
  subsys.meshtastic.environment_no_sensor:
    tags:
      - meshtastic
      - lora
      - sensor
    platform_allow:
      - native_sim
    integration_platforms:
      - native_sim
    extra_args:
      - EXTRA_CONF_FILE=env.conf
  subsys.meshtastic.serial:
    tags:
      - meshtastic
      - lora
      - serial
    platform_allow:
      - native_sim
    integration_platforms:
      - native_sim
    extra_args:
      - EXTRA_CONF_FILE=serial.conf
      - DTC_OVERLAY_FILE=serial.overlay
  subsys.meshtastic.settings:
    tags:
      - meshtastic
      - lora
      - settings
    platform_allow:
      - native_sim
    integration_platforms:
      - native_sim
    extra_args:
      - EXTRA_CONF_FILE=settings.conf
      - DTC_OVERLAY_FILE=serial.overlay
```

## tests/subsys/portability/freertos/testcase.yaml
```yaml
tests:
  portability.freertos:
    platform_key:
      - arch
      - simulation
    tags: freertos portability
    min_ram: 32
    min_flash: 34
    integration_platforms:
      - native_sim
```
