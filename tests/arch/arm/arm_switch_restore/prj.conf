## CMakeLists.txt
```
# SPDX-FileCopyrightText: Copyright The Zephyr Project Contributors
# SPDX-License-Identifier: Apache-2.0

cmake_minimum_required(VERSION 3.20.0)
find_package(Zephyr REQUIRED HINTS $ENV{ZEPHYR_BASE})
project(arm_switch_restore)

target_sources(app PRIVATE
  src/main.c
  src/inject.c
)
zephyr_link_libraries("-Wl,--wrap=arm_m_switch_restore")
```

## prj.conf
```kconfig
CONFIG_ZTEST=y
CONFIG_USE_SWITCH=y
CONFIG_INIT_STACKS=y
CONFIG_THREAD_STACK_INFO=y
CONFIG_THREAD_MONITOR=y
CONFIG_THREAD_NAME=y
CONFIG_SYS_CLOCK_TICKS_PER_SEC=10000
CONFIG_DYNAMIC_INTERRUPTS=y
```

## src/main.c
```c
/*
 * SPDX-FileCopyrightText: Copyright The Zephyr Project Contributors
 * SPDX-License-Identifier: Apache-2.0
 */

#include <zephyr/kernel.h>
#include <zephyr/ztest.h>

/* Checks that the idle thread's stack usage does not grow across a large
 * number of context switches.
 *
 * Two threads each sleep for a single tick, one of them offset by a busy wait
 * that grows every round, so the point at which a wakeup lands relative to a
 * switch into idle sweeps through the tick period instead of always falling in
 * the same place. Idle is the subject because it is entered whenever every
 * other thread is pending, and it has the smallest stack in the system.
 *
 * The measurement is idle's unused stack before and after, as reported by
 * k_thread_stack_space_get(). Sampling the stack rather than waiting for a
 * fault is deliberate: stack lost a frame at a time runs off the bottom into
 * whatever sits below it rather than tripping a guard, so a fault would
 * surface late and somewhere unrelated.
 */

#define ROUNDS       3000U
#define HELPER_STACK 512U
#define HELPER_PRIO  K_PRIO_PREEMPT(0)

/* Two samples of idle's high-water mark differ by up to one exception frame,
 * since an interrupt can be nested at its deepest point when one is taken.
 * Past that, stack is not being given back.
 */
#define SLACK 48U

static K_THREAD_STACK_DEFINE(helper_stack, HELPER_STACK);
static struct k_thread helper_thread;

static struct k_thread *idle_thread;

static void find_idle_cb(const struct k_thread *thread, void *user_data)
{
	const char *name = k_thread_name_get((k_tid_t)thread);

	ARG_UNUSED(user_data);

	if ((idle_thread == NULL) && (name != NULL) && (strncmp(name, "idle", 4) == 0)) {
		idle_thread = (struct k_thread *)thread;
	}
}

static void helper_entry(void *p1, void *p2, void *p3)
{
	ARG_UNUSED(p1);
	ARG_UNUSED(p2);
	ARG_UNUSED(p3);

	for (uint32_t i = 0U; i < ROUNDS; i++) {
		/* Drift against the tick so successive wakeups land at
		 * different points of the switch into idle.
		 */
		k_busy_wait(i % 101U);
		k_sleep(K_TICKS(1));
	}
}

ZTEST(arm_switch_restore, test_idle_stack_survives_switch_restore)
{
	size_t before, after;
	int ret;

	k_thread_foreach_unlocked(find_idle_cb, NULL);
	zassert_not_null(idle_thread, "idle thread not found");

	/* Let the system settle so the reading below is idle's steady state. */
	k_sleep(K_TICKS(10));

	ret = k_thread_stack_space_get(idle_thread, &before);
	zassert_equal(ret, 0, "k_thread_stack_space_get() failed: %d", ret);

	k_thread_create(&helper_thread, helper_stack, K_THREAD_STACK_SIZEOF(helper_stack),
			helper_entry, NULL, NULL, NULL, HELPER_PRIO, 0, K_NO_WAIT);

	for (uint32_t i = 0U; i < ROUNDS; i++) {
		k_sleep(K_TICKS(1));
	}

	ret = k_thread_join(&helper_thread, K_FOREVER);
	zassert_ok(ret, "k_thread_join() failed: %d", ret);

	ret = k_thread_stack_space_get(idle_thread, &after);
	zassert_equal(ret, 0, "k_thread_stack_space_get() failed: %d", ret);

	TC_PRINT("idle stack unused: %zu -> %zu bytes over %u rounds\n", before, after, ROUNDS);

	zassert_true(after + SLACK >= before,
		     "idle leaked %zu bytes of stack (%zu unused before, %zu after)",
		     before - after, before, after);
}

ZTEST_SUITE(arm_switch_restore, NULL, NULL, NULL, NULL, NULL);
```

## src/inject.c
```c
/*
 * SPDX-FileCopyrightText: Copyright The Zephyr Project Contributors
 * SPDX-License-Identifier: Apache-2.0
 */

#include <zephyr/kernel.h>
#include <zephyr/ztest.h>
#include <zephyr/sw_isr_table.h>
#include <cmsis_core.h>

#define PREEMPTIONS 256U

extern char arm_m_switch_restore_start, arm_m_switch_restore_end;

volatile uint32_t restore_test_armed;
void *volatile restore_test_handle;
volatile uint32_t *restore_test_pending;
uint32_t restore_test_irq_mask;

static K_SEM_DEFINE(start, 0, 1);
static K_SEM_DEFINE(interrupted, 0, 1);
static K_THREAD_STACK_DEFINE(preemptor_stack, 1024);
static struct k_thread preemptor;
static struct k_thread *victim;
static void *first_handle;
static uint32_t resume_pc;
static uint32_t count;

/* Pend an interrupt before the real restore unmasks it. This wrapper exists
 * only in the test image; production restore instructions are unchanged.
 */
__attribute__((naked)) void __wrap_arm_m_switch_restore(void)
{
	__asm__("ldr r1, =restore_test_armed;"
		"ldr r2, [r1];"
		"cbz r2, 1f;"
		"ldr r1, =restore_test_handle;"
		"str r4, [r1];"
		"ldr r1, =restore_test_pending;"
		"ldr r1, [r1];"
		"ldr r2, =restore_test_irq_mask;"
		"ldr r2, [r2];"
		"str r2, [r1];"
		"dsb;"
		"1: b __real_arm_m_switch_restore;");
}

static void interrupt_restore(const void *arg)
{
	uint32_t *frame = (uint32_t *)__get_PSP();
	uint32_t pc = frame[6];

	ARG_UNUSED(arg);
	if ((k_current_get() != victim) || (restore_test_armed == 0U)) {
		return;
	}
	if ((pc < (uint32_t)&arm_m_switch_restore_start) ||
	    (pc >= (uint32_t)&arm_m_switch_restore_end)) {
		return;
	}

	if (first_handle == NULL) {
		first_handle = restore_test_handle;
	}

	/* Model suspension at the later loads, including a partially completed
	 * LDM. Recovery must ignore both the stacked scratch registers and ICI
	 * state and return the untouched original handle. Always wake a higher
	 * priority thread, so the edited frame is discarded rather than resumed.
	 */
	frame[6] = resume_pc;
	frame[7] |= BIT(10);
	frame[0] = 0xdead0000U;
	frame[1] = 0xdead0001U;
	k_sem_give(&interrupted);
}

static void preempt(void *p1, void *p2, void *p3)
{
	ARG_UNUSED(p1);
	ARG_UNUSED(p2);
	ARG_UNUSED(p3);

	zassert_ok(k_sem_take(&start, K_FOREVER));
#ifdef CONFIG_FPU
	__asm__ volatile("vmov s16, %0" :: "r"(0xdeadbeefU) : "s16");
#endif
	restore_test_armed = 1U;
	for (count = 0U; count < PREEMPTIONS; count++) {
		zassert_ok(k_sem_take(&interrupted, K_FOREVER));
		if (victim->switch_handle != first_handle) {
			restore_test_armed = 0U;
			zassert_equal_ptr(victim->switch_handle, first_handle,
					 "interrupted restore allocated another frame");
		}
	}
	restore_test_armed = 0U;
}

ZTEST(arm_switch_restore, test_late_restore_reuses_frame)
{
	int32_t priority = k_thread_priority_get(k_current_get());

	int32_t test_irq;

	for (test_irq = CONFIG_NUM_IRQS - 1; test_irq >= 0; test_irq--) {
		if ((_sw_isr_table[test_irq].isr == z_irq_spurious) &&
		    (NVIC_GetEnableIRQ(test_irq) == 0U)) {
			NVIC_SetPendingIRQ(test_irq);
			bool implemented = NVIC_GetPendingIRQ(test_irq) != 0U;

			NVIC_ClearPendingIRQ(test_irq);
			if (implemented) {
				break;
			}
		}
	}
	zassert_true(test_irq >= 0, "no unused IRQ");
	zassert_equal(irq_connect_dynamic(test_irq, 0, interrupt_restore, NULL, 0), test_irq);
	restore_test_pending = &NVIC->ISPR[(uint32_t)test_irq / 32U];
	restore_test_irq_mask = BIT((uint32_t)test_irq % 32U);
	irq_enable(test_irq);
	victim = k_current_get();
	k_thread_priority_set(victim, K_PRIO_PREEMPT(1));

	/* The last three instructions are 32-bit loads of the callee-saved
	 * registers, caller-saved registers, and finally PC with SP writeback.
	 */
	for (uint32_t offset = 4U; offset <= 12U; offset += 4U) {
		first_handle = NULL;
		count = 0U;
		resume_pc = (uint32_t)&arm_m_switch_restore_end - offset;
		k_thread_create(&preemptor, preemptor_stack,
				K_THREAD_STACK_SIZEOF(preemptor_stack), preempt,
				NULL, NULL, NULL, K_PRIO_PREEMPT(0), 0, K_NO_WAIT);
#ifdef CONFIG_FPU
		__asm__ volatile("vmov s16, %0" :: "r"(0x3f800000U) : "s16");
#endif
		k_sem_give(&start);
		restore_test_armed = 0U;
		zassert_equal(count, PREEMPTIONS, "restore interrupt did not switch threads");
#ifdef CONFIG_FPU
		uint32_t value;

		__asm__ volatile("vmov %0, s16" : "=r"(value));
		zassert_equal(value, 0x3f800000U, "FP context was not preserved");
#endif
		zassert_ok(k_thread_join(&preemptor, K_FOREVER));
	}

	irq_disable(test_irq);
	victim = NULL;
	k_thread_priority_set(k_current_get(), priority);
}
```
