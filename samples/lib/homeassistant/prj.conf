## CMakeLists.txt
```
# SPDX-License-Identifier: Apache-2.0

cmake_minimum_required(VERSION 3.20.0)
find_package(Zephyr REQUIRED HINTS $ENV{ZEPHYR_BASE})
project(homeassistant_sample)

target_sources(app PRIVATE src/main.c)
```

## Kconfig
```
# Copyright (c) 2025
# SPDX-License-Identifier: Apache-2.0

mainmenu "Home Assistant Integration Sample"

config HOMEASSISTANT_MQTT_BROKER
	string "MQTT broker hostname"
	default "localhost"
	help
	  Hostname or IP address of the MQTT broker to connect to.

config HOMEASSISTANT_MQTT_PORT
	int "MQTT broker port"
	default 1883
	help
	  Port number of the MQTT broker.

source "Kconfig.zephyr"
```

## sample.yaml
```
sample:
  name: Home Assistant Integration
  description: Sample demonstrating Home Assistant integration with Zephyr
common:
  tags:
    - homeassistant
    - mqtt
    - iot
  integration_platforms:
    - native_sim
    - qemu_x86
  harness: console
  harness_config:
    type: multi_line
    ordered: false
    regex:
      - "Home Assistant Integration Sample"
      - "Home Assistant client initialized"
tests:
  sample.lib.homeassistant:
    platform_allow: native_sim
```

## prj.conf
```kconfig
# Enable networking
CONFIG_NETWORKING=y
CONFIG_NET_IPV4=y
CONFIG_NET_IPV6=n

# Enable networking services
CONFIG_NET_SOCKETS=y
CONFIG_NET_SOCKETS_POSIX_NAMES=y

# Enable DNS resolver
CONFIG_DNS_RESOLVER=y
CONFIG_DNS_RESOLVER_ADDITIONAL_BUF_CTR=5
CONFIG_DNS_RESOLVER_MAX_SERVERS=1

# Enable MQTT
CONFIG_MQTT_LIB=y

# Enable HTTP client
CONFIG_HTTP_CLIENT=y

# Enable JSON library
CONFIG_JSON_LIBRARY=y

# Enable Home Assistant integration
CONFIG_HOMEASSISTANT=y
CONFIG_HOMEASSISTANT_MQTT_DISCOVERY=y

# Logging
CONFIG_LOG=y
CONFIG_HOMEASSISTANT_LOG_LEVEL_DBG=y

# Networking buffers
CONFIG_NET_PKT_RX_COUNT=16
CONFIG_NET_PKT_TX_COUNT=16
CONFIG_NET_BUF_RX_COUNT=16
CONFIG_NET_BUF_TX_COUNT=16

# Memory
CONFIG_MAIN_STACK_SIZE=4096
CONFIG_HEAP_MEM_POOL_SIZE=8192
```

## src/main.c
```c
/*
 * Copyright (c) 2025
 * SPDX-License-Identifier: Apache-2.0
 */

#include <zephyr/kernel.h>
#include <zephyr/logging/log.h>
#include <zephyr/homeassistant.h>
#include <stdio.h>

LOG_MODULE_REGISTER(app, LOG_LEVEL_INF);

/* MQTT broker configuration - can be overridden via Kconfig */
#define MQTT_BROKER CONFIG_HOMEASSISTANT_MQTT_BROKER
#define MQTT_PORT CONFIG_HOMEASSISTANT_MQTT_PORT

/* Simulated temperature sensor */
static float current_temperature = 22.5f;

static void update_temperature(void)
{
	/* Simulate temperature changes */
	current_temperature += ((float)(sys_rand32_get() % 20) - 10.0f) / 10.0f;

	/* Keep in reasonable range */
	if (current_temperature < 15.0f) {
		current_temperature = 15.0f;
	} else if (current_temperature > 30.0f) {
		current_temperature = 30.0f;
	}
}

int main(void)
{
	int ret;

	LOG_INF("Home Assistant Integration Sample");

	/* Wait for network to be ready */
	k_sleep(K_SECONDS(2));

	/* Configure Home Assistant client */
	struct homeassistant_config config = {
		.mqtt_broker = MQTT_BROKER,
		.mqtt_port = MQTT_PORT,
		.mqtt_username = NULL,
		.mqtt_password = NULL,
		.discovery_prefix = "homeassistant",
		.device = {
			.name = "Zephyr Device",
			.manufacturer = "Zephyr Project",
			.model = "Sample Device",
			.sw_version = "1.0.0",
			.identifier = "zephyr_device_001",
		},
	};

	/* Initialize Home Assistant client */
	struct homeassistant_client *client = homeassistant_init(&config);

	if (!client) {
		LOG_ERR("Failed to initialize Home Assistant client");
		return -1;
	}

	/* Connect to MQTT broker */
	ret = homeassistant_connect(client);
	if (ret < 0) {
		LOG_ERR("Failed to connect to Home Assistant: %d", ret);
		homeassistant_deinit(client);
		return -1;
	}

	/* Wait for connection to establish */
	k_sleep(K_MSEC(500));

	/* Register a temperature sensor entity */
	struct homeassistant_entity temp_sensor = {
		.type = HOMEASSISTANT_ENTITY_SENSOR,
		.name = "Temperature Sensor",
		.unique_id = "temp_sensor",
		.sensor_class = HOMEASSISTANT_SENSOR_TEMPERATURE,
		.unit_of_measurement = "°C",
		.state_topic = "homeassistant/state/zephyr_device_001/temp_sensor",
		.command_topic = NULL,
	};

	ret = homeassistant_register_entity(client, &temp_sensor);
	if (ret < 0) {
		LOG_ERR("Failed to register temperature sensor: %d", ret);
	}

	/* Main loop - update temperature every 5 seconds */
	while (1) {
		char state_str[32];

		update_temperature();

		snprintf(state_str, sizeof(state_str), "%.1f",
			 current_temperature);

		ret = homeassistant_update_state(client, "temp_sensor",
						 state_str);
		if (ret < 0) {
			LOG_ERR("Failed to update state: %d", ret);
		} else {
			LOG_INF("Temperature: %.1f°C", current_temperature);
		}

		/* Process MQTT events */
		homeassistant_process(client, 100);

		k_sleep(K_SECONDS(5));
	}

	/* Cleanup (never reached in this sample) */
	homeassistant_disconnect(client);
	homeassistant_deinit(client);

	return 0;
}
```
