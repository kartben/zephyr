## prj.conf
```kconfig
# General config
CONFIG_MAIN_STACK_SIZE=1088
CONFIG_NEWLIB_LIBC=y
CONFIG_POSIX_API=y
CONFIG_SNTP=y
CONFIG_NET_CONFIG_CLOCK_SNTP_INIT=y
CONFIG_NET_CONFIG_SNTP_INIT_SERVER="time.nist.gov"

# Networking config
CONFIG_NETWORKING=y
CONFIG_NET_IPV4=y
CONFIG_NET_IPV6=y
CONFIG_NET_TCP=y
CONFIG_NET_SOCKETS=y

CONFIG_DNS_RESOLVER=y
CONFIG_DNS_SERVER_IP_ADDRESSES=y
CONFIG_DNS_SERVER1="192.0.2.2"

# Network driver config
CONFIG_TEST_RANDOM_GENERATOR=y

# Network address config
CONFIG_NET_CONFIG_SETTINGS=y
CONFIG_NET_CONFIG_NEED_IPV4=y
CONFIG_NET_CONFIG_MY_IPV4_ADDR="192.0.2.1"
CONFIG_NET_CONFIG_PEER_IPV4_ADDR="192.0.2.2"
CONFIG_NET_CONFIG_MY_IPV4_GW="192.0.2.2"

# Network debug config
CONFIG_NET_LOG=y


CONFIG_THREAD_NAME=y
```

## src/main.c
```c
#include <stdio.h>
#include <stdlib.h>
#include <pthread.h>
#include <string.h>

// Shared counter and spin lock
int counter = 0;
pthread_spinlock_t spinlock;

// Thread function to increment counter
void* increment_counter(void* arg) {
    char thread_name[16];
    strncpy(thread_name, (char*) arg, sizeof(thread_name) - 1);
    thread_name[sizeof(thread_name) - 1] = '\0';  // Null-terminate
    pthread_setname_np(pthread_self(), thread_name);

    int rounds = 100000;  // Hard-coded for demonstration

    for (int i = 0; i < rounds; i++) {
        pthread_spin_lock(&spinlock);  // Lock the counter
        counter++;

        // Print a message every 1000 increments
        if (counter % 1000 == 0) {
            printf("%s: Counter value %d\n", thread_name, counter);
        }

        pthread_spin_unlock(&spinlock);  // Unlock the counter
    }

    return NULL;
}

int main() {
    pthread_t t1, t2;

    // Initialize the spin lock
    pthread_spin_init(&spinlock, 0);

    // Create threads
    pthread_create(&t1, NULL, increment_counter, (void*)"Thread 1");
    pthread_create(&t2, NULL, increment_counter, (void*)"Thread 2");

    // Wait for both threads to finish
    pthread_join(t1, NULL);
    pthread_join(t2, NULL);

    // Destroy the spin lock
    pthread_spin_destroy(&spinlock);

    printf("Final counter value: %d\n", counter);

    return 0;
}
```
