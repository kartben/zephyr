/*
 * Example overlay demonstrating a DISABLED devicetree node scenario.
 * 
 * To use this overlay:
 * 1. Copy this file to your build directory as an overlay
 * 2. Modify src/main.c to remove the #if guards around SENSOR_NODE usage
 * 3. Build with: west build -b <board> -- -DZEPHYR_SCA_VARIANT=dtdoctor
 * 
 * dtdoctor will help diagnose the error by explaining that the node is
 * disabled and suggesting how to enable it.
 */

/ {
	aliases {
		demo-sensor = &demo_sensor;
	};
};

&i2c0 {
	demo_sensor: sensor@40 {
		compatible = "bosch,bme280";
		reg = <0x40>;
		status = "disabled";  /* Intentionally disabled to trigger error */
	};
};
