## CMakeLists.txt
```
# SPDX-License-Identifier: Apache-2.0

cmake_minimum_required(VERSION 3.20.0)

find_package(Zephyr REQUIRED HINTS $ENV{ZEPHYR_BASE})
project(smart_sensor_hub)

target_sources(app PRIVATE
  src/main.c
  src/sensor_sim.c
  src/alert_engine.c
)
```

## sample.yaml
```
sample:
  name: Smart Sensor Hub — Zephyr 4.4 Feature Showcase
  description: |
    Industrial environment monitoring demo showcasing Zephyr 4.4 highlights:
    scope-based cleanup helpers, zbus pub/sub messaging, and the ztest
    benchmark framework.
tests:
  sample.demo.smart_sensor_hub:
    tags:
      - zbus
      - cleanup
      - demo
    platform_allow:
      - native_sim
      - native_sim/native/64
    harness: console
    harness_config:
      type: multi_line
      ordered: true
      regex:
        - "Smart Sensor Hub.*started"
        - "ALERT"
```

## prj.conf
```kconfig
# Copyright (c) 2025 The Zephyr Project Contributors
# SPDX-License-Identifier: Apache-2.0

# Logging
CONFIG_LOG=y
CONFIG_LOG_MODE_DEFERRED=y

# Zbus messaging
CONFIG_ZBUS=y
CONFIG_ZBUS_LOG_LEVEL_INF=y
CONFIG_ZBUS_CHANNEL_NAME=y
CONFIG_ZBUS_OBSERVER_NAME=y

# Scope-based cleanup helpers (Zephyr 4.4 feature)
CONFIG_SCOPE_CLEANUP_HELPERS=y

# Heap for dynamic allocation used in scope_var demo
CONFIG_HEAP_MEM_POOL_SIZE=4096

# Stack sizes
CONFIG_MAIN_STACK_SIZE=2048
CONFIG_SYSTEM_WORKQUEUE_STACK_SIZE=2048
```

## src/main.c
```c
/*
 * Copyright (c) 2025 The Zephyr Project Contributors
 * SPDX-License-Identifier: Apache-2.0
 *
 * Smart Sensor Hub — Zephyr 4.4 Feature Showcase
 * ================================================
 *
 * A factory-floor environmental monitoring station that demonstrates several
 * headline features introduced in Zephyr 4.4:
 *
 *   • **Zbus** publish/subscribe messaging between decoupled modules
 *   • **Scope-based cleanup helpers** (scope_var, scope_guard) for
 *     automatic, exception-safe resource management in C
 *   • **Ztest benchmarking framework** (in the companion benchmark/ app)
 *
 * Architecture
 * ------------
 *
 *   sensor_sim  ──►  [ sensor_data_chan ]  ──►  alert_engine
 *                                                    │
 *                                                    ▼
 *                                             [ alert_chan ]
 *                                                    │
 *                                                    ▼
 *                                             alert_listener (log)
 *
 * The application runs entirely on native_sim — no hardware required.
 */

#include <zephyr/kernel.h>
#include <zephyr/logging/log.h>
#include <zephyr/zbus/zbus.h>

#include "channels.h"
#include "sensor_sim.h"
#include "alert_engine.h"

LOG_MODULE_REGISTER(main, LOG_LEVEL_INF);

/* -------- Zbus channel definitions (one place, shared via channels.h) ---- */

ZBUS_CHAN_DEFINE(sensor_data_chan,       /* Name */
		 struct sensor_reading,  /* Message type */
		 NULL,                   /* Validator */
		 NULL,                   /* User data */
		 ZBUS_OBSERVERS_EMPTY,   /* Observers added at compile-time via
					  * ZBUS_CHAN_ADD_OBS in each module
					  */
		 ZBUS_MSG_INIT(.temperature_mcelsius = 0,
			       .humidity_mpercent = 0,
			       .pressure_mpa = 0,
			       .seq = 0)
);

ZBUS_CHAN_DEFINE(alert_chan,              /* Name */
		 struct alert_event,     /* Message type */
		 NULL,                   /* Validator */
		 NULL,                   /* User data */
		 ZBUS_OBSERVERS_EMPTY,   /* Observers added at compile-time via
					  * ZBUS_CHAN_ADD_OBS in each module
					  */
		 ZBUS_MSG_INIT(.severity = 0,
			       .sensor_id = 0,
			       .value = 0,
			       .threshold = 0)
);

/* -------- Entry point ---------------------------------------------------- */

int main(void)
{
	LOG_INF("==========================================================");
	LOG_INF("  Smart Sensor Hub — Zephyr 4.4 Feature Showcase started");
	LOG_INF("==========================================================");
	LOG_INF("");
	LOG_INF("Features demonstrated:");
	LOG_INF("  [1] Zbus pub/sub messaging (sensor -> alert pipeline)");
	LOG_INF("  [2] Scope-based cleanup helpers (scope_var, scope_guard)");
	LOG_INF("  [3] Ztest benchmark framework (see benchmark/ sub-app)");
	LOG_INF("");

	sensor_sim_start();
	alert_engine_start();

	LOG_INF("All modules running. Watching for threshold breaches...");
	LOG_INF("");

	return 0;
}
```

## src/alert_engine.c
```c
/*
 * Copyright (c) 2025 The Zephyr Project Contributors
 * SPDX-License-Identifier: Apache-2.0
 *
 * Smart Sensor Hub — Alert Engine
 * ================================
 *
 * Subscribes to sensor_data_chan via zbus, evaluates safety thresholds, and
 * publishes alert_event messages when breached.  Demonstrates:
 *
 *   1. **Zbus subscriber** — blocking wait on channel updates.
 *   2. **Zbus listener** — synchronous callback for lightweight reactions.
 *   3. **Scope-based guard** — automatic mutex lock/unlock using
 *      `scope_guard` so the critical section is always exited, even on
 *      error paths (Zephyr 4.4 feature).
 */

#include <zephyr/kernel.h>
#include <zephyr/logging/log.h>
#include <zephyr/cleanup.h>
#include <zephyr/zbus/zbus.h>

#include "channels.h"
#include "alert_engine.h"

LOG_MODULE_REGISTER(alert_engine, LOG_LEVEL_INF);

/* ---------- Thresholds --------------------------------------------------- */

#define TEMP_WARN_MC   26000   /* 26 °C — warning */
#define TEMP_CRIT_MC   29000   /* 29 °C — critical */
#define HUM_WARN_MP    55000   /* 55 %  — warning */
#define HUM_CRIT_MP    58000   /* 58 %  — critical */

/* Severity levels — keep in sync with struct alert_event.severity */
#define SEV_INFO     0
#define SEV_WARNING  1
#define SEV_CRITICAL 2

/* ---------- Alert statistics (guarded by a mutex) ------------------------ */

static struct {
	uint32_t warnings;
	uint32_t criticals;
	uint32_t total_readings;
} alert_stats;

static K_MUTEX_DEFINE(stats_mutex);

/* ---------- Zephyr 4.4 Feature: scope_guard for mutex -------------------- */

/*
 * SCOPE_GUARD_DEFINE creates a guard type that acquires a lock on
 * initialisation and releases it when the variable goes out of scope.
 * Using `scope_guard(k_mutex)(&stats_mutex)` in a function body means
 * the mutex is *always* unlocked — no matter how the function returns.
 */
SCOPE_GUARD_DEFINE(k_mutex, struct k_mutex *,
		   (void)k_mutex_lock(_T, K_FOREVER),
		   (void)k_mutex_unlock(_T));

/**
 * Update statistics safely using a scope-guarded mutex.
 *
 * The `scope_guard(k_mutex)` call locks the mutex and automatically unlocks
 * it when this function returns — even on early exit.
 */
static void record_alert(uint8_t severity)
{
	scope_guard(k_mutex)(&stats_mutex);

	/* Mutex is held from this point until scope exit. */

	if (severity == SEV_WARNING) {
		alert_stats.warnings++;
	} else if (severity == SEV_CRITICAL) {
		alert_stats.criticals++;
	}
}

static void record_reading(void)
{
	scope_guard(k_mutex)(&stats_mutex);

	alert_stats.total_readings++;
}

/* ---------- Threshold evaluation ----------------------------------------- */

static void check_and_alert(const struct sensor_reading *reading)
{
	struct alert_event evt = {0};

	record_reading();

	/* Temperature checks */
	if (reading->temperature_mcelsius >= TEMP_CRIT_MC) {
		evt.severity  = SEV_CRITICAL;
		evt.sensor_id = 0; /* temperature */
		evt.value     = reading->temperature_mcelsius;
		evt.threshold = TEMP_CRIT_MC;

		LOG_ERR("ALERT [CRITICAL] Temperature %d.%03d°C >= %d.%03d°C",
			reading->temperature_mcelsius / 1000,
			reading->temperature_mcelsius % 1000,
			TEMP_CRIT_MC / 1000, TEMP_CRIT_MC % 1000);

		record_alert(SEV_CRITICAL);
		zbus_chan_pub(&alert_chan, &evt, K_MSEC(200));
	} else if (reading->temperature_mcelsius >= TEMP_WARN_MC) {
		evt.severity  = SEV_WARNING;
		evt.sensor_id = 0;
		evt.value     = reading->temperature_mcelsius;
		evt.threshold = TEMP_WARN_MC;

		LOG_WRN("ALERT [WARNING]  Temperature %d.%03d°C >= %d.%03d°C",
			reading->temperature_mcelsius / 1000,
			reading->temperature_mcelsius % 1000,
			TEMP_WARN_MC / 1000, TEMP_WARN_MC % 1000);

		record_alert(SEV_WARNING);
		zbus_chan_pub(&alert_chan, &evt, K_MSEC(200));
	}

	/* Humidity checks */
	if (reading->humidity_mpercent >= HUM_CRIT_MP) {
		evt.severity  = SEV_CRITICAL;
		evt.sensor_id = 1; /* humidity */
		evt.value     = reading->humidity_mpercent;
		evt.threshold = HUM_CRIT_MP;

		LOG_ERR("ALERT [CRITICAL] Humidity %d.%03d%% >= %d.%03d%%",
			reading->humidity_mpercent / 1000,
			reading->humidity_mpercent % 1000,
			HUM_CRIT_MP / 1000, HUM_CRIT_MP % 1000);

		record_alert(SEV_CRITICAL);
		zbus_chan_pub(&alert_chan, &evt, K_MSEC(200));
	} else if (reading->humidity_mpercent >= HUM_WARN_MP) {
		evt.severity  = SEV_WARNING;
		evt.sensor_id = 1;
		evt.value     = reading->humidity_mpercent;
		evt.threshold = HUM_WARN_MP;

		LOG_WRN("ALERT [WARNING]  Humidity %d.%03d%% >= %d.%03d%%",
			reading->humidity_mpercent / 1000,
			reading->humidity_mpercent % 1000,
			HUM_WARN_MP / 1000, HUM_WARN_MP % 1000);

		record_alert(SEV_WARNING);
		zbus_chan_pub(&alert_chan, &evt, K_MSEC(200));
	}
}

/* ---------- Zbus subscriber (blocking wait in dedicated thread) ---------- */

ZBUS_SUBSCRIBER_DEFINE(alert_sub, 4);
ZBUS_CHAN_ADD_OBS(sensor_data_chan, alert_sub, 0);

static void alert_thread_fn(void *p1, void *p2, void *p3)
{
	ARG_UNUSED(p1);
	ARG_UNUSED(p2);
	ARG_UNUSED(p3);

	const struct zbus_channel *chan;

	LOG_INF("Alert engine thread started — monitoring thresholds");

	while (!zbus_sub_wait(&alert_sub, &chan, K_FOREVER)) {
		if (chan == &sensor_data_chan) {
			struct sensor_reading reading;

			zbus_chan_read(&sensor_data_chan, &reading, K_MSEC(500));
			check_and_alert(&reading);
		}
	}
}

K_THREAD_DEFINE(alert_engine_tid, 1024, alert_thread_fn,
		NULL, NULL, NULL, 4, 0, 0);

/* ---------- Zbus listener for alert logging ------------------------------ */

static void alert_listener_cb(const struct zbus_channel *chan)
{
	const struct alert_event *evt = zbus_chan_const_msg(chan);
	const char *sev_str = (evt->severity == SEV_CRITICAL) ? "CRITICAL"
			    : (evt->severity == SEV_WARNING)  ? "WARNING"
							      : "INFO";

	LOG_INF(">>> Alert dispatched: severity=%s sensor=%u value=%d threshold=%d",
		sev_str, evt->sensor_id, evt->value, evt->threshold);
}

ZBUS_LISTENER_DEFINE(alert_listener, alert_listener_cb);
ZBUS_CHAN_ADD_OBS(alert_chan, alert_listener, 0);

/* ---------- Periodic statistics report ----------------------------------- */

static void stats_timer_handler(struct k_timer *timer)
{
	ARG_UNUSED(timer);

	scope_guard(k_mutex)(&stats_mutex);

	LOG_INF("--- Stats: %u readings | %u warnings | %u criticals ---",
		alert_stats.total_readings,
		alert_stats.warnings,
		alert_stats.criticals);
}

K_TIMER_DEFINE(stats_timer, stats_timer_handler, NULL);

void alert_engine_start(void)
{
	/* Print stats every 10 seconds. */
	k_timer_start(&stats_timer, K_SECONDS(10), K_SECONDS(10));
	LOG_INF("Alert engine module initialised");
}
```

## src/alert_engine.h
```c
/*
 * Copyright (c) 2025 The Zephyr Project Contributors
 * SPDX-License-Identifier: Apache-2.0
 */

#ifndef SMART_SENSOR_HUB_ALERT_ENGINE_H_
#define SMART_SENSOR_HUB_ALERT_ENGINE_H_

/**
 * @file alert_engine.h
 * @brief Alert engine — subscribes to sensor data via zbus, evaluates
 *        thresholds and publishes alert events.  Uses scope-based cleanup
 *        guards for safe mutex handling.
 */

/** Start the alert engine (called from main). */
void alert_engine_start(void);

#endif /* SMART_SENSOR_HUB_ALERT_ENGINE_H_ */
```

## src/channels.h
```c
/*
 * Copyright (c) 2025 The Zephyr Project Contributors
 * SPDX-License-Identifier: Apache-2.0
 */

/**
 * @file channels.h
 * @brief Zbus channel declarations for the Smart Sensor Hub.
 *
 * Demonstrates the Zephyr 4.4 zbus pub/sub API: channels are defined once and
 * shared across modules via ZBUS_CHAN_DECLARE.
 */

#ifndef SMART_SENSOR_HUB_CHANNELS_H_
#define SMART_SENSOR_HUB_CHANNELS_H_

#include <zephyr/zbus/zbus.h>

/** Sensor reading published by the sensor simulation module. */
struct sensor_reading {
	int32_t temperature_mcelsius; /**< Temperature in milli-°C */
	int32_t humidity_mpercent;    /**< Relative humidity in milli-% */
	int32_t pressure_mpa;        /**< Atmospheric pressure in milli-Pa */
	uint32_t seq;                /**< Monotonic sequence number */
};

/** Alert raised by the alert engine when a threshold is breached. */
struct alert_event {
	uint8_t severity;   /**< 0 = info, 1 = warning, 2 = critical */
	uint8_t sensor_id;  /**< Which sensor triggered the alert */
	int32_t value;      /**< The offending value */
	int32_t threshold;  /**< The threshold that was breached */
};

ZBUS_CHAN_DECLARE(sensor_data_chan, alert_chan);

#endif /* SMART_SENSOR_HUB_CHANNELS_H_ */
```

## src/sensor_sim.c
```c
/*
 * Copyright (c) 2025 The Zephyr Project Contributors
 * SPDX-License-Identifier: Apache-2.0
 *
 * Smart Sensor Hub — Zephyr 4.4 Feature Showcase
 * ================================================
 *
 * Simulated sensor module that publishes environmental readings on a
 * zbus channel.  Demonstrates two Zephyr 4.4 features:
 *
 *   1. **Zbus pub/sub** — decoupled, type-safe data flow between modules.
 *   2. **Scope-based cleanup helpers** — RAII / defer-style automatic
 *      resource management using `scope_var` and `SCOPE_VAR_DEFINE`.
 *
 * The cleanup helpers ensure that a dynamically-allocated calibration
 * context is always freed, even on early-return error paths — a pattern
 * that eliminates an entire class of resource-leak bugs in embedded C.
 */

#include <zephyr/kernel.h>
#include <zephyr/logging/log.h>
#include <zephyr/cleanup.h>
#include <zephyr/zbus/zbus.h>

#include "channels.h"
#include "sensor_sim.h"

LOG_MODULE_REGISTER(sensor_sim, LOG_LEVEL_INF);

/* ---------- Zephyr 4.4 Feature: scope-based cleanup ----------------------
 *
 * We define a "calibration context" that is heap-allocated and must be freed
 * after every reading cycle.  `SCOPE_VAR_DEFINE` + `scope_var` guarantee
 * automatic cleanup — even if the function returns early due to an error.
 */

/** Opaque calibration context — allocated per reading cycle. */
struct cal_ctx {
	int32_t temp_offset;
	int32_t hum_offset;
	int32_t pres_offset;
};

static struct cal_ctx *cal_ctx_create(int32_t t_off, int32_t h_off, int32_t p_off)
{
	struct cal_ctx *ctx = k_malloc(sizeof(*ctx));

	if (ctx != NULL) {
		ctx->temp_offset = t_off;
		ctx->hum_offset  = h_off;
		ctx->pres_offset = p_off;
	}
	return ctx;
}

static void cal_ctx_destroy(struct cal_ctx *ctx)
{
	if (ctx != NULL) {
		LOG_DBG("  [scope cleanup] freeing calibration context %p", ctx);
		k_free(ctx);
	}
}

/*
 * SCOPE_VAR_DEFINE ties the type, destructor and constructor together so that
 * a variable declared with `scope_var(cal, name)(args)` is automatically
 * destroyed when the enclosing scope exits.
 */
SCOPE_VAR_DEFINE(cal, struct cal_ctx *, cal_ctx_destroy(_T),
		 cal_ctx_create(t_off, h_off, p_off),
		 int32_t t_off, int32_t h_off, int32_t p_off);

/* ---------- Simulated sensor baseline + drift ---------------------------- */

#define BASE_TEMP_MC    22000   /* 22.000 °C */
#define BASE_HUM_MP     45000   /* 45.000 %  */
#define BASE_PRES_MPA   101325  /* 101.325 kPa — stored in milli-units to keep
				 * the demo integer-only; the field name in the
				 * struct is `pressure_mpa` (milli-Pa).
				 */

/** Simple deterministic "noise" that varies with the sequence counter. */
static int32_t pseudo_drift(uint32_t seq, int32_t amplitude)
{
	/* Triangular wave: ramps up for 10 samples, then back down. */
	int32_t phase = seq % 20;

	if (phase >= 10) {
		phase = 20 - phase;
	}
	return (amplitude * phase) / 10;
}

/* ---------- Reading cycle ------------------------------------------------ */

/**
 * Perform one sensor reading cycle.
 *
 * The calibration context is allocated with `scope_var` so it is freed
 * automatically at scope exit — no explicit `k_free()` needed, even if we
 * add early-return error handling later.
 */
static int sensor_read_cycle(uint32_t seq, struct sensor_reading *out)
{
	/* scope_var(cal, ctx)(args) — allocates AND registers cleanup. */
	scope_var(cal, ctx)(0, 0, 0);

	if (ctx == NULL) {
		LOG_ERR("Failed to allocate calibration context");
		return -ENOMEM;
		/* ctx is NULL so cal_ctx_destroy is a safe no-op. */
	}

	/* Apply simulated drift + calibration offsets. */
	out->temperature_mcelsius = BASE_TEMP_MC
				  + pseudo_drift(seq, 8000)
				  + ctx->temp_offset;

	out->humidity_mpercent    = BASE_HUM_MP
				  + pseudo_drift(seq + 5, 15000)
				  + ctx->hum_offset;

	out->pressure_mpa         = BASE_PRES_MPA
				  + pseudo_drift(seq + 3, 500)
				  + ctx->pres_offset;

	out->seq = seq;

	/* ctx is freed here automatically by scope_var cleanup. */
	return 0;
}

/* ---------- Sensor thread ------------------------------------------------ */

#define SENSOR_INTERVAL_MS 2000

static void sensor_thread_fn(void *p1, void *p2, void *p3)
{
	ARG_UNUSED(p1);
	ARG_UNUSED(p2);
	ARG_UNUSED(p3);

	uint32_t seq = 0;

	LOG_INF("Sensor simulation thread started (interval %d ms)", SENSOR_INTERVAL_MS);

	while (true) {
		struct sensor_reading reading;
		int ret = sensor_read_cycle(seq, &reading);

		if (ret == 0) {
			LOG_INF("Sensor [#%u] T=%d.%03d°C  H=%d.%03d%%  P=%d.%03d kPa",
				reading.seq,
				reading.temperature_mcelsius / 1000,
				reading.temperature_mcelsius % 1000,
				reading.humidity_mpercent / 1000,
				reading.humidity_mpercent % 1000,
				reading.pressure_mpa / 1000,
				reading.pressure_mpa % 1000);

			/* Publish on zbus — any subscriber/listener picks it up. */
			ret = zbus_chan_pub(&sensor_data_chan, &reading, K_MSEC(500));
			if (ret < 0) {
				LOG_ERR("Failed to publish sensor data: %d", ret);
			}
		}

		seq++;
		k_msleep(SENSOR_INTERVAL_MS);
	}
}

K_THREAD_DEFINE(sensor_sim_tid, 1024, sensor_thread_fn,
		NULL, NULL, NULL, 5, 0, 0);

void sensor_sim_start(void)
{
	/* Thread is auto-started by K_THREAD_DEFINE — this function is a
	 * placeholder for any future one-time init.
	 */
	LOG_INF("Sensor simulation module initialised");
}
```

## src/sensor_sim.h
```c
/*
 * Copyright (c) 2025 The Zephyr Project Contributors
 * SPDX-License-Identifier: Apache-2.0
 */

#ifndef SMART_SENSOR_HUB_SENSOR_SIM_H_
#define SMART_SENSOR_HUB_SENSOR_SIM_H_

/**
 * @file sensor_sim.h
 * @brief Simulated sensor module — reads synthetic environment data and
 *        publishes it on the zbus ``sensor_data_chan`` channel.
 */

/** Start the sensor simulation (called from main). */
void sensor_sim_start(void);

#endif /* SMART_SENSOR_HUB_SENSOR_SIM_H_ */
```
