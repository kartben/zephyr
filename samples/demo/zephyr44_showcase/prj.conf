## CMakeLists.txt
```
# SPDX-License-Identifier: Apache-2.0
# Copyright (c) 2026 The Zephyr Project Contributors

cmake_minimum_required(VERSION 3.20.0)

find_package(Zephyr REQUIRED HINTS $ENV{ZEPHYR_BASE})
project(securevault_node)

target_sources(app PRIVATE
  src/main.c
  src/auth.c
  src/monitor.c
  src/shell.c
  src/report.c
)

# WireGuard stack is optional (zephyr-wireguard west module). report.c is always
# built; the full VPN path is compiled only when CONFIG_WIREGUARD=y (see report.c).
# Build without WireGuard: west build ... -- -DCONFIG_WIREGUARD=n
if(CONFIG_WIREGUARD)
  zephyr_library_include_directories(
    ${ZEPHYR_WIREGUARD_MODULE_DIR}/include
  )
endif()
```

## sample.yaml
```
sample:
  name: SecureVault Node — Zephyr 4.4 Feature Showcase
  description: >
    Demonstrates six Zephyr 4.4 new features (Biometrics API, Scope-based
    Cleanup, WireGuard VPN, CPU Frequency Pressure Policy, shell_readline,
    and ztest Benchmark Framework) through a secure facility monitoring
    application.
tests:
  sample.demo.zephyr44_showcase:
    tags: introduction
    platform_allow:
      - native_sim
    harness: console
    harness_config:
      type: one_line
      regex:
        - "Shell ready"
```

## prj.conf
```kconfig
# SPDX-License-Identifier: Apache-2.0
#
# SecureVault Node — Zephyr 4.4 Feature Showcase
# ================================================
# This demo intentionally enables one Kconfig option per new 4.4 feature so
# that every CONFIG_* below can be pointed at a specific release note entry.

# --------------------------------------------------------------------------
# [4.4 NEW] Biometrics driver subsystem
# --------------------------------------------------------------------------
CONFIG_BIOMETRICS=y
# Emulated driver is auto-selected when DT node is present (native_sim.overlay)

# --------------------------------------------------------------------------
# [4.4 NEW] Scope-based cleanup helpers (RAII in C)
# Requires compiler __cleanup__ attribute — available on GCC/Clang/LLVM.
# --------------------------------------------------------------------------
CONFIG_SCOPE_CLEANUP_HELPERS=y

# --------------------------------------------------------------------------
# [4.4 NEW] CPU Frequency Scaling — pressure-based policy
# CONFIG_CPU_FREQ_PSTATE_SET_STUB=y lets the policy run on any target even
# without real DVFS hardware, making the demo portable to native_sim.
# --------------------------------------------------------------------------
CONFIG_CPU_FREQ=y
CONFIG_CPU_FREQ_POLICY_PRESSURE=y
CONFIG_CPU_FREQ_PSTATE_SET_STUB=y
CONFIG_CPU_FREQ_INTERVAL_MS=1000
# Track threads from priority 1 (high) down to priority 10 (low)
CONFIG_CPU_FREQ_POLICY_PRESSURE_LOWEST_PRIO=10

# --------------------------------------------------------------------------
# Shell (shell_readline() — new helper in 4.4)
# --------------------------------------------------------------------------
CONFIG_SHELL=y
CONFIG_SHELL_BACKEND_SERIAL=y
CONFIG_SHELL_STACK_SIZE=4096

# --------------------------------------------------------------------------
# [4.4 NEW] WireGuard VPN (EXPERIMENTAL — guard-disabled by default here;
# set CONFIG_WIREGUARD=y and add the zephyr-wireguard module to enable)
# --------------------------------------------------------------------------
# CONFIG_WIREGUARD=y  # uncomment when zephyr-wireguard module is present

# --------------------------------------------------------------------------
# Networking stack (needed for WireGuard path; kept minimal otherwise)
# --------------------------------------------------------------------------
CONFIG_NETWORKING=y
CONFIG_NET_IPV4=y
CONFIG_NET_UDP=y
CONFIG_NET_SOCKETS=y
CONFIG_NET_LOG=y
CONFIG_NET_L2_DUMMY=y
CONFIG_TEST_RANDOM_GENERATOR=y

# --------------------------------------------------------------------------
# Sensor
# --------------------------------------------------------------------------
CONFIG_SENSOR=y

# --------------------------------------------------------------------------
# Logging
# --------------------------------------------------------------------------
CONFIG_LOG=y
CONFIG_LOG_DEFAULT_LEVEL=3

# --------------------------------------------------------------------------
# General
# --------------------------------------------------------------------------
CONFIG_PRINTK=y
CONFIG_MAIN_STACK_SIZE=4096
CONFIG_SYSTEM_WORKQUEUE_STACK_SIZE=2048
CONFIG_HEAP_MEM_POOL_SIZE=8192
```

## boards/native_sim_native_64.overlay
```dts
/*
 * SPDX-License-Identifier: Apache-2.0
 *
 * native_sim devicetree overlay for the SecureVault Node demo.
 *
 * Adds the biometrics emulator node (new in Zephyr 4.4) so the demo
 * runs without any physical fingerprint hardware.
 */

/ {
	aliases {
		/* "fingerprint" alias consumed by src/auth.c */
		fingerprint = &biometrics_emul;
	};

	/*
	 * [4.4 NEW] zephyr,biometrics-emul — emulated fingerprint sensor.
	 * Backed by drivers/biometrics/biometrics_emul.c which ships in-tree.
	 * On real hardware replace this node with e.g. a ZFM-x0 or GT5x node.
	 */
	biometrics_emul: biometrics-emul {
		compatible = "zephyr,biometrics-emul";
		status = "okay";
	};
};
```

## src/main.c
```c
/*
 * SPDX-License-Identifier: Apache-2.0
 * Copyright (c) 2026 The Zephyr Project Contributors
 *
 * SecureVault Node — application entry point
 *
 * ┌─────────────────────────────────────────────────────────────────────────┐
 * │  Zephyr 4.4 Feature Showcase — "SecureVault Node"                      │
 * │                                                                         │
 * │  Business scenario                                                      │
 * │  ─────────────────                                                      │
 * │  A compact IoT node deployed in sensitive facilities (data centres,    │
 * │  pharmaceutical clean rooms, industrial control rooms).  Each node:    │
 * │                                                                         │
 * │    • Authenticates field engineers via fingerprint before allowing      │
 * │      any local reconfiguration.                                         │
 * │    • Continuously monitors temperature and humidity.                    │
 * │    • Transmits telemetry over an encrypted WireGuard VPN tunnel.       │
 * │    • Adapts CPU frequency to workload — quiet when idle, fast when     │
 * │      processing alarms.                                                 │
 * │    • Exposes a local shell for technicians using shell_readline() for   │
 * │      interactive confirmation prompts.                                  │
 * │                                                                         │
 * │  Features demonstrated (all new in Zephyr 4.4)                         │
 * │  ──────────────────────────────────────────────                         │
 * │  ① Biometrics API          auth.c                                      │
 * │  ② Scope-based Cleanup     auth.c, report.c                            │
 * │  ③ WireGuard VPN           report.c                                    │
 * │  ④ CPU Freq Pressure Policy monitor.c                                  │
 * │  ⑤ shell_readline()        shell.c                                     │
 * │  ⑥ ztest Benchmark         tests/benchmark/                            │
 * └─────────────────────────────────────────────────────────────────────────┘
 */

#include "auth.h"
#include "monitor.h"
#include "report.h"

#include <stdio.h>
#include <zephyr/kernel.h>
#include <zephyr/logging/log.h>
#include <zephyr/net/net_if.h>
#include <zephyr/net/net_mgmt.h>

LOG_MODULE_REGISTER(main, LOG_LEVEL_INF);

/* How often to send a telemetry report. */
#define REPORT_INTERVAL_SEC 10

/* Track authentication events between reports. */
static uint32_t auth_event_count;

/* -------------------------------------------------------------------------
 * Reporting work item — fires every REPORT_INTERVAL_SEC seconds.
 * ---------------------------------------------------------------------- */
static void report_work_fn(struct k_work *work);
K_WORK_DELAYABLE_DEFINE(report_work, report_work_fn);

static void report_work_fn(struct k_work *work)
{
	struct monitor_reading r;

	monitor_get_latest(&r);
	report_send(&r, auth_event_count);
	auth_event_count = 0;

	k_work_reschedule(&report_work, K_SECONDS(REPORT_INTERVAL_SEC));
}

/* -------------------------------------------------------------------------
 * main
 * ---------------------------------------------------------------------- */
int main(void)
{
	int ret;

	LOG_INF("========================================");
	LOG_INF(" SecureVault Node — Zephyr 4.4 Showcase");
	LOG_INF("========================================");

	/* ----------------------------------------------------------------
	 * ① Biometrics API — initialise the fingerprint sensor.
	 *    On native_sim this binds to the emulated driver from
	 *    boards/native_sim.overlay.
	 * ------------------------------------------------------------- */
	ret = auth_init();
	if (ret < 0) {
		LOG_ERR("auth_init failed: %d — halting", ret);
		return ret;
	}

	/* ----------------------------------------------------------------
	 * ③ WireGuard — set up the VPN tunnel.
	 *    Skipped gracefully when CONFIG_WIREGUARD is not set.
	 * ------------------------------------------------------------- */
	ret = report_init();
	if (ret < 0) {
		LOG_WRN("report_init returned %d — continuing without VPN", ret);
	}

	/* ----------------------------------------------------------------
	 * ④ CPU Frequency Pressure Policy — start the sensor pipeline.
	 *    Three threads at priorities 1, 5, 10 create varying scheduler
	 *    pressure.  The pressure policy (CONFIG_CPU_FREQ_POLICY_PRESSURE)
	 *    raises the CPU P-state when high-priority threads are runnable
	 *    and lowers it when only low-priority work remains.
	 * ------------------------------------------------------------- */
	ret = monitor_init();
	if (ret < 0) {
		LOG_ERR("monitor_init failed: %d", ret);
		return ret;
	}

	/* ----------------------------------------------------------------
	 * Enroll a demo user if the template database is empty.
	 * In production this would be done through the shell after
	 * physical installation.
	 * ------------------------------------------------------------- */
	if (auth_enrolled_count() == 0) {
		LOG_INF("No users enrolled — auto-enrolling demo user 1");
		ret = auth_enroll(1, K_SECONDS(10));
		if (ret == 0) {
			LOG_INF("Demo user 1 enrolled — try: securevault verify 1");
		} else {
			LOG_WRN("Auto-enroll failed (%d); use 'securevault enroll 1'", ret);
		}
	} else {
		LOG_INF("%zu user(s) already enrolled", auth_enrolled_count());
	}

	/* ----------------------------------------------------------------
	 * Start periodic telemetry reporting.
	 * ⑤ shell_readline() is available via 'securevault' shell commands.
	 * ---------------------------------------------------------------- */
	LOG_INF("Starting telemetry reporting every %d seconds", REPORT_INTERVAL_SEC);
	k_work_schedule(&report_work, K_SECONDS(REPORT_INTERVAL_SEC));

	LOG_INF("");
	LOG_INF("Shell ready. Try:");
	LOG_INF("  securevault status");
	LOG_INF("  securevault enroll 2");
	LOG_INF("  securevault identify");
	LOG_INF("  securevault alarm");

	/*
	 * Main thread exits here — the shell, monitor threads, and report
	 * work item keep running.  The CPU freq pressure policy continues to
	 * evaluate the thread ready queue every CONFIG_CPU_FREQ_INTERVAL_MS.
	 */
	return 0;
}
```

## src/auth.c
```c
/*
 * SPDX-License-Identifier: Apache-2.0
 * Copyright (c) 2026 The Zephyr Project Contributors
 *
 * SecureVault Node — biometric authentication module
 *
 * ┌─────────────────────────────────────────────────────────────────────────┐
 * │  Zephyr 4.4 features showcased in this file                            │
 * │                                                                         │
 * │  1. Biometrics API  (include/zephyr/drivers/biometrics.h)              │
 * │     Brand-new driver subsystem for fingerprint / iris / face sensors.  │
 * │     Uniform enroll → capture → finalize workflow across all backends.  │
 * │                                                                         │
 * │  2. Scope-based Cleanup  (include/zephyr/cleanup/kernel.h)             │
 * │     RAII-style resource management in C using __cleanup__ attribute.   │
 * │     scope_guard(k_mutex)  — auto-unlock on any return path.            │
 * │     scope_defer(biometric_enroll_abort) — auto-abort if enroll fails.  │
 * │     Eliminates the error-path goto ladder that embedded C is notorious  │
 * │     for. See "Before / After" comment below for a direct comparison.   │
 * └─────────────────────────────────────────────────────────────────────────┘
 */

#include "auth.h"

#include <zephyr/device.h>
#include <zephyr/drivers/biometrics.h>
#include <zephyr/kernel.h>
#include <zephyr/logging/log.h>

/*
 * [4.4 NEW] Scope-based cleanup — import the pre-defined kernel helpers.
 * This single include gives us: scope_guard(k_mutex), scope_defer(k_free),
 * scope_defer(k_mutex_unlock), scope_defer(k_sem_give), and more.
 */
#include <zephyr/cleanup/kernel.h>

LOG_MODULE_REGISTER(auth, LOG_LEVEL_INF);

/* -------------------------------------------------------------------------
 * Device binding — resolved at boot via DT alias "fingerprint".
 * On native_sim the alias points to the biometrics emulator node added in
 * boards/native_sim.overlay.  On real hardware swap the overlay for a node
 * targeting, e.g., the ZFM-x0 optical sensor or GT5x capacitive sensor.
 * ---------------------------------------------------------------------- */
#define FINGERPRINT_NODE DT_ALIAS(fingerprint)

#if !DT_NODE_EXISTS(FINGERPRINT_NODE)
#error "No 'fingerprint' DT alias found. Add one to your board overlay."
#endif

static const struct device *const fp = DEVICE_DT_GET(FINGERPRINT_NODE);

/*
 * Mutex that protects access to the sensor during multi-step operations
 * (enroll, verify).  Demonstrated with scope_guard below.
 */
static struct k_mutex sensor_mutex;

/* -------------------------------------------------------------------------
 * [4.4 NEW] Custom scope-defer definition for biometric_enroll_abort.
 *
 * SCOPE_DEFER_DEFINE teaches the cleanup framework how to call a function
 * with a specific argument type.  After this line we can write:
 *
 *   scope_defer(biometric_enroll_abort)(fp);
 *
 * …and the compiler guarantees biometric_enroll_abort(fp) will run when
 * the enclosing block exits, whether by return, goto, or fall-through.
 * ---------------------------------------------------------------------- */
SCOPE_DEFER_DEFINE(biometric_enroll_abort, const struct device *);

/* -------------------------------------------------------------------------
 * auth_init
 * ---------------------------------------------------------------------- */
int auth_init(void)
{
	if (!device_is_ready(fp)) {
		LOG_ERR("Fingerprint sensor not ready");
		return -ENODEV;
	}

	k_mutex_init(&sensor_mutex);

	/* Tune the sensor — security level 7 = fewer false accepts. */
	biometric_attr_set(fp, BIOMETRIC_ATTR_SECURITY_LEVEL, 7);

	struct biometric_capabilities caps;

	biometric_get_capabilities(fp, &caps);
	LOG_INF("Fingerprint sensor ready — max %u templates, %u samples/enroll",
		caps.max_templates, caps.enrollment_samples_required);

	return 0;
}

/* -------------------------------------------------------------------------
 * auth_enroll
 *
 * SCOPE CLEANUP SHOWCASE
 * ──────────────────────
 *
 * Before 4.4 (classic goto pattern — hard to read, easy to get wrong):
 *
 *   int auth_enroll_old(uint16_t user_id) {
 *       k_mutex_lock(&sensor_mutex, K_FOREVER);
 *       biometric_enroll_start(fp, user_id);
 *
 *       for (int i = 0; i < required; i++) {
 *           ret = biometric_enroll_capture(fp, K_SECONDS(5), &cap);
 *           if (ret < 0) goto abort;      // must remember to unlock too
 *       }
 *       ret = biometric_enroll_finalize(fp);
 *       goto done;
 *   abort:
 *       biometric_enroll_abort(fp);
 *   done:
 *       k_mutex_unlock(&sensor_mutex);   // easy to forget on every path
 *       return ret;
 *   }
 *
 * After 4.4 (scope cleanup — linear, declarative, compiler-enforced):
 * ---------------------------------------------------------------------- */
int auth_enroll(uint16_t user_id, k_timeout_t timeout)
{
	int ret;

	/*
	 * [4.4 NEW] scope_guard(k_mutex) acquires the mutex NOW and releases
	 * it automatically when this function returns — on any path.
	 */
	scope_guard(k_mutex)(&sensor_mutex);

	biometric_led_control(fp, BIOMETRIC_LED_BREATHE);

	ret = biometric_enroll_start(fp, user_id);
	if (ret < 0) {
		LOG_ERR("enroll_start failed: %d", ret);
		biometric_led_control(fp, BIOMETRIC_LED_OFF);
		return ret;
	}

	/*
	 * [4.4 NEW] scope_defer(biometric_enroll_abort) registers an abort
	 * call that fires if we return before finalize.  After a successful
	 * finalize the sensor resets its own state so the extra abort is
	 * a no-op (returns -EALREADY which we ignore here).
	 *
	 * Without this, every early-return path above would need its own
	 * manual biometric_enroll_abort() — classic C error-path footgun.
	 */
	scope_defer(biometric_enroll_abort)(fp);

	struct biometric_capabilities caps;

	biometric_get_capabilities(fp, &caps);

	struct biometric_capture_result cap = {0};

	do {
		LOG_INF("Place finger… (%u/%u)", cap.samples_captured + 1,
			caps.enrollment_samples_required);

		ret = biometric_enroll_capture(fp, timeout, &cap);
		if (ret < 0) {
			LOG_ERR("Capture failed: %d", ret);
			biometric_led_control(fp, BIOMETRIC_LED_BLINK);
			biometric_led_control(fp, BIOMETRIC_LED_OFF);
			return ret; /* scope_defer fires here → abort called */
		}

		LOG_INF("  Sample %u/%u — quality %u%%", cap.samples_captured,
			caps.enrollment_samples_required, cap.quality);

		if (cap.samples_captured < caps.enrollment_samples_required) {
			LOG_INF("Lift finger and place again…");
			k_sleep(K_MSEC(400));
		}

	} while (cap.samples_captured < caps.enrollment_samples_required);

	ret = biometric_enroll_finalize(fp);
	if (ret == 0) {
		LOG_INF("Enrollment complete for user %u", user_id);
		biometric_led_control(fp, BIOMETRIC_LED_ON);
		k_sleep(K_MSEC(500));
	} else {
		LOG_ERR("Finalize failed: %d", ret);
	}

	biometric_led_control(fp, BIOMETRIC_LED_OFF);

	/*
	 * scope_guard(k_mutex) releases the lock.
	 * scope_defer(biometric_enroll_abort) fires (no-op after finalize).
	 */
	return ret;
}

/* -------------------------------------------------------------------------
 * auth_verify
 * ---------------------------------------------------------------------- */
int auth_verify(uint16_t user_id, k_timeout_t timeout)
{
	struct biometric_match_result result = {0};

	/* scope_guard ensures the mutex is released even on -ETIMEDOUT */
	scope_guard(k_mutex)(&sensor_mutex);

	biometric_led_control(fp, BIOMETRIC_LED_BLINK);

	int ret = biometric_match(fp, BIOMETRIC_MATCH_VERIFY, user_id, timeout, &result);

	biometric_led_control(fp, BIOMETRIC_LED_OFF);

	if (ret == 0) {
		LOG_INF("Authenticated: user %u (confidence %d, quality %u%%)",
			result.template_id, result.confidence, result.image_quality);
	} else if (ret == -ENOENT) {
		LOG_WRN("Fingerprint does not match user %u", user_id);
	} else if (ret == -ETIMEDOUT) {
		LOG_WRN("No finger detected within timeout");
	} else {
		LOG_ERR("Match error: %d", ret);
	}

	return ret;
}

/* -------------------------------------------------------------------------
 * auth_identify
 * ---------------------------------------------------------------------- */
int auth_identify(uint16_t *matched_id, k_timeout_t timeout)
{
	struct biometric_match_result result = {0};

	scope_guard(k_mutex)(&sensor_mutex);

	biometric_led_control(fp, BIOMETRIC_LED_BLINK);

	int ret = biometric_match(fp, BIOMETRIC_MATCH_IDENTIFY, 0, timeout, &result);

	biometric_led_control(fp, BIOMETRIC_LED_OFF);

	if (ret == 0) {
		*matched_id = result.template_id;
		LOG_INF("Identified: user %u (confidence %d)", result.template_id,
			result.confidence);
	} else if (ret == -ENOENT) {
		LOG_WRN("Unknown fingerprint — access denied");
	}

	return ret;
}

/* -------------------------------------------------------------------------
 * auth_wipe
 * ---------------------------------------------------------------------- */
int auth_wipe(void)
{
	scope_guard(k_mutex)(&sensor_mutex);

	int ret = biometric_template_delete_all(fp);

	if (ret == 0) {
		LOG_INF("All templates wiped");
	}
	return ret;
}

/* -------------------------------------------------------------------------
 * auth_enrolled_count
 * ---------------------------------------------------------------------- */
size_t auth_enrolled_count(void)
{
	uint16_t ids[AUTH_MAX_USERS];
	size_t count = 0;

	scope_guard(k_mutex)(&sensor_mutex);
	biometric_template_list(fp, ids, ARRAY_SIZE(ids), &count);

	return count;
}
```

## src/auth.h
```c
/*
 * SPDX-License-Identifier: Apache-2.0
 * Copyright (c) 2026 The Zephyr Project Contributors
 *
 * SecureVault Node — biometric authentication module.
 *
 * Wraps the Zephyr 4.4 Biometrics API into a simple enroll / verify / identify
 * interface used by the rest of the application.
 */

#ifndef SECUREVAULT_AUTH_H
#define SECUREVAULT_AUTH_H

#include <stdint.h>
#include <stdbool.h>
#include <zephyr/kernel.h>

#ifdef __cplusplus
extern "C" {
#endif

/** Maximum number of enrolled users. */
#define AUTH_MAX_USERS 10

/**
 * @brief Initialise the authentication subsystem.
 *
 * Must be called once before any other auth_* function.
 *
 * @return 0 on success, negative errno on failure.
 */
int auth_init(void);

/**
 * @brief Enroll a new fingerprint template.
 *
 * Blocks until the required number of captures is collected or @p timeout
 * expires. The caller should prompt the user to place / lift their finger
 * between captures.
 *
 * @param user_id   Template slot to store into (1 … AUTH_MAX_USERS).
 * @param timeout   Per-capture timeout.
 * @return 0 on success, negative errno on failure.
 */
int auth_enroll(uint16_t user_id, k_timeout_t timeout);

/**
 * @brief Verify a specific user.
 *
 * Captures one sample and checks it against the stored template for @p user_id.
 *
 * @param user_id   Template slot to verify against.
 * @param timeout   Timeout for the capture.
 * @return 0 if authenticated, -ENOENT if no match, negative errno on error.
 */
int auth_verify(uint16_t user_id, k_timeout_t timeout);

/**
 * @brief Identify — find any matching template in the database.
 *
 * Captures one sample and searches all enrolled templates.
 *
 * @param[out] matched_id  Template ID of the matched user (only valid on ret==0).
 * @param      timeout     Timeout for the capture.
 * @return 0 if a match was found, -ENOENT if none, negative errno on error.
 */
int auth_identify(uint16_t *matched_id, k_timeout_t timeout);

/**
 * @brief Delete all enrolled templates.
 * @return 0 on success.
 */
int auth_wipe(void);

/**
 * @brief Return the number of currently enrolled users.
 */
size_t auth_enrolled_count(void);

#ifdef __cplusplus
}
#endif

#endif /* SECUREVAULT_AUTH_H */
```

## src/monitor.c
```c
/*
 * SPDX-License-Identifier: Apache-2.0
 * Copyright (c) 2026 The Zephyr Project Contributors
 *
 * SecureVault Node — environmental monitor module
 *
 * ┌─────────────────────────────────────────────────────────────────────────┐
 * │  Zephyr 4.4 feature showcased in this file                             │
 * │                                                                         │
 * │  CPU Frequency Scaling — pressure-based policy (experimental)          │
 * │  (subsys/cpu_freq/, include/zephyr/cpu_freq/)                          │
 * │                                                                         │
 * │  The pressure policy monitors how many threads at each priority level  │
 * │  are runnable.  When higher-priority threads become active the policy  │
 * │  raises the CPU P-state; when only low-priority work remains it scales │
 * │  back down.  No application code calls cpu_freq_* directly — the       │
 * │  policy runs autonomously in the background.  What the application     │
 * │  does control is the workload shape: which threads exist and at what   │
 * │  priority they run.                                                     │
 * │                                                                         │
 * │  Three threads model a real sensor pipeline:                           │
 * │    • alarm_thread   (prio 1)  — reacts to threshold breaches           │
 * │    • sample_thread  (prio 5)  — periodic sensor polling                │
 * │    • aggregate_thread (prio 10) — rolling average / history            │
 * │                                                                         │
 * │  During normal operation only sample + aggregate run → low pressure    │
 * │  → CPU stays at lowest P-state.  A threshold breach wakes alarm_thread │
 * │  → high pressure → CPU scales up to handle the burst workload.        │
 * └─────────────────────────────────────────────────────────────────────────┘
 */

#include "monitor.h"

#include <zephyr/kernel.h>
#include <zephyr/logging/log.h>
#include <zephyr/random/random.h>
#include <zephyr/sys/util.h>

LOG_MODULE_REGISTER(monitor, LOG_LEVEL_INF);

/* -------------------------------------------------------------------------
 * Internal state
 * ---------------------------------------------------------------------- */

/* Latest reading, protected by a mutex. */
static struct monitor_reading latest;
static struct k_mutex          reading_mutex;

/* Alarm semaphore — alarm_thread blocks on this. */
static struct k_sem alarm_sem;

/* -------------------------------------------------------------------------
 * Simulated sensor — on real hardware replace with sensor_channel_get().
 * ------------------------------------------------------------------ */
static void read_sensor(int32_t *temp_mc, int32_t *hum_mpct)
{
	static int32_t t = 21000; /* start at 21.0 °C */
	static int32_t h = 45000; /* start at 45.0 %  */

	/* Simulate slow drift with wraparound so the demo never stalls. */
	t += (sys_rand32_get() % 300) - 100; /* ±0.1 °C steps */
	h += (sys_rand32_get() % 200) - 100; /* ±0.1 % steps  */

	t = CLAMP(t, 15000, 35000);
	h = CLAMP(h, 20000, 80000);

	*temp_mc  = t;
	*hum_mpct = h;
}

/* -------------------------------------------------------------------------
 * Thread: alarm_thread  (priority 1 — highest pressure contributor)
 *
 * Normally blocked waiting for the alarm semaphore.  When a threshold
 * breach is signalled it becomes runnable, adding high-priority pressure
 * to the scheduler queue.  The CPU freq pressure policy sees this and
 * scales up the P-state within one evaluation interval.
 * ---------------------------------------------------------------------- */
#define ALARM_STACK_SIZE 512
K_THREAD_STACK_DEFINE(alarm_stack, ALARM_STACK_SIZE);
static struct k_thread alarm_thread_data;

static void alarm_thread(void *a1, void *a2, void *a3)
{
	ARG_UNUSED(a1);
	ARG_UNUSED(a2);
	ARG_UNUSED(a3);

	while (1) {
		/*
		 * Block here most of the time — zero scheduler pressure.
		 * When monitor_trigger_alarm() gives the semaphore this thread
		 * wakes up, becomes runnable at prio 1, and the pressure policy
		 * sees a high-priority thread in the ready queue.
		 */
		k_sem_take(&alarm_sem, K_FOREVER);

		LOG_WRN("ALARM: sensor threshold breached — CPU freq scaled UP");

		/* Simulate doing meaningful work (alert dispatch, logging…). */
		k_busy_wait(50000); /* 50 ms of work */
	}
}

/* -------------------------------------------------------------------------
 * Thread: sample_thread  (priority 5 — medium pressure)
 *
 * Polls the sensor every second.  This is the "always-on" workload that
 * keeps a moderate P-state selected during normal operation.
 * ---------------------------------------------------------------------- */
#define SAMPLE_STACK_SIZE 1024
K_THREAD_STACK_DEFINE(sample_stack, SAMPLE_STACK_SIZE);
static struct k_thread sample_thread_data;

static void sample_thread(void *a1, void *a2, void *a3)
{
	ARG_UNUSED(a1);
	ARG_UNUSED(a2);
	ARG_UNUSED(a3);

	uint32_t seq = 0;

	while (1) {
		int32_t temp, hum;

		read_sensor(&temp, &hum);

		k_mutex_lock(&reading_mutex, K_FOREVER);
		latest.temp_mc  = temp;
		latest.hum_mpct = hum;
		latest.seq      = ++seq;
		k_mutex_unlock(&reading_mutex);

		LOG_DBG("Sample #%u: temp=%d.%03d°C hum=%d.%03d%%", seq,
			temp / 1000, temp % 1000, hum / 1000, hum % 1000);

		/* Check thresholds — trigger alarm if temp > 30 °C. */
		if (temp > 30000) {
			k_sem_give(&alarm_sem);
		}

		k_sleep(K_SECONDS(1));
	}
}

/* -------------------------------------------------------------------------
 * Thread: aggregate_thread  (priority 10 — lowest pressure)
 *
 * Computes a 10-sample rolling average for reporting.  This is background
 * bookkeeping work — low priority, runs only when the system is idle.
 * When only this thread is runnable the pressure policy allows the CPU
 * to drop to its lowest P-state.
 * ---------------------------------------------------------------------- */
#define AGGREGATE_STACK_SIZE 1024
K_THREAD_STACK_DEFINE(aggregate_stack, AGGREGATE_STACK_SIZE);
static struct k_thread aggregate_thread_data;

static void aggregate_thread(void *a1, void *a2, void *a3)
{
	ARG_UNUSED(a1);
	ARG_UNUSED(a2);
	ARG_UNUSED(a3);

#define HISTORY_LEN 10
	int32_t temp_hist[HISTORY_LEN] = {0};
	int32_t hum_hist[HISTORY_LEN]  = {0};
	uint32_t last_seq = 0;
	int idx = 0;

	while (1) {
		struct monitor_reading r;

		monitor_get_latest(&r);

		if (r.seq != last_seq) {
			last_seq = r.seq;
			temp_hist[idx % HISTORY_LEN] = r.temp_mc;
			hum_hist[idx % HISTORY_LEN]  = r.hum_mpct;
			idx++;
		}

		/* Slow background work — this keeps the thread runnable but
		 * the long sleep means it doesn't *block* other threads. */
		k_sleep(K_SECONDS(5));
	}
}

/* -------------------------------------------------------------------------
 * Public API
 * ---------------------------------------------------------------------- */

int monitor_init(void)
{
	k_mutex_init(&reading_mutex);
	k_sem_init(&alarm_sem, 0, 10);

	/* alarm_thread starts suspended; monitor_trigger_alarm() wakes it. */
	k_thread_create(&alarm_thread_data, alarm_stack, ALARM_STACK_SIZE,
			alarm_thread, NULL, NULL, NULL,
			1, 0, K_NO_WAIT);
	k_thread_name_set(&alarm_thread_data, "sv_alarm");

	k_thread_create(&sample_thread_data, sample_stack, SAMPLE_STACK_SIZE,
			sample_thread, NULL, NULL, NULL,
			5, 0, K_NO_WAIT);
	k_thread_name_set(&sample_thread_data, "sv_sample");

	k_thread_create(&aggregate_thread_data, aggregate_stack, AGGREGATE_STACK_SIZE,
			aggregate_thread, NULL, NULL, NULL,
			10, 0, K_NO_WAIT);
	k_thread_name_set(&aggregate_thread_data, "sv_aggregate");

	LOG_INF("Monitor started — CPU freq pressure policy will track prio 1..10");

	return 0;
}

void monitor_get_latest(struct monitor_reading *out)
{
	k_mutex_lock(&reading_mutex, K_FOREVER);
	*out = latest;
	k_mutex_unlock(&reading_mutex);
}

void monitor_trigger_alarm(void)
{
	LOG_WRN("Alarm triggered (simulated threshold breach)");
	k_sem_give(&alarm_sem);
}

void monitor_clear_alarm(void)
{
	/* Drain any pending semaphore tokens — alarm_thread will block again. */
	while (k_sem_take(&alarm_sem, K_NO_WAIT) == 0) {
		;
	}
	LOG_INF("Alarm cleared");
}
```

## src/monitor.h
```c
/*
 * SPDX-License-Identifier: Apache-2.0
 * Copyright (c) 2026 The Zephyr Project Contributors
 *
 * SecureVault Node — environmental monitor module.
 */

#ifndef SECUREVAULT_MONITOR_H
#define SECUREVAULT_MONITOR_H

#include <stdint.h>
#include <stdbool.h>

#ifdef __cplusplus
extern "C" {
#endif

/** Latest sensor reading snapshot. */
struct monitor_reading {
	/** Temperature in milli-°C (e.g. 22500 = 22.5 °C). */
	int32_t temp_mc;
	/** Relative humidity in milli-% (e.g. 48000 = 48.0 %). */
	int32_t hum_mpct;
	/** Sequence number, incremented on every successful poll. */
	uint32_t seq;
};

/**
 * @brief Initialise the monitor subsystem and start background threads.
 *
 * Launches three priority-differentiated worker threads whose combined
 * scheduler pressure drives the CPU frequency policy introduced in 4.4.
 *
 * @return 0 on success, negative errno on failure.
 */
int monitor_init(void);

/**
 * @brief Get the latest sensor reading.
 * Thread-safe — may be called from any context.
 */
void monitor_get_latest(struct monitor_reading *out);

/**
 * @brief Trigger a high-priority alarm condition (simulates a threshold breach).
 *
 * Temporarily wakes the high-priority alarm thread, increasing scheduler
 * pressure so the CPU frequency policy scales up.  Call monitor_clear_alarm()
 * to return to normal.
 */
void monitor_trigger_alarm(void);

/** @brief Clear a previously triggered alarm condition. */
void monitor_clear_alarm(void);

#ifdef __cplusplus
}
#endif

#endif /* SECUREVAULT_MONITOR_H */
```

## src/report.c
```c
/*
 * SPDX-License-Identifier: Apache-2.0
 * Copyright (c) 2026 The Zephyr Project Contributors
 *
 * SecureVault Node — secure telemetry reporting module
 *
 * ┌─────────────────────────────────────────────────────────────────────────┐
 * │  Zephyr 4.4 features showcased in this file                            │
 * │                                                                         │
 * │  1. WireGuard VPN  (include/zephyr/net/wireguard.h)                    │
 * │     Full WireGuard VPN stack on bare metal.  A virtual network        │
 * │     interface is created; UDP traffic routed through it is             │
 * │     transparently encrypted with Curve25519 / ChaCha20-Poly1305.      │
 * │     The application just opens a normal UDP socket to the peer's VPN  │
 * │     IP — the encryption is invisible at the socket layer.             │
 * │                                                                         │
 * │  2. Scope-based Cleanup  (include/zephyr/cleanup/kernel.h)             │
 * │     scope_defer(zsock_close) ensures the UDP socket is always closed   │
 * │     regardless of which return path is taken.  Classic C would need   │
 * │     a manual close on every error branch.                              │
 * └─────────────────────────────────────────────────────────────────────────┘
 *
 * Guard the whole file with CONFIG_WIREGUARD.  When the module is absent the
 * header provides inline no-ops so the rest of the app still links cleanly.
 */

#include "report.h"
#include "monitor.h"

#include <zephyr/kernel.h>
#include <zephyr/logging/log.h>

LOG_MODULE_REGISTER(report, LOG_LEVEL_INF);

#if defined(CONFIG_WIREGUARD)

#include <stdio.h>
#include <string.h>

#include <zephyr/net/net_if.h>
#include <zephyr/net/net_ip.h>
#include <zephyr/net/socket.h>
#include <zephyr/net/virtual.h>
#include <zephyr/net/virtual_mgmt.h>
#include <zephyr/net/wireguard.h>
#include <zephyr/sys/base64.h>

/*
 * [4.4 NEW] Scope-based cleanup — register a defer for zsock_close.
 *
 * After this macro, anywhere in this compilation unit we can write:
 *   scope_defer(zsock_close)(sock);
 * …and zsock_close(sock) will be called when the enclosing scope exits.
 */
#include <zephyr/cleanup/kernel.h>
SCOPE_DEFER_DEFINE(zsock_close, int);

/* -------------------------------------------------------------------------
 * Demo key material — generated with `wg genkey | wg pubkey`.
 * REPLACE THESE before deploying in production.
 * ---------------------------------------------------------------------- */

/* Private key of this device (base64, 32-byte Curve25519 scalar). */
#define MY_PRIVATE_KEY  "lmAIbJR8PQOpgJxmfOydBiDbexTMEKsjglZ1sj3kIjs="

/* Public key of the facility management gateway peer. */
#define PEER_PUBLIC_KEY "v/xiHtIDhnnMJV3SbqI+cChcSqfrU4zlhLUUbL1J8x4="

/* WireGuard endpoint of the peer (IP as string for inet_pton). */
#define PEER_ENDPOINT_IP   "192.0.2.2"
#define PEER_ENDPOINT_PORT 51820

/* Tunnel IP address assigned to this device inside the VPN. */
#define MY_VPN_ADDR "198.51.100.1"

/* Peer IP reachable over the tunnel (what we send UDP to). */
#define PEER_VPN_IP   "198.51.100.2"
#define PEER_VPN_PORT 9000

/* Allowed peer subnet over the VPN. */
#define PEER_ALLOWED_IP      "198.51.100.0"
#define PEER_ALLOWED_MASKLEN 24

/* -------------------------------------------------------------------------
 * VPN interface reference — stored after successful init.
 * ---------------------------------------------------------------------- */
static struct net_if *vpn_iface;

/* -------------------------------------------------------------------------
 * Interface enumeration callback — find the WireGuard virtual interface.
 * ---------------------------------------------------------------------- */
static void find_vpn_iface(struct net_if *iface, void *user_data)
{
	struct net_if **out = user_data;

	if (*out != NULL) {
		return; /* already found */
	}

	if (net_if_l2(iface) != &NET_L2_GET_NAME(VIRTUAL)) {
		return;
	}

	if (net_virtual_get_iface_capabilities(iface) & VIRTUAL_INTERFACE_VPN) {
		*out = iface;
	}
}

/* -------------------------------------------------------------------------
 * WireGuard interface setup.
 *
 * Adapts the pattern from samples/net/wireguard/src/wg.c to our scenario.
 * Key steps:
 *   1. Find the VPN virtual interface created by CONFIG_WIREGUARD=y.
 *   2. Install our Curve25519 private key via net_mgmt.
 *   3. Assign our tunnel IP address to the interface.
 *   4. Configure the peer (public key + allowed IPs + endpoint) via
 *      wireguard_peer_add() — the new 4.4 WireGuard API.
 *   5. Bring the interface up.
 * ---------------------------------------------------------------------- */
static int setup_wireguard(void)
{
	int ret;

	/* Step 1: find the WireGuard virtual interface. */
	net_if_foreach(find_vpn_iface, &vpn_iface);
	if (!vpn_iface) {
		LOG_ERR("No WireGuard VPN interface found — is CONFIG_WIREGUARD=y?");
		return -ENODEV;
	}

	/* Step 2: install our private key. */
	struct virtual_interface_req_params params = {0};
	uint8_t private_key[NET_VIRTUAL_MAX_PUBLIC_KEY_LEN];
	size_t olen;

	ret = base64_decode(private_key, sizeof(private_key), &olen,
			    MY_PRIVATE_KEY, strlen(MY_PRIVATE_KEY));
	if (ret < 0) {
		LOG_ERR("base64_decode private key failed: %d", ret);
		return ret;
	}
	params.private_key.data = private_key;
	params.private_key.len  = olen;

	ret = net_mgmt(NET_REQUEST_VIRTUAL_INTERFACE_SET_PRIVATE_KEY,
		       vpn_iface, &params, sizeof(params));
	memset(private_key, 0, sizeof(private_key)); /* zero key material */
	if (ret < 0) {
		LOG_ERR("Cannot set private key: %d", ret);
		return ret;
	}

	/* Step 3: assign our tunnel IPv4 address. */
	struct in_addr my_addr;

	zsock_inet_pton(AF_INET, MY_VPN_ADDR, &my_addr);
	if (!net_if_ipv4_addr_add(vpn_iface, &my_addr, NET_ADDR_MANUAL, 0)) {
		LOG_ERR("Cannot add tunnel IP address");
		return -ENOMEM;
	}

	/* Step 4: configure the peer.
	 *
	 * wireguard_peer_add() is part of the new 4.4 WireGuard API.
	 * It registers the peer's public key, endpoint, and allowed IP
	 * ranges with the WireGuard subsystem.
	 */
	struct wireguard_peer_config peer = {0};

	/* Public key in base64 — wireguard_peer_config takes a string pointer. */
	peer.public_key = PEER_PUBLIC_KEY;

	/* Peer endpoint address (where to send encrypted UDP packets). */
	struct sockaddr_in *ep = (struct sockaddr_in *)&peer.endpoint_ip;

	ep->sin_family = AF_INET;
	ep->sin_port   = htons(PEER_ENDPOINT_PORT);
	zsock_inet_pton(AF_INET, PEER_ENDPOINT_IP, &ep->sin_addr);

	/* Allowed IPs — traffic to this subnet will be routed through the tunnel. */
	peer.allowed_ip[0].is_valid = true;
	peer.allowed_ip[0].mask_len = PEER_ALLOWED_MASKLEN;
	peer.allowed_ip[0].addr.family = AF_INET;
	zsock_inet_pton(AF_INET, PEER_ALLOWED_IP,
			&peer.allowed_ip[0].addr.in_addr);

	struct net_if *peer_iface = NULL;

	ret = wireguard_peer_add(&peer, &peer_iface);
	if (ret < 0) {
		LOG_ERR("wireguard_peer_add failed: %d", ret);
		return ret;
	}

	/* Step 5: bring the interface up. */
	net_if_up(vpn_iface);

	LOG_INF("WireGuard VPN ready — tunnel %s → peer %s:%d",
		MY_VPN_ADDR, PEER_ENDPOINT_IP, PEER_ENDPOINT_PORT);
	LOG_INF("  (traffic to %s/%d encrypted transparently)",
		PEER_ALLOWED_IP, PEER_ALLOWED_MASKLEN);

	return 0;
}

/* -------------------------------------------------------------------------
 * Public API
 * ---------------------------------------------------------------------- */

int report_init(void)
{
	return setup_wireguard();
}

int report_send(const struct monitor_reading *reading, uint32_t auth_events)
{
	char payload[128];
	int  payload_len;

	payload_len = snprintf(payload, sizeof(payload),
			       "{\"seq\":%u,\"temp\":%d.%03d,"
			       "\"hum\":%d.%03d,\"auth_events\":%u}",
			       reading->seq,
			       reading->temp_mc / 1000,
			       abs(reading->temp_mc  % 1000),
			       reading->hum_mpct / 1000,
			       abs(reading->hum_mpct % 1000),
			       auth_events);

	/*
	 * Open a UDP socket to the peer's VPN IP.
	 * From the application's perspective this is a completely ordinary
	 * UDP socket — the WireGuard virtual interface handles encryption
	 * and decryption transparently.
	 */
	int sock = zsock_socket(AF_INET, SOCK_DGRAM, IPPROTO_UDP);

	if (sock < 0) {
		LOG_ERR("socket() failed: %d", errno);
		return -errno;
	}

	/*
	 * [4.4 NEW] scope_defer(zsock_close) — the socket will be closed
	 * automatically when report_send() returns, regardless of whether
	 * we exit via the sendto error path or the happy path below.
	 *
	 * Without this we'd need:
	 *   if (ret < 0) { zsock_close(sock); return ret; }
	 * on every subsequent error branch — easy to forget one.
	 */
	scope_defer(zsock_close)(sock);

	struct sockaddr_in dest = {
		.sin_family = AF_INET,
		.sin_port   = htons(PEER_VPN_PORT),
	};

	zsock_inet_pton(AF_INET, PEER_VPN_IP, &dest.sin_addr);

	int ret = zsock_sendto(sock, payload, payload_len, 0,
			       (struct sockaddr *)&dest, sizeof(dest));

	if (ret < 0) {
		LOG_ERR("sendto() failed: %d", errno);
		return -errno; /* zsock_close called by scope_defer */
	}

	LOG_INF("Telemetry sent (%d bytes): %s", payload_len, payload);

	/* zsock_close(sock) called here by scope_defer */
	return 0;
}

#else /* CONFIG_WIREGUARD not set */

int report_init(void)
{
	LOG_INF("WireGuard not enabled — reporting disabled. "
		"Build with CONFIG_WIREGUARD=y to activate.");
	return 0;
}

int report_send(const struct monitor_reading *reading, uint32_t auth_events)
{
	LOG_INF("[STUB] Would report seq=%u temp=%d.%03d hum=%d.%03d auth=%u",
		reading->seq,
		reading->temp_mc / 1000,  abs(reading->temp_mc  % 1000),
		reading->hum_mpct / 1000, abs(reading->hum_mpct % 1000),
		auth_events);
	return 0;
}

#endif /* CONFIG_WIREGUARD */
```

## src/report.h
```c
/*
 * SPDX-License-Identifier: Apache-2.0
 * Copyright (c) 2026 The Zephyr Project Contributors
 *
 * SecureVault Node — secure telemetry reporting module.
 *
 * Transmits sensor readings over a WireGuard VPN tunnel to the facility
 * management system.  Requires CONFIG_WIREGUARD=y and the zephyr-wireguard
 * west module.  When CONFIG_WIREGUARD is not set the module compiles to
 * no-ops so the rest of the application still works on vanilla native_sim.
 */

#ifndef SECUREVAULT_REPORT_H
#define SECUREVAULT_REPORT_H

#include "monitor.h"
#include <stdint.h>

#ifdef __cplusplus
extern "C" {
#endif

/**
 * @brief Initialise the reporting subsystem.
 *
 * Sets up the WireGuard virtual interface, installs the peer public key, and
 * assigns the tunnel IP address.  Must be called after the network stack is up.
 *
 * @return 0 on success, negative errno on failure (or always 0 if WireGuard
 *         is not compiled in).
 */
int report_init(void);

/**
 * @brief Send a telemetry report for the given sensor reading.
 *
 * Opens a UDP socket over the WireGuard tunnel interface, sends a compact
 * JSON payload, and closes the socket.  Socket cleanup is handled by
 * scope_defer — no manual close needed on error paths.
 *
 * @param reading  Latest sensor snapshot to report.
 * @param auth_events  Number of authentication events since last report.
 * @return 0 on success, negative errno on failure.
 */
int report_send(const struct monitor_reading *reading, uint32_t auth_events);

#ifdef __cplusplus
}
#endif

#endif /* SECUREVAULT_REPORT_H */
```
