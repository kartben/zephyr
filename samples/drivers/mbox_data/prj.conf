## CMakeLists.txt
```
# Copyright 2024-2026 NXP
#
# SPDX-License-Identifier: Apache-2.0
#

cmake_minimum_required(VERSION 3.28.3)

find_package(Zephyr REQUIRED HINTS $ENV{ZEPHYR_BASE})

set(REMOTE_ZEPHYR_DIR ${CMAKE_CURRENT_BINARY_DIR}/../remote/zephyr)

if(CONFIG_BOARD_MIMXRT1170_EVK_MIMXRT1176_CM7 OR
   CONFIG_BOARD_MIMXRT1160_EVK_MIMXRT1166_CM7 OR
   CONFIG_BOARD_MIMXRT700_EVK_MIMXRT798S_CM33_CPU0 OR
   CONFIG_BOARD_FRDM_MCXN947_MCXN947_CPU0 OR
   CONFIG_BOARD_MCX_N9XX_EVK_MCXN947_CPU0 OR
   CONFIG_BOARD_MIMXRT1180_EVK_MIMXRT1189_CM33 OR
   CONFIG_BOARD_FRDM_IMXRT1186_MIMXRT1186_CM33 OR
   CONFIG_BOARD_LPCXPRESSO55S69_LPC55S69_CPU0 OR
   CONFIG_BOARD_EK_RA8P1_R7KA8P1KFLCAC_CM85 OR
   CONFIG_BOARD_ESP32C5_DEVKITC_ESP32C5_HPCORE OR
   CONFIG_BOARD_ESP32C6_DEVKITC_ESP32C6_HPCORE OR
   CONFIG_BOARD_ESP32P4X_FUNCTION_EV_BOARD_ESP32P4_HPCORE OR
   CONFIG_BOARD_IMX943_EVK_MIMX94398_M7_0 OR
   CONFIG_BOARD_IMX943_EVK_MIMX94398_M7_1 OR
   CONFIG_BOARD_IMX943_EVK_MIMX94398_M33 OR
   CONFIG_BOARD_VERSALNET_RPU OR
   CONFIG_BOARD_VERSAL2_RPU)
  message(STATUS "${BOARD}/${BOARD_QUALIFIERS} compile as Main in this sample")
else()
  message(FATAL_ERROR "${BOARD}/${BOARD_QUALIFIERS} is not supported for this sample")
endif()

project(mbox_data_ipc)

enable_language(C ASM)

if(CONFIG_INCLUDE_REMOTE_DIR)
  target_include_directories(zephyr_interface
    INTERFACE ${REMOTE_ZEPHYR_DIR}/include/public)
endif()

target_sources(app PRIVATE src/main.c)
```

## prj.conf
```kconfig
CONFIG_PRINTK=y
CONFIG_MBOX=y



# CPU Frequency Subsystem Configuration
CONFIG_CPU_FREQ=y
CONFIG_CPU_FREQ_LOG_LEVEL_DBG=y
CONFIG_CPU_FREQ_INTERVAL_MS=5000
CONFIG_CPU_FREQ_POLICY_PRESSURE=y
CONFIG_CPU_FREQ_POLICY_PRESSURE_LOWEST_PRIO=10
CONFIG_LOG=y
```

## boards/imx943_evk_mimx94398_m33.overlay
```dts
/*
 * Copyright 2025 NXP
 *
 * SPDX-License-Identifier: Apache-2.0
 */

/ {
	mbox-consumer {
		compatible = "vnd,mbox-consumer";
		/*
		 * m33s(NETCMIX) as host, m71(M7MIX1) as remote
		 */
		mboxes = <&mu_m33s_m71_for_m33s 1>, <&mu_m33s_m71_for_m33s 0>;
		mbox-names = "tx", "rx";
	};
};
```

## boards/imx943_evk_mimx94398_m7_0.overlay
```dts
/*
 * Copyright 2025 NXP
 *
 * SPDX-License-Identifier: Apache-2.0
 */

/ {
	mbox-consumer {
		compatible = "vnd,mbox-consumer";
		/*
		 * m70(M7MIX0) as host, m33s(NETCMIX) as remote
		 */
		mboxes = <&mu_m33s_m70_for_m70 1>, <&mu_m33s_m70_for_m70 0>;
		mbox-names = "tx", "rx";
	};
};
```

## boards/imx943_evk_mimx94398_m7_1.overlay
```dts
/*
 * Copyright 2025 NXP
 *
 * SPDX-License-Identifier: Apache-2.0
 */

/ {
	mbox-consumer {
		compatible = "vnd,mbox-consumer";
		/*
		 * m71(M7MIX1) as host, m33s(NETCMIX) as remote
		 */
		mboxes = <&mu_m33s_m71_for_m71 1>, <&mu_m33s_m71_for_m71 0>;
		mbox-names = "tx", "rx";
	};
};
```

## src/main.c
```c
/*
 * Copyright 2024 NXP
 *
 * SPDX-License-Identifier: Apache-2.0
 */

#include <stdio.h>
#include <stdlib.h>
#include <string.h>
#include <zephyr/kernel.h>
#include <zephyr/drivers/mbox.h>

static K_SEM_DEFINE(g_mbox_data_rx_sem, 0, 1);

static mbox_channel_id_t g_mbox_received_data;
static mbox_channel_id_t g_mbox_received_channel;

static void callback(const struct device *dev, mbox_channel_id_t channel_id, void *user_data,
		     struct mbox_msg *data)
{
	memcpy(&g_mbox_received_data, data->data, data->size);
	g_mbox_received_channel = channel_id;

	k_sem_give(&g_mbox_data_rx_sem);
}

int main(void)
{
	const struct mbox_dt_spec tx_channel = MBOX_DT_SPEC_GET(DT_PATH(mbox_consumer), tx);
	const struct mbox_dt_spec rx_channel = MBOX_DT_SPEC_GET(DT_PATH(mbox_consumer), rx);
	struct mbox_msg msg = {0};
	uint32_t message = 0;

	printk("mbox_data Client demo started\n");

	const int max_transfer_size_bytes = mbox_mtu_get_dt(&tx_channel);
	/* Sample currently supports only transfer size up to 4 bytes */
	if ((max_transfer_size_bytes < 0) || (max_transfer_size_bytes > 4)) {
		printk("mbox_mtu_get() error\n");
		return 0;
	}

	if (mbox_register_callback_dt(&rx_channel, callback, NULL)) {
		printk("mbox_register_callback() error\n");
		return 0;
	}

	if (mbox_set_enabled_dt(&rx_channel, 1)) {
		printk("mbox_set_enable() error\n");
		return 0;
	}

	while (true) {
		msg.data = &message;
		msg.size = max_transfer_size_bytes;

		printk("Client send (on channel %d) value: %d\n", tx_channel.channel_id, message);
		if (mbox_send_dt(&tx_channel, &msg) < 0) {
			printk("mbox_send() error\n");
			return 0;
		}

		k_sleep(K_MSEC(100));

		k_sem_take(&g_mbox_data_rx_sem, K_FOREVER);
		message = g_mbox_received_data;

		printk("Client received (on channel %d) value: %d\n", g_mbox_received_channel,
		       message);
		message++;
	}

	printk("mbox_data Client demo ended\n");
	return 0;
}
```
