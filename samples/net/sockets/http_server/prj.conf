## CMakeLists.txt
```
# SPDX-License-Identifier: Apache-2.0

cmake_minimum_required(VERSION 3.28.3)

find_package(Zephyr REQUIRED HINTS $ENV{ZEPHYR_BASE})
find_package(Python REQUIRED COMPONENTS Interpreter)

project(http_server)

if(CONFIG_NET_SOCKETS_SOCKOPT_TLS AND
  CONFIG_MBEDTLS_KEY_EXCHANGE_PSK_ENABLED AND
  (CONFIG_NET_SAMPLE_PSK_HEADER_FILE STREQUAL "dummy_psk.h")
)
  add_custom_target(development_psk
    COMMAND ${CMAKE_COMMAND} -E echo "----------------------------------------------------------"
    COMMAND ${CMAKE_COMMAND} -E echo "--- WARNING: Using dummy PSK! Only suitable for        ---"
    COMMAND ${CMAKE_COMMAND} -E echo "--- development. Set NET_SAMPLE_PSK_HEADER_FILE to use ---"
    COMMAND ${CMAKE_COMMAND} -E echo "--- own pre-shared key.                                ---"
    COMMAND ${CMAKE_COMMAND} -E echo "----------------------------------------------------------"
  )
  add_dependencies(app development_psk)
endif()

set(CERTS_DIR ${CMAKE_CURRENT_SOURCE_DIR}/src/certs)

add_custom_target(sample_ca_cert
  WORKING_DIRECTORY ${CERTS_DIR}
  COMMAND sh gen_ca_cert.sh
  COMMENT "Generating sample CA certificate"
)

add_custom_target(sample_server_cert
  WORKING_DIRECTORY ${CERTS_DIR}
  COMMAND sh gen_server_cert.sh
  COMMENT "Generating sample server certificate"
)

option(INCLUDE_HTML_CONTENT "Include the HTML content" ON)

target_sources(app PRIVATE src/main.c)

set(gen_dir ${ZEPHYR_BINARY_DIR}/include/generated/)

target_sources_ifdef(CONFIG_NET_SAMPLE_WEBSOCKET_SERVICE app PRIVATE src/ws.c)

if(CONFIG_USB_DEVICE_STACK_NEXT)
  include(${ZEPHYR_BASE}/samples/subsys/usb/common/common.cmake)
endif()

target_link_libraries(app PRIVATE zephyr_interface zephyr)

zephyr_linker_sources(SECTIONS sections-rom.ld)
zephyr_linker_section_ifdef(CONFIG_NET_SAMPLE_HTTPS_SERVICE
  NAME http_resource_desc_test_https_service
  KVMA RAM_REGION GROUP RODATA_REGION
)
zephyr_linker_section_ifdef(CONFIG_NET_SAMPLE_HTTP_SERVICE
  NAME http_resource_desc_test_http_service
  KVMA RAM_REGION GROUP RODATA_REGION
)

foreach(web_resource
  index.html
  main.js
)
  generate_inc_file_for_target(app
    src/static_web_resources/${web_resource}
    ${gen_dir}/${web_resource}.gz.inc
    --gzip
  )
endforeach()

foreach(inc_file
  server_cert.der
  server_privkey.der
)
  generate_inc_file_for_target(app
    src/certs/${inc_file}
    ${gen_dir}/${inc_file}.inc
  )
endforeach()
```

## Kconfig
```
# Config options for http2 server sample application

# Copyright (c) 2023, Emna Rekik
# SPDX-License-Identifier: Apache-2.0

mainmenu "HTTP2 server sample application"

config NET_SAMPLE_HTTP_SERVICE
	bool "Enable http service"
	default y

config NET_SAMPLE_HTTP_SERVER_SERVICE_PORT
	int "Port number for http service"
	default 80
	depends on NET_SAMPLE_HTTP_SERVICE

config NET_SAMPLE_HTTPS_SERVICE
	bool "Enable https service"
	depends on NET_SOCKETS_SOCKOPT_TLS || TLS_CREDENTIALS
	select PSA_CRYPTO

if NET_SAMPLE_HTTPS_SERVICE

config NET_SAMPLE_HTTPS_SERVER_SERVICE_PORT
	int "Port number for https service"
	default 443
	depends on NET_SAMPLE_HTTPS_SERVICE

config NET_SAMPLE_HTTPS_USE_ALPN
	bool "Allow HTTP2 connectivity with web browsers by using ALPN"
	select MBEDTLS_SSL_ALPN
	select HTTP_SERVER_TLS_USE_ALPN
	help
	  Web browsers only use HTTP/2 over HTTPS, and use ALPN to determine if a
	  server supports HTTP/2. If this option is enabled, web browsers can use
	  HTTP/2 to communicate with the server. However web browsers are stricter
	  with security when using HTTP/2, at a minimum you will need to add the CA
	  certificate used to sign the server certificate into your web browser's
	  trusted authorities. Otherwise the connection can fail with a security
	  error, without giving an option to ignore this and proceed anyway.

endif # NET_SAMPLE_HTTPS_SERVICE

config NET_SAMPLE_PSK_HEADER_FILE
	string "Header file containing PSK"
	default "dummy_psk.h"
	depends on MBEDTLS_KEY_EXCHANGE_PSK_ENABLED
	help
	  Name of a header file containing a
	  pre-shared key.

config NET_SAMPLE_WEBSOCKET_SERVICE
	bool "Enable websocket service"
	default y if HTTP_SERVER_WEBSOCKET

config NET_SAMPLE_NUM_WEBSOCKET_HANDLERS
	int "How many websocket connections to serve at the same time"
	depends on NET_SAMPLE_WEBSOCKET_SERVICE
	default 1
	help
	  Each websocket connection is served by a thread which needs
	  memory. Only increase the value here if really needed.

config NET_SAMPLE_WEBSOCKET_STATS_INTERVAL
	int "Interval in milliseconds to send network stats over websocket"
	depends on NET_SAMPLE_WEBSOCKET_SERVICE
	default 1000
	help
	  This interval controls how often the net stats data shown on the web page
	  will be updated.

# WireGuard VPN (same options as samples/net/wireguard)
config NET_SAMPLE_COMMON_VPN_MY_PRIVATE_KEY
	string "My private key in base64 format"
	default ""
	depends on WIREGUARD
	help
	  The public key will be calculated from the private one.

config NET_SAMPLE_COMMON_VPN_PEER_PUBLIC_KEY
	string "Peer public key in base64 format"
	default ""
	depends on WIREGUARD
	help
	  This specifies the public key of the peer that we are being
	  connected from.

config NET_SAMPLE_COMMON_VPN_PEER_IP_ADDR
	string "Peer IP address to connect to"
	default ""
	depends on WIREGUARD
	help
	  This specifies the IP address of VPN service we are trying to
	  connect to. You can also set the port number also here like
	  this: 192.0.2.2:51821 or [2001:db8::2]:51822
	  if using non standard Wireguard port which is 51820.

config NET_SAMPLE_COMMON_VPN_ALLOWED_PEER_ADDR
	string "Allowed peer IP addresses"
	depends on WIREGUARD
	help
	  What peer IP address is allowed to connect.
	  Format is: ip/masklen
	  Multiple addresses can be given and must be separated by "," or space
	  characters.
	  Example: 192.0.2.0/24,2001:db9::/64

config NET_SAMPLE_COMMON_VPN_MY_ADDR
	string "My addresses for VPN connections"
	depends on WIREGUARD
	help
	  The value depends on your network setup. Can contain multiple
	  network addresses separated by comma.
	  Example: 198.51.100.1/24,2001:db8:100::1/64

config NET_SAMPLE_COMMON_VPN_KEEPALIVE_INTERVAL
	int "Keepalive message period in seconds"
	default 0
	depends on WIREGUARD
	help
	  The value depends on your network setup. If set to 0, keepalive
	  messages are not sent. If value is > 0, then a Wireguard keepalive
	  message is sent periodically. Sensible value is 25 sec.

if USB_DEVICE_STACK_NEXT
# Source common USB sample options used to initialize new experimental USB
# device stack. The scope of these options is limited to USB samples in project
# tree, you cannot use them in your own application.
	source "samples/subsys/usb/common/Kconfig.sample_usbd"
endif

source "samples/net/common/Kconfig"
source "Kconfig.zephyr"
```

## sample.yaml
```
sample:
  description: HTTP Server Sample
  name: http_server_sample
common:
  harness: net
  depends_on: netif
  min_ram: 224
  tags:
    - http
    - net
    - server
    - socket
  platform_exclude:
    - nrf5340dk/nrf5340/cpuapp/ns # Excluding due to ROM overflow.
tests:
  sample.net.sockets.http.server: {}
  sample.net.sockets.https.server:
    extra_args: EXTRA_CONF_FILE="overlay-tls.conf"
  sample.net.sockets.http.server.usbd_cdc_ncm:
    depends_on: usbd
    extra_args: EXTRA_CONF_FILE="overlay-usbd.conf"
                EXTRA_DTC_OVERLAY_FILE="usbd_cdc_ncm.overlay"
    tags:
      - usb
```

## prj.conf
```kconfig
# General config
CONFIG_MAIN_STACK_SIZE=3072
CONFIG_SYSTEM_WORKQUEUE_STACK_SIZE=2048
CONFIG_SHELL=y
CONFIG_LOG=y
CONFIG_ENTROPY_GENERATOR=y
CONFIG_TEST_RANDOM_GENERATOR=y
CONFIG_INIT_STACKS=y
CONFIG_ZVFS_OPEN_ADD_SIZE_NET_SAMPLE=24
CONFIG_POSIX_API=y
CONFIG_ZVFS_POLL_MAX=32

# Eventfd
CONFIG_EVENTFD=y

# Networking config
CONFIG_NETWORKING=y
CONFIG_NET_IPV4=y
CONFIG_NET_IPV6=y
CONFIG_NET_TCP=y
CONFIG_NET_SOCKETS=y
CONFIG_NET_CONNECTION_MANAGER=y
CONFIG_NET_SHELL=y
CONFIG_NET_STATISTICS=y
CONFIG_NET_STATISTICS_USER_API=y
CONFIG_LOG=n
CONFIG_NET_LOG=n

# JSON
CONFIG_JSON_LIBRARY=y

# HTTP parser
CONFIG_HTTP_PARSER_URL=y
CONFIG_HTTP_PARSER=y
CONFIG_HTTP_SERVER=y
CONFIG_HTTP_SERVER_WEBSOCKET=y

# Network buffers — larger fragments improve bulk TCP throughput (fewer net_buf
# chains per segment); pool size sets TCP windows as (count * data_size) / 3.
CONFIG_NET_PKT_RX_COUNT=16
CONFIG_NET_PKT_TX_COUNT=40
CONFIG_NET_BUF_RX_COUNT=128
CONFIG_NET_BUF_TX_COUNT=256
CONFIG_NET_BUF_DATA_SIZE=256
CONFIG_NET_CONTEXT_NET_PKT_POOL=y

# Compiler / kernel tweaks often used for networking throughput samples
CONFIG_SPEED_OPTIMIZATIONS=y
CONFIG_TIMESLICING=n

# IP address options
CONFIG_NET_IF_UNICAST_IPV6_ADDR_COUNT=3
CONFIG_NET_IF_MCAST_IPV6_ADDR_COUNT=4
CONFIG_NET_MAX_CONTEXTS=32
CONFIG_NET_MAX_CONN=32

# Network address config
CONFIG_NET_CONFIG_SETTINGS=y
CONFIG_NET_CONFIG_NEED_IPV4=y
CONFIG_NET_CONFIG_NEED_IPV6=y
CONFIG_NET_CONFIG_MY_IPV4_ADDR="192.0.2.1"
CONFIG_NET_CONFIG_PEER_IPV4_ADDR="192.0.2.2"
CONFIG_NET_CONFIG_MY_IPV4_GW="192.0.2.2"
CONFIG_NET_CONFIG_MY_IPV6_ADDR="2001:db8::1"
CONFIG_NET_CONFIG_PEER_IPV6_ADDR="2001:db8::2"

# Networking tweaks
# Required to handle large number of consecutive connections,
# e.g. when testing with ApacheBench.
CONFIG_NET_TCP_TIME_WAIT_DELAY=0

# Device drivers
CONFIG_GPIO=y
CONFIG_LED=y

# Network debug config
CONFIG_NET_SOCKETS_LOG_LEVEL_DBG=n
CONFIG_NET_HTTP_LOG_LEVEL_DBG=n
CONFIG_NET_IPV6_LOG_LEVEL_DBG=n
CONFIG_NET_IPV6_ND_LOG_LEVEL_DBG=n


# Optimizations(?)
CONFIG_CACHE_MANAGEMENT=y
CONFIG_SPEED_OPTIMIZATIONS=y
CONFIG_TIMESLICING=n
CONFIG_PICOLIBC_USE_MODULE=y
```

## overlay-wireguard.conf
```kconfig
CONFIG_NETWORKING=y
CONFIG_NET_LOG=y
CONFIG_NET_IPV6=y
CONFIG_NET_IPV4=y
CONFIG_NET_DHCPV4=y
CONFIG_NET_UDP=y
CONFIG_NET_TCP=y
CONFIG_NET_STATISTICS=y
CONFIG_NET_SOCKETS_SERVICE=y
CONFIG_POSIX_API=y

CONFIG_TEST_RANDOM_GENERATOR=y

CONFIG_NET_PKT_RX_COUNT=32
CONFIG_NET_PKT_TX_COUNT=32
CONFIG_NET_BUF_RX_COUNT=64
CONFIG_NET_BUF_TX_COUNT=64
CONFIG_NET_IF_UNICAST_IPV6_ADDR_COUNT=5
CONFIG_NET_IF_MCAST_IPV6_ADDR_COUNT=5
CONFIG_NET_IF_UNICAST_IPV4_ADDR_COUNT=1
CONFIG_NET_MAX_CONTEXTS=10
CONFIG_ZVFS_POLL_MAX=10

CONFIG_NET_IF_MAX_IPV6_COUNT=3
CONFIG_NET_IF_MAX_IPV4_COUNT=3

CONFIG_MAIN_STACK_SIZE=1536
CONFIG_INIT_STACKS=y
CONFIG_PRINTK=y
CONFIG_NET_SHELL=y
CONFIG_NET_L2_ETHERNET=y

CONFIG_NET_CONFIG_NEED_IPV6=y
CONFIG_NET_CONFIG_NEED_IPV4=y
CONFIG_NET_CONFIG_SETTINGS=y

# First ethernet interface will use these settings
CONFIG_NET_CONFIG_MY_IPV6_ADDR="2001:db8::1"
CONFIG_NET_CONFIG_PEER_IPV6_ADDR="2001:db8::2"
CONFIG_NET_CONFIG_MY_IPV4_ADDR="192.0.2.1"
CONFIG_NET_CONFIG_PEER_IPV4_ADDR="192.0.2.2"

# Logging
CONFIG_LOG=y

# Wireguard configuration
CONFIG_WIREGUARD=y
CONFIG_WIREGUARD_MAX_SRC_IPS=4

# First VPN interface will use these settings
CONFIG_NET_SAMPLE_COMMON_VPN_PEER_IP_ADDR="192.0.2.2:50085"
CONFIG_NET_SAMPLE_COMMON_VPN_MY_ADDR="198.51.100.1/24,2001:db8:100::1/64"
CONFIG_NET_SAMPLE_COMMON_VPN_ALLOWED_PEER_ADDR="2001:db8:100::/64,198.51.100.0/24"
CONFIG_NET_SAMPLE_COMMON_VPN_MY_PRIVATE_KEY="oKyfQtC/s112ppXKAzGvfscngmfDixfaiPaka80Eqlo="
CONFIG_NET_SAMPLE_COMMON_VPN_PEER_PUBLIC_KEY="bSvrJaKanXZq1TAA5J/V/A18wadFYHwy3nYvlpe34Gc="

CONFIG_NET_IF_MAX_IPV6_COUNT=4
CONFIG_NET_IF_MAX_IPV4_COUNT=4
CONFIG_NET_IF_UNICAST_IPV6_ADDR_COUNT=2
CONFIG_NET_IF_UNICAST_IPV4_ADDR_COUNT=2
CONFIG_NET_RX_STACK_SIZE=2560
CONFIG_SYSTEM_WORKQUEUE_STACK_SIZE=2048
CONFIG_NET_TCP_WORKQ_STACK_SIZE=2048
```

## socs/esp32s3_procpu.conf
```kconfig
CONFIG_WIFI=y

CONFIG_NETWORKING=y
CONFIG_NET_L2_ETHERNET=y

CONFIG_NET_IPV6=n
CONFIG_NET_IPV4=y
CONFIG_NET_DHCPV4=y
CONFIG_ESP32_WIFI_STA_AUTO_DHCPV4=y

CONFIG_NET_LOG=y


# CONFIG_ESP_SPIRAM=y
# CONFIG_ESP32_WIFI_NET_ALLOC_SPIRAM=y
```

## src/main.c
```c
/*
 * Copyright (c) 2023, Emna Rekik
 * Copyright (c) 2024, Nordic Semiconductor
 *
 * SPDX-License-Identifier: Apache-2.0
 */

#include <stdio.h>
#include <inttypes.h>
#include <string.h>

#include <zephyr/kernel.h>
#include <zephyr/net/tls_credentials.h>
#include <zephyr/net/http/server.h>
#include <zephyr/net/http/service.h>
#include <zephyr/net/net_ip.h>
#include <zephyr/net/socket.h>
#include "zephyr/device.h"
#include "zephyr/sys/util.h"
#include <zephyr/drivers/led.h>
#include <zephyr/data/json.h>
#include <zephyr/sys/util_macro.h>
#include <zephyr/net/net_config.h>

#if IS_ENABLED(CONFIG_WIREGUARD)
extern int init_vpn(void);
#endif

#if CONFIG_USB_DEVICE_STACK_NEXT
#include <sample_usbd.h>
#endif

#include "ws.h"

#include <zephyr/logging/log.h>
LOG_MODULE_REGISTER(net_http_server_sample, LOG_LEVEL_DBG);

struct led_command {
	int led_num;
	bool led_state;
};

static const struct json_obj_descr led_command_descr[] = {
	JSON_OBJ_DESCR_PRIM(struct led_command, led_num, JSON_TOK_NUMBER),
	JSON_OBJ_DESCR_PRIM(struct led_command, led_state, JSON_TOK_TRUE),
};

static const struct device *leds_dev = DEVICE_DT_GET_ANY(gpio_leds);

static uint8_t index_html_gz[] = {
#include "index.html.gz.inc"
};

static uint8_t main_js_gz[] = {
#include "main.js.gz.inc"
};

static struct http_resource_detail_static index_html_gz_resource_detail = {
	.common = {
			.type = HTTP_RESOURCE_TYPE_STATIC,
			.bitmask_of_supported_http_methods = BIT(HTTP_GET),
			.content_encoding = "gzip",
			.content_type = "text/html",
		},
	.static_data = index_html_gz,
	.static_data_len = sizeof(index_html_gz),
};

static struct http_resource_detail_static main_js_gz_resource_detail = {
	.common = {
			.type = HTTP_RESOURCE_TYPE_STATIC,
			.bitmask_of_supported_http_methods = BIT(HTTP_GET),
			.content_encoding = "gzip",
			.content_type = "text/javascript",
		},
	.static_data = main_js_gz,
	.static_data_len = sizeof(main_js_gz),
};

static int echo_handler(struct http_client_ctx *client, enum http_transaction_status status,
			const struct http_request_ctx *request_ctx,
			struct http_response_ctx *response_ctx, void *user_data)
{
#define MAX_TEMP_PRINT_LEN 32
	static char print_str[MAX_TEMP_PRINT_LEN];
	enum http_method method = client->method;
	static size_t processed;

	if (status == HTTP_SERVER_TRANSACTION_ABORTED ||
	    status == HTTP_SERVER_TRANSACTION_COMPLETE) {
		if (status == HTTP_SERVER_TRANSACTION_ABORTED) {
			LOG_DBG("Transaction aborted after %zd bytes.", processed);
		}
		processed = 0;
		return 0;
	}

	__ASSERT_NO_MSG(request_ctx->data != NULL);

	processed += request_ctx->data_len;

	snprintf(print_str, sizeof(print_str), "%s received (%zd bytes)", http_method_str(method),
		 request_ctx->data_len);
	LOG_HEXDUMP_DBG(request_ctx->data, request_ctx->data_len, print_str);

	if (status == HTTP_SERVER_REQUEST_DATA_FINAL) {
		LOG_DBG("All data received (%zd bytes).", processed);
		processed = 0;
	}

	/* Echo data back to client */
	response_ctx->body = request_ctx->data;
	response_ctx->body_len = request_ctx->data_len;
	response_ctx->final_chunk = (status == HTTP_SERVER_REQUEST_DATA_FINAL);

	return 0;
}

static struct http_resource_detail_dynamic echo_resource_detail = {
	.common = {
			.type = HTTP_RESOURCE_TYPE_DYNAMIC,
			.bitmask_of_supported_http_methods = BIT(HTTP_GET) | BIT(HTTP_POST),
		},
	.cb = echo_handler,
	.user_data = NULL,
};

static int uptime_handler(struct http_client_ctx *client, enum http_transaction_status status,
			  const struct http_request_ctx *request_ctx,
			  struct http_response_ctx *response_ctx, void *user_data)
{
	int ret;
	static uint8_t uptime_buf[sizeof(STRINGIFY(INT64_MAX))];

	LOG_DBG("Uptime handler status %d", status);

	/* A payload is not expected with the GET request. Ignore any data and wait until
	 * final callback before sending response
	 */
	if (status == HTTP_SERVER_REQUEST_DATA_FINAL) {
		ret = snprintf(uptime_buf, sizeof(uptime_buf), "%" PRId64, k_uptime_get());
		if (ret < 0) {
			LOG_ERR("Failed to snprintf uptime, err %d", ret);
			return ret;
		}

		response_ctx->body = uptime_buf;
		response_ctx->body_len = ret;
		response_ctx->final_chunk = true;
	}

	return 0;
}

static struct http_resource_detail_dynamic uptime_resource_detail = {
	.common = {
			.type = HTTP_RESOURCE_TYPE_DYNAMIC,
			.bitmask_of_supported_http_methods = BIT(HTTP_GET),
		},
	.cb = uptime_handler,
	.user_data = NULL,
};

static void parse_led_post(uint8_t *buf, size_t len)
{
	int ret;
	struct led_command cmd;
	const int expected_return_code = BIT_MASK(ARRAY_SIZE(led_command_descr));

	ret = json_obj_parse(buf, len, led_command_descr, ARRAY_SIZE(led_command_descr), &cmd);
	if (ret != expected_return_code) {
		LOG_WRN("Failed to fully parse JSON payload, ret=%d", ret);
		return;
	}

	LOG_INF("POST request setting LED %d to state %d", cmd.led_num, cmd.led_state);

	if (leds_dev != NULL) {
		if (cmd.led_state) {
			led_on(leds_dev, cmd.led_num);
		} else {
			led_off(leds_dev, cmd.led_num);
		}
	}
}

static int led_handler(struct http_client_ctx *client, enum http_transaction_status status,
		       const struct http_request_ctx *request_ctx,
		       struct http_response_ctx *response_ctx, void *user_data)
{
	static uint8_t post_payload_buf[32];
	static size_t cursor;

	LOG_DBG("LED handler status %d, size %zu", status, request_ctx->data_len);

	if (status == HTTP_SERVER_TRANSACTION_ABORTED ||
	    status == HTTP_SERVER_TRANSACTION_COMPLETE) {
		cursor = 0;
		return 0;
	}

	if (request_ctx->data_len + cursor > sizeof(post_payload_buf)) {
		cursor = 0;
		return -ENOMEM;
	}

	/* Copy payload to our buffer. Note that even for a small payload, it may arrive split into
	 * chunks (e.g. if the header size was such that the whole HTTP request exceeds the size of
	 * the client buffer).
	 */
	memcpy(post_payload_buf + cursor, request_ctx->data, request_ctx->data_len);
	cursor += request_ctx->data_len;

	if (status == HTTP_SERVER_REQUEST_DATA_FINAL) {
		parse_led_post(post_payload_buf, cursor);
		cursor = 0;
	}

	return 0;
}

static struct http_resource_detail_dynamic led_resource_detail = {
	.common = {
			.type = HTTP_RESOURCE_TYPE_DYNAMIC,
			.bitmask_of_supported_http_methods = BIT(HTTP_POST),
		},
	.cb = led_handler,
	.user_data = NULL,
};

#define THROUGHPUT_DURATION_MS 10000
/* Larger chunks reduce HTTP handler round-trips and chunked-encoding overhead. */
#define THROUGHPUT_CHUNK_SIZE  8192

static uint8_t throughput_chunk[THROUGHPUT_CHUNK_SIZE];
static int64_t throughput_deadline_ms = -1;
static bool throughput_extra_headers_sent;

static const struct http_header throughput_extra_headers[] = {
	{
		.name = "Content-Disposition",
		.value = "attachment; filename=\"throughput.bin\"",
	},
	{
		.name = "Cache-Control",
		.value = "no-store",
	},
};

static void throughput_session_reset(void)
{
	throughput_deadline_ms = -1;
	throughput_extra_headers_sent = false;
}

static int throughput_handler(struct http_client_ctx *client, enum http_transaction_status status,
			      const struct http_request_ctx *request_ctx,
			      struct http_response_ctx *response_ctx, void *user_data)
{
	ARG_UNUSED(client);
	ARG_UNUSED(request_ctx);
	ARG_UNUSED(user_data);

	if (status == HTTP_SERVER_TRANSACTION_ABORTED || status == HTTP_SERVER_TRANSACTION_COMPLETE) {
		throughput_session_reset();
		return 0;
	}

	if (status != HTTP_SERVER_REQUEST_DATA_FINAL) {
		return 0;
	}

	if (throughput_deadline_ms < 0) {
		throughput_deadline_ms = k_uptime_get() + THROUGHPUT_DURATION_MS;
		throughput_extra_headers_sent = false;
		memset(throughput_chunk, 0xa5, sizeof(throughput_chunk));
	}

	if (k_uptime_get() >= throughput_deadline_ms) {
		response_ctx->final_chunk = true;
		response_ctx->body = NULL;
		response_ctx->body_len = 0;
		return 0;
	}

	if (!throughput_extra_headers_sent) {
		response_ctx->headers = throughput_extra_headers;
		response_ctx->header_count = ARRAY_SIZE(throughput_extra_headers);
		throughput_extra_headers_sent = true;
	}

	response_ctx->body = throughput_chunk;
	response_ctx->body_len = sizeof(throughput_chunk);
	response_ctx->final_chunk = false;

	return 0;
}

static struct http_resource_detail_dynamic throughput_resource_detail = {
	.common = {
			.type = HTTP_RESOURCE_TYPE_DYNAMIC,
			.bitmask_of_supported_http_methods = BIT(HTTP_GET),
			.content_type = "application/octet-stream",
		},
	.cb = throughput_handler,
	.user_data = NULL,
};

#if defined(CONFIG_NET_SAMPLE_WEBSOCKET_SERVICE)
static uint8_t ws_echo_buffer[1024];

struct http_resource_detail_websocket ws_echo_resource_detail = {
	.common = {
			.type = HTTP_RESOURCE_TYPE_WEBSOCKET,

			/* We need HTTP/1.1 Get method for upgrading */
			.bitmask_of_supported_http_methods = BIT(HTTP_GET),
		},
	.cb = ws_echo_setup,
	.data_buffer = ws_echo_buffer,
	.data_buffer_len = sizeof(ws_echo_buffer),
	.user_data = NULL, /* Fill this for any user specific data */
};

static uint8_t ws_netstats_buffer[128];

struct http_resource_detail_websocket ws_netstats_resource_detail = {
	.common = {
			.type = HTTP_RESOURCE_TYPE_WEBSOCKET,
			.bitmask_of_supported_http_methods = BIT(HTTP_GET),
		},
	.cb = ws_netstats_setup,
	.data_buffer = ws_netstats_buffer,
	.data_buffer_len = sizeof(ws_netstats_buffer),
	.user_data = NULL,
};

#endif /* CONFIG_NET_SAMPLE_WEBSOCKET_SERVICE */

#if defined(CONFIG_NET_SAMPLE_HTTP_SERVICE)
static uint16_t test_http_service_port = CONFIG_NET_SAMPLE_HTTP_SERVER_SERVICE_PORT;
HTTP_SERVICE_DEFINE(test_http_service, NULL, &test_http_service_port,
		    CONFIG_HTTP_SERVER_MAX_CLIENTS, 10, NULL, NULL, NULL);

HTTP_RESOURCE_DEFINE(index_html_gz_resource, test_http_service, "/",
		     &index_html_gz_resource_detail);

HTTP_RESOURCE_DEFINE(main_js_gz_resource, test_http_service, "/main.js",
		     &main_js_gz_resource_detail);

HTTP_RESOURCE_DEFINE(echo_resource, test_http_service, "/dynamic", &echo_resource_detail);

HTTP_RESOURCE_DEFINE(uptime_resource, test_http_service, "/uptime", &uptime_resource_detail);

HTTP_RESOURCE_DEFINE(led_resource, test_http_service, "/led", &led_resource_detail);

HTTP_RESOURCE_DEFINE(throughput_resource, test_http_service, "/throughput",
		     &throughput_resource_detail);

#if defined(CONFIG_NET_SAMPLE_WEBSOCKET_SERVICE)
HTTP_RESOURCE_DEFINE(ws_echo_resource, test_http_service, "/ws_echo", &ws_echo_resource_detail);

HTTP_RESOURCE_DEFINE(ws_netstats_resource, test_http_service, "/", &ws_netstats_resource_detail);
#endif /* CONFIG_NET_SAMPLE_WEBSOCKET_SERVICE */
#endif /* CONFIG_NET_SAMPLE_HTTP_SERVICE */

#if defined(CONFIG_NET_SAMPLE_HTTPS_SERVICE)
#include "certificate.h"

static const sec_tag_t sec_tag_list_verify_none[] = {
		HTTP_SERVER_CERTIFICATE_TAG,
#if defined(CONFIG_MBEDTLS_KEY_EXCHANGE_PSK_ENABLED)
		PSK_TAG,
#endif
	};

static uint16_t test_https_service_port = CONFIG_NET_SAMPLE_HTTPS_SERVER_SERVICE_PORT;
HTTPS_SERVICE_DEFINE(test_https_service, NULL, &test_https_service_port,
		     CONFIG_HTTP_SERVER_MAX_CLIENTS, 10, NULL, NULL, NULL, sec_tag_list_verify_none,
		     sizeof(sec_tag_list_verify_none));

HTTP_RESOURCE_DEFINE(index_html_gz_resource_https, test_https_service, "/",
		     &index_html_gz_resource_detail);

HTTP_RESOURCE_DEFINE(main_js_gz_resource_https, test_https_service, "/main.js",
		     &main_js_gz_resource_detail);

HTTP_RESOURCE_DEFINE(echo_resource_https, test_https_service, "/dynamic", &echo_resource_detail);

HTTP_RESOURCE_DEFINE(uptime_resource_https, test_https_service, "/uptime", &uptime_resource_detail);

HTTP_RESOURCE_DEFINE(led_resource_https, test_https_service, "/led", &led_resource_detail);

HTTP_RESOURCE_DEFINE(throughput_resource_https, test_https_service, "/throughput",
		       &throughput_resource_detail);

#if defined(CONFIG_NET_SAMPLE_WEBSOCKET_SERVICE)
HTTP_RESOURCE_DEFINE(ws_echo_resource_https, test_https_service, "/ws_echo",
		     &ws_echo_resource_detail);

HTTP_RESOURCE_DEFINE(ws_netstats_resource_https, test_https_service, "/",
		     &ws_netstats_resource_detail);
#endif /* CONFIG_NET_SAMPLE_WEBSOCKET_SERVICE */
#endif /* CONFIG_NET_SAMPLE_HTTPS_SERVICE */

static void setup_tls(void)
{
#if defined(CONFIG_NET_SAMPLE_HTTPS_SERVICE)
#if defined(CONFIG_NET_SOCKETS_SOCKOPT_TLS)
	int err;

	err = tls_credential_add(HTTP_SERVER_CERTIFICATE_TAG,
				 TLS_CREDENTIAL_PUBLIC_CERTIFICATE,
				 server_certificate,
				 sizeof(server_certificate));
	if (err < 0) {
		LOG_ERR("Failed to register public certificate: %d", err);
	}

	err = tls_credential_add(HTTP_SERVER_CERTIFICATE_TAG,
				 TLS_CREDENTIAL_PRIVATE_KEY,
				 private_key, sizeof(private_key));
	if (err < 0) {
		LOG_ERR("Failed to register private key: %d", err);
	}

#if defined(CONFIG_MBEDTLS_KEY_EXCHANGE_PSK_ENABLED)
	err = tls_credential_add(PSK_TAG,
				 TLS_CREDENTIAL_PSK,
				 psk,
				 sizeof(psk));
	if (err < 0) {
		LOG_ERR("Failed to register PSK: %d", err);
	}

	err = tls_credential_add(PSK_TAG,
				 TLS_CREDENTIAL_PSK_ID,
				 psk_id,
				 sizeof(psk_id) - 1);
	if (err < 0) {
		LOG_ERR("Failed to register PSK ID: %d", err);
	}
#endif /* defined(CONFIG_MBEDTLS_KEY_EXCHANGE_PSK_ENABLED) */
#endif /* defined(CONFIG_NET_SOCKETS_SOCKOPT_TLS) */
#endif /* defined(CONFIG_NET_SAMPLE_HTTPS_SERVICE) */
}

static int init_usb(void)
{
#if defined(CONFIG_USB_DEVICE_STACK_NEXT)
	struct usbd_context *sample_usbd;
	int err;

	sample_usbd = sample_usbd_init_device(NULL);
	if (sample_usbd == NULL) {
		return -ENODEV;
	}

	err = usbd_enable(sample_usbd);
	if (err) {
		return err;
	}

	(void)net_config_init_app(NULL, "Initializing network");
#endif /* CONFIG_USB_DEVICE_STACK_NEXT */

	return 0;
}

int main(void)
{
	init_usb();

#if IS_ENABLED(CONFIG_WIREGUARD)
	{
		int ret = init_vpn();

		if (ret < 0) {
			return ret;
		}
	}
#endif

	setup_tls();
	http_server_start();
	return 0;
}
```

## src/wg.c
```c
/*
 * Copyright (c) 2026 Nordic Semiconductor
 *
 * SPDX-License-Identifier: Apache-2.0
 */

#include <zephyr/logging/log.h>
LOG_MODULE_DECLARE(net_http_server_sample, LOG_LEVEL_DBG);

#include <zephyr/kernel.h>
#include <zephyr/sys/base64.h>
#include <zephyr/posix/sys/socket.h>
#include <zephyr/posix/unistd.h>
#include <zephyr/posix/arpa/inet.h>
#include <zephyr/net/virtual.h>
#include <zephyr/net/virtual_mgmt.h>
#include <zephyr/net/wireguard.h>

/* User data for the interface callback */
struct ud {
	struct net_if *vpn[CONFIG_WIREGUARD_MAX_PEER];
};

static void iface_cb(struct net_if *iface, void *user_data)
{
	struct ud *ud = user_data;

	if (net_if_l2(iface) != &NET_L2_GET_NAME(VIRTUAL)) {
		return;
	}

	if (!(net_virtual_get_iface_capabilities(iface) & VIRTUAL_INTERFACE_VPN)) {
		return;
	}

	for (int i = 0; i < CONFIG_WIREGUARD_MAX_PEER; i++) {
		if (ud->vpn[i] != NULL) {
			continue;
		}

		ud->vpn[i] = iface;
		return;
	}
}

static int setup_iface(struct net_if *iface,
		       const char *my_addresses,
		       const char *allowed_ip_addr,
		       const char *my_private_key,
		       const char *peer_public_key,
		       int keepalive_interval)
{
	struct virtual_interface_req_params params = { 0 };
	struct wireguard_peer_config peer_config = { 0 };
	struct sockaddr_storage addr = { 0 };
	struct sockaddr *paddr = (struct sockaddr *)&addr;
	struct net_if *peer_iface = NULL;
	uint8_t mask_len = 0;
	uint8_t private_key[NET_VIRTUAL_MAX_PUBLIC_KEY_LEN];
	struct net_if_addr *ifaddr;
	const char *addr_str, *next;
	bool status, found;
	size_t olen;
	int ret;

	(void)base64_decode(private_key, sizeof(private_key), &olen,
			    my_private_key, strlen(my_private_key));

	params.private_key.data = private_key;
	params.private_key.len = sizeof(private_key);

	ret = net_mgmt(NET_REQUEST_VIRTUAL_INTERFACE_SET_PRIVATE_KEY,
		       iface, &params, sizeof(params));

	memset(private_key, 0, sizeof(private_key));

	if (ret < 0) {
		LOG_ERR("Cannot set private key (%d)", ret);
		return ret;
	}

	addr_str = my_addresses;

	do {
		char my_addr[INET6_ADDRSTRLEN] = { 'N', 'o', ' ', 'I', 'P', '\0'};

		next = net_ipaddr_parse_mask(addr_str, strlen(addr_str),
					     paddr, &mask_len);
		if (next == NULL) {
			LOG_ERR("Cannot parse IP address \"%s\"", my_addresses);
			return -EINVAL;
		}

		inet_ntop(paddr->sa_family, net_sin(paddr)->sin_addr.s4_addr,
			  my_addr, sizeof(my_addr));

		if (paddr->sa_family == AF_INET) {
			struct sockaddr_in *addr4 = (struct sockaddr_in *)paddr;
			struct sockaddr_in mask;

			ifaddr = net_if_ipv4_addr_add(iface, &addr4->sin_addr,
						      NET_ADDR_MANUAL, 0);

			ret = net_mask_len_to_netmask(AF_INET, mask_len,
						      (struct sockaddr *)&mask);
			if (ret < 0) {
				LOG_ERR("Invalid network mask length (%d)", ret);
				return ret;
			}

			status = net_if_ipv4_set_netmask_by_addr(iface,
								 &addr4->sin_addr,
								 &mask.sin_addr);

		} else if (paddr->sa_family == AF_INET6) {
			struct sockaddr_in6 *addr6 = (struct sockaddr_in6 *)paddr;
			struct in6_addr netaddr6;

			ifaddr = net_if_ipv6_addr_add(iface, &addr6->sin6_addr,
						      NET_ADDR_MANUAL, 0);

			net_ipv6_addr_prefix_mask((uint8_t *)&addr6->sin6_addr,
						  (uint8_t *)&netaddr6,
						  mask_len);

			if (!net_if_ipv6_prefix_add(iface, &netaddr6, mask_len,
						    (uint32_t)0xffffffff)) {
				LOG_ERR("Cannot add %s to interface %d", my_addr,
					net_if_get_by_iface(iface));
				return -EINVAL;
			}

		} else {
			LOG_ERR("Cannot parse IP address \"%s\"", my_addr);
			return -EAFNOSUPPORT;
		}

		if (ifaddr == NULL) {
			LOG_ERR("Cannot add IP address \"%s\" to interface %d",
				my_addr, net_if_get_by_iface(iface));
			return -ENOENT;
		}

		addr_str = next;
	} while (addr_str != NULL && *addr_str != '\0');

	peer_config.public_key = peer_public_key;

	addr_str = allowed_ip_addr;
	found = false;

	do {
		next = net_ipaddr_parse_mask(addr_str, strlen(addr_str),
					     paddr, &mask_len);
		if (next == NULL) {
			LOG_ERR("Cannot parse IP address \"%s\"", allowed_ip_addr);
			return -EINVAL;
		}

		ARRAY_FOR_EACH(peer_config.allowed_ip, i) {
			if (peer_config.allowed_ip[i].is_valid) {
				continue;
			}

			if (paddr->sa_family == AF_INET) {
				struct sockaddr_in *addr4 = (struct sockaddr_in *)paddr;

				memcpy(&peer_config.allowed_ip[i].addr.in_addr,
				       &addr4->sin_addr,
				       sizeof(struct in_addr));
				peer_config.allowed_ip[i].addr.family = AF_INET;
				peer_config.allowed_ip[i].is_valid = true;
				peer_config.allowed_ip[i].mask_len = mask_len;
				found = true;

			} else if (addr.ss_family == AF_INET6) {
				struct sockaddr_in6 *addr6 = (struct sockaddr_in6 *)paddr;

				memcpy(&peer_config.allowed_ip[i].addr.in6_addr,
				       &addr6->sin6_addr,
				       sizeof(struct in6_addr));
				peer_config.allowed_ip[i].addr.family = AF_INET6;
				peer_config.allowed_ip[i].is_valid = true;
				peer_config.allowed_ip[i].mask_len = mask_len;
				found = true;

			} else {
				LOG_ERR("Cannot parse IP address \"%s\"", allowed_ip_addr);
				return -EAFNOSUPPORT;
			}

			break;
		}

		addr_str = next;
	} while (addr_str != NULL && *addr_str != '\0');

	if (!found) {
		LOG_ERR("Not enough space for allowed IP addresses");
		return -ENOMEM;
	}

	if (CONFIG_NET_SAMPLE_COMMON_VPN_PEER_IP_ADDR[0] == '\0') {
		LOG_ERR("Peer IP address is not set");
		return -EINVAL;
	}

	if (!net_ipaddr_parse(CONFIG_NET_SAMPLE_COMMON_VPN_PEER_IP_ADDR,
			      strlen(CONFIG_NET_SAMPLE_COMMON_VPN_PEER_IP_ADDR),
			      paddr)) {
		LOG_ERR("Cannot parse peer IP address \"%s\"",
			CONFIG_NET_SAMPLE_COMMON_VPN_PEER_IP_ADDR);
		return -EINVAL;
	}

	if (paddr->sa_family == AF_INET6) {
		memcpy(&peer_config.endpoint_ip, paddr, sizeof(struct sockaddr_in6));
	} else {
		memcpy(&peer_config.endpoint_ip, paddr, sizeof(struct sockaddr_in));
	}

	peer_config.keepalive_interval = keepalive_interval;

	ret = wireguard_peer_add(&peer_config, &peer_iface);
	if (ret < 0) {
		LOG_ERR("Cannot add peer (%d)", ret);
	} else if (ret > 0) {
		if (peer_iface != NULL) {
			LOG_INF("Added peer id %d using interface %d", ret,
				 net_if_get_by_iface(peer_iface));
		} else {
			LOG_INF("Added peer id %d", ret);
		}
	}

	LOG_DBG("Interface %d VPN setup done.", net_if_get_by_iface(iface));

	return 0;
}

int init_vpn(void)
{
	struct ud user_data;
	int ret;

	memset(&user_data, 0, sizeof(user_data));

	net_if_foreach(iface_cb, &user_data);

	/* This sample has support for one VPN connection.
	 */
	ret = setup_iface(user_data.vpn[0],
			  CONFIG_NET_SAMPLE_COMMON_VPN_MY_ADDR,
			  CONFIG_NET_SAMPLE_COMMON_VPN_ALLOWED_PEER_ADDR,
			  CONFIG_NET_SAMPLE_COMMON_VPN_MY_PRIVATE_KEY,
			  CONFIG_NET_SAMPLE_COMMON_VPN_PEER_PUBLIC_KEY,
			  CONFIG_NET_SAMPLE_COMMON_VPN_KEEPALIVE_INTERVAL);
	if (ret < 0) {
		return ret;
	}

	return 0;
}
```

## src/ws.c
```c
/*
 * Copyright (c) 2024, Nordic Semiconductor
 *
 * SPDX-License-Identifier: Apache-2.0
 */

#include <stdio.h>

#include <zephyr/kernel.h>
#include <zephyr/net/tls_credentials.h>
#include <zephyr/net/http/server.h>
#include <zephyr/net/http/service.h>
#include <zephyr/net/net_ip.h>
#include <zephyr/net/socket.h>
#include <zephyr/net/websocket.h>

#include <zephyr/drivers/sensor.h>

#include <zephyr/logging/log.h>
LOG_MODULE_DECLARE(net_http_server_sample, LOG_LEVEL_DBG);

#if defined(CONFIG_NET_SOCKETS_SOCKOPT_TLS) || defined(CONFIG_COVERAGE_GCOV)
#define STACK_SIZE 4096
#else
#define STACK_SIZE 2048
#endif

#if defined(CONFIG_NET_TC_THREAD_COOPERATIVE)
#define THREAD_PRIORITY K_PRIO_COOP(CONFIG_NUM_COOP_PRIORITIES - 1)
#else
#define THREAD_PRIORITY K_PRIO_PREEMPT(8)
#endif

#if defined(CONFIG_USERSPACE)
#include <zephyr/app_memory/app_memdomain.h>
extern struct k_mem_partition app_partition;
extern struct k_mem_domain app_domain;
#define APP_BMEM K_APP_BMEM(app_partition)
#define APP_DMEM K_APP_DMEM(app_partition)
#else
#define APP_BMEM
#define APP_DMEM
#endif

#define MAX_CLIENT_QUEUE CONFIG_NET_SAMPLE_NUM_WEBSOCKET_HANDLERS
#define RECV_BUFFER_SIZE 1280

K_THREAD_STACK_ARRAY_DEFINE(ws_handler_stack,
			    CONFIG_NET_SAMPLE_NUM_WEBSOCKET_HANDLERS,
			    STACK_SIZE);
static struct k_thread ws_handler_thread[CONFIG_NET_SAMPLE_NUM_WEBSOCKET_HANDLERS];
static APP_BMEM bool ws_handler_in_use[CONFIG_NET_SAMPLE_NUM_WEBSOCKET_HANDLERS];

static struct data {
	int sock;
	uint32_t counter;
	uint32_t bytes_received;
	struct pollfd fds[1];
	char recv_buffer[RECV_BUFFER_SIZE];
} config[CONFIG_NET_SAMPLE_NUM_WEBSOCKET_HANDLERS] = {
	[0 ... (CONFIG_NET_SAMPLE_NUM_WEBSOCKET_HANDLERS - 1)] = {
		.sock = -1,
		.fds[0].fd = -1,
	}
};

static int get_free_slot(struct data *cfg)
{
	for (int i = 0; i < CONFIG_NET_SAMPLE_NUM_WEBSOCKET_HANDLERS; i++) {
		if (cfg[i].sock < 0) {
			return i;
		}
	}

	return -1;
}

static void ws_handler(void *ptr1, void *ptr2, void *ptr3)
{
	int slot = POINTER_TO_INT(ptr1);
	struct data *cfg = ptr2;
	bool *in_use = ptr3;
	int offset = 0;
	int received;
	int client;
	int ret;

	client = cfg->sock;

	cfg->fds[0].fd = client;
	cfg->fds[0].events = POLLIN;

	const struct device *accel_sensor = DEVICE_DT_GET(DT_ALIAS(accel0));
	if (!device_is_ready(accel_sensor)) {
		LOG_ERR("Device %s is not ready\n", accel_sensor->name);
		return -ENODEV;
	}

	/* In this example, we start to receive data from the websocket
	 * and send it back to the client. Note that we could either use
	 * the BSD socket interface if we do not care about Websocket
	 * specific packets, or we could use the websocket_{send/recv}_msg()
	 * function to send websocket specific data.
	 */
	while (true) {
		if (cfg->fds[0].fd < 0) {
			continue;
		}

		if (cfg->fds[0].revents & ZSOCK_POLLHUP) {
			LOG_DBG("Client #%d has disconnected", client);
			break;
		}

		char buf[32];

		struct sensor_value accel[3];
		ret = sensor_sample_fetch(accel_sensor);

		if (ret == 0) {
			ret = sensor_channel_get(accel_sensor, SENSOR_CHAN_ACCEL_XYZ, accel);
		}
		if (ret < 0) {
			LOG_ERR("ERROR: Update failed: %d\n", ret);
			continue;
		}

		snprintf(buf, sizeof(buf), "{\"value\": %.3f}", sensor_value_to_double(&accel[0]));

		ret = websocket_send_msg(cfg->fds[0].fd, buf, strlen(buf),
					 WEBSOCKET_OPCODE_DATA_TEXT, false, true, SYS_FOREVER_MS);

		if (ret < 0) {
			LOG_ERR("[%d] Failed to send data, closing socket", slot);
			break;
		}

		k_sleep(K_MSEC(20));
	}

	*in_use = false;

	(void)websocket_unregister(client);

	cfg->sock = -1;
}

int ws_setup(int ws_socket, void *user_data)
{
	int slot;

	slot = get_free_slot(config);
	if (slot < 0) {
		LOG_ERR("Cannot accept more connections");
		/* The caller will close the connection in this case */
		return -ENOENT;
	}

	config[slot].sock = ws_socket;

	LOG_INF("[%d] Accepted a Websocket connection", slot);

	k_thread_create(&ws_handler_thread[slot],
			ws_handler_stack[slot],
			K_THREAD_STACK_SIZEOF(ws_handler_stack[slot]),
			ws_handler,
			INT_TO_POINTER(slot), &config[slot], &ws_handler_in_use[slot],
			THREAD_PRIORITY,
			IS_ENABLED(CONFIG_USERSPACE) ? K_USER |
						       K_INHERIT_PERMS : 0,
			K_NO_WAIT);

	if (IS_ENABLED(CONFIG_THREAD_NAME)) {
#define MAX_NAME_LEN sizeof("ws[xx]")
		char name[MAX_NAME_LEN];

		snprintk(name, sizeof(name), "ws[%d]", slot);
		k_thread_name_set(&ws_handler_thread[slot], name);
	}

	return 0;
}
```
