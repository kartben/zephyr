## CMakeLists.txt
```
# SPDX-License-Identifier: Apache-2.0

cmake_minimum_required(VERSION 3.28.3)

find_package(Zephyr REQUIRED HINTS $ENV{ZEPHYR_BASE})
project(wireguard_vpn)

zephyr_library_include_directories(${ZEPHYR_WIREGUARD_MODULE_DIR}/include)

target_sources(app PRIVATE
  src/main.c
  src/wg.c
)
```

## sample.yaml
```
common:
  harness: net
  tags:
    - net
    - socket
    - vpn
  depends_on: netif
  min_flash: 140
sample:
  description: Test WireGuard VPN using a client/server sample
  name: WireGuard VPN
tests:
  sample.net.sockets.echo_service.vpn:
    platform_allow:
      - native_sim
      - native_sim/native/64
```

## prj.conf
```kconfig
CONFIG_NETWORKING=y
CONFIG_NET_LOG=y
CONFIG_NET_IPV6=n
CONFIG_NET_IPV4=y
CONFIG_NET_DHCPV4=y
CONFIG_NET_UDP=y
CONFIG_NET_TCP=y
CONFIG_NET_STATISTICS=y
CONFIG_NET_SOCKETS_SERVICE=y
CONFIG_POSIX_API=y

CONFIG_TEST_RANDOM_GENERATOR=y

CONFIG_NET_PKT_RX_COUNT=32
CONFIG_NET_PKT_TX_COUNT=32
CONFIG_NET_BUF_RX_COUNT=64
CONFIG_NET_BUF_TX_COUNT=64
CONFIG_NET_IF_UNICAST_IPV6_ADDR_COUNT=5
CONFIG_NET_IF_MCAST_IPV6_ADDR_COUNT=5
CONFIG_NET_IF_UNICAST_IPV4_ADDR_COUNT=1
CONFIG_NET_MAX_CONTEXTS=10
CONFIG_ZVFS_POLL_MAX=10

CONFIG_NET_IF_MAX_IPV6_COUNT=3
CONFIG_NET_IF_MAX_IPV4_COUNT=3

CONFIG_MAIN_STACK_SIZE=1536
CONFIG_INIT_STACKS=y
CONFIG_PRINTK=y
CONFIG_NET_SHELL=y
CONFIG_NET_L2_ETHERNET=y

CONFIG_NET_CONFIG_NEED_IPV6=y
CONFIG_NET_CONFIG_NEED_IPV4=y
CONFIG_NET_CONFIG_SETTINGS=y

# First ethernet interface will use these settings
CONFIG_NET_CONFIG_MY_IPV6_ADDR="2001:db8::1"
CONFIG_NET_CONFIG_PEER_IPV6_ADDR="2001:db8::2"
CONFIG_NET_CONFIG_MY_IPV4_ADDR="192.0.2.1"
CONFIG_NET_CONFIG_PEER_IPV4_ADDR="192.0.2.2"

# Logging
CONFIG_LOG=y

# Wireguard configuration
CONFIG_WIREGUARD=y
CONFIG_WIREGUARD_MAX_SRC_IPS=4
CONFIG_WIREGUARD_PORT=50085

# First VPN interface will use these settings
CONFIG_NET_SAMPLE_COMMON_VPN_PEER_IP_ADDR="192.0.2.2:50085"
CONFIG_NET_SAMPLE_COMMON_VPN_MY_ADDR="198.51.100.1/24"
CONFIG_NET_SAMPLE_COMMON_VPN_ALLOWED_PEER_ADDR="198.51.100.0/24"
CONFIG_NET_SAMPLE_COMMON_VPN_MY_PRIVATE_KEY="uID5BaJV5HoalK0fT6Sm5JIbRFc9SnG4AUqn2YuxgUw="
CONFIG_NET_SAMPLE_COMMON_VPN_PEER_PUBLIC_KEY="bSvrJaKanXZq1TAA5J/V/A18wadFYHwy3nYvlpe34Gc="

CONFIG_NET_IF_MAX_IPV6_COUNT=4
CONFIG_NET_IF_MAX_IPV4_COUNT=4
CONFIG_NET_IF_UNICAST_IPV6_ADDR_COUNT=2
CONFIG_NET_IF_UNICAST_IPV4_ADDR_COUNT=2
CONFIG_NET_RX_STACK_SIZE=2560
CONFIG_SYSTEM_WORKQUEUE_STACK_SIZE=2048
CONFIG_NET_TCP_WORKQ_STACK_SIZE=2048





# CPU Frequency Subsystem Configuration
CONFIG_CPU_FREQ=y
CONFIG_CPU_FREQ_LOG_LEVEL_DBG=y
CONFIG_CPU_FREQ_INTERVAL_MS=1000
CONFIG_CPU_FREQ_POLICY_PRESSURE=y
CONFIG_CPU_FREQ_POLICY_PRESSURE_LOWEST_PRIO=10
```

## src/main.c
```c
/*
 * Copyright (c) 2026 Nordic Semiconductor
 *
 * SPDX-License-Identifier: Apache-2.0
 */

#include <zephyr/kernel.h>
#include <zephyr/logging/log.h>
LOG_MODULE_REGISTER(vpn_sample, LOG_LEVEL_DBG);

#include <stdio.h>
#include <stdlib.h>
#include <errno.h>

#include <zephyr/posix/unistd.h>
#include <zephyr/posix/poll.h>
#include <zephyr/posix/arpa/inet.h>
#include <zephyr/posix/sys/socket.h>
#include <zephyr/net/socket_service.h>

extern int init_vpn(void);

/* Echo received data back to sender */

#define MY_PORT 4242

#define MAX_SERVICES (CONFIG_ZVFS_POLL_MAX - 3)

BUILD_ASSERT(MAX_SERVICES > 0, "Need at least 4 poll fds, increase CONFIG_ZVFS_POLL_MAX");

K_MUTEX_DEFINE(lock);
static struct pollfd sockfd_tcp[MAX_SERVICES];
static int tcp_socket = -1;
static int udp_socket = -1;

static void receive_data(bool is_udp, struct net_socket_service_event *pev,
			 char *buf, size_t buflen);
static void tcp_accept_handler(struct net_socket_service_event *pev);
static void restart_echo_service(void);

static void tcp_service_handler(struct net_socket_service_event *pev)
{
	static char buf[1500];

	receive_data(false, pev, buf, sizeof(buf));
}

static void udp_service_handler(struct net_socket_service_event *pev)
{
	static char buf[1500];

	receive_data(true, pev, buf, sizeof(buf));
}

NET_SOCKET_SERVICE_SYNC_DEFINE_STATIC(service_udp, udp_service_handler, 1);
NET_SOCKET_SERVICE_SYNC_DEFINE_STATIC(service_accept, tcp_accept_handler, 1);
NET_SOCKET_SERVICE_SYNC_DEFINE_STATIC(service_tcp, tcp_service_handler, MAX_SERVICES);

static void client_list_init(void)
{
	k_mutex_lock(&lock, K_FOREVER);
	ARRAY_FOR_EACH_PTR(sockfd_tcp, sockfd) {
		sockfd->fd = -1;
	}
	k_mutex_unlock(&lock);
}

static void client_list_deinit(void)
{
	(void)net_socket_service_unregister(&service_tcp);

	k_mutex_lock(&lock, K_FOREVER);
	ARRAY_FOR_EACH_PTR(sockfd_tcp, sockfd) {
		if (sockfd->fd != -1) {
			close(sockfd->fd);
			sockfd->fd = -1;
		}
	}
	k_mutex_unlock(&lock);
}

static void client_list_try_add(int sock)
{
	int ret;

	k_mutex_lock(&lock, K_FOREVER);
	ARRAY_FOR_EACH_PTR(sockfd_tcp, sockfd) {
		if (sockfd->fd == -1) {
			sockfd->fd = sock;
			sockfd->events = POLLIN;

			ret = net_socket_service_register(&service_tcp, sockfd_tcp,
							  ARRAY_SIZE(sockfd_tcp), NULL);
			if (ret < 0) {
				LOG_ERR("Cannot register socket service handler (%d). "
					"Attempting to restart service.", ret);
				restart_echo_service();
			}
			k_mutex_unlock(&lock);
			return;
		}
	}
	k_mutex_unlock(&lock);
	LOG_WRN("Max capacity reached");
	close(sock);
}

static void client_list_remove(int client)
{
	int ret;

	k_mutex_lock(&lock, K_FOREVER);
	ARRAY_FOR_EACH_PTR(sockfd_tcp, sockfd) {
		if (sockfd->fd == client) {
			close(client);
			sockfd->fd = -1;
			ret = net_socket_service_register(&service_tcp, sockfd_tcp,
							  ARRAY_SIZE(sockfd_tcp), NULL);
			if (ret < 0) {
				LOG_ERR("Cannot register socket service handler (%d). "
					"Attempting to restart service.", ret);
				restart_echo_service();
			}
			break;
		}
	}
	k_mutex_unlock(&lock);
}

static void receive_data(bool is_udp, struct net_socket_service_event *pev,
			 char *buf, size_t buflen)
{
	struct pollfd *pfd = &pev->event;
	int client = pfd->fd;
	struct sockaddr_in6 addr = { 0 };
	socklen_t addrlen = sizeof(addr);
	char addr_str[INET6_ADDRSTRLEN];
	int len, out_len;
	char *p;

	len = recvfrom(client, buf, buflen, 0,
		       (struct sockaddr *)&addr, &addrlen);
	if (len <= 0) {
		if (len < 0) {
			LOG_ERR("recv: %d", -errno);
		}
		if (!is_udp) {
			client_list_remove(client);
			inet_ntop(addr.sin6_family, &addr.sin6_addr, addr_str, sizeof(addr_str));
			LOG_INF("Connection from %s closed", addr_str);
		}
		return;
	}

	p = buf;
	do {
		if (is_udp) {
			out_len = sendto(client, p, len, 0,
					 (struct sockaddr *)&addr, addrlen);
		} else {
			out_len = send(client, p, len, 0);
		}

		if (out_len < 0) {
			LOG_ERR("sendto: %d", -errno);
			break;
		}

		p += out_len;
		len -= out_len;
	} while (len);
}

static void tcp_accept_handler(struct net_socket_service_event *pev)
{
	int client;
	int sock = pev->event.fd;
	char addr_str[INET6_ADDRSTRLEN];
	struct sockaddr_in6 client_addr;
	socklen_t client_addr_len = sizeof(client_addr);

	client = accept(sock, (struct sockaddr *)&client_addr, &client_addr_len);
	if (client < 0) {
		LOG_ERR("accept: %d. Restarting service.", -errno);
		restart_echo_service();
		return;
	}

	inet_ntop(client_addr.sin6_family, &client_addr.sin6_addr, addr_str, sizeof(addr_str));
	LOG_INF("Connection from %s (%d)", addr_str, client);

	client_list_try_add(client);
}

static int setup_tcp_socket(struct sockaddr_in6 *addr)
{
	socklen_t optlen = sizeof(int);
	int ret, sock, opt;

	sock = socket(AF_INET6, SOCK_STREAM, IPPROTO_TCP);
	if (sock < 0) {
		LOG_ERR("socket: %d", -errno);
		return -errno;
	}

	ret = getsockopt(sock, IPPROTO_IPV6, IPV6_V6ONLY, &opt, &optlen);
	if (ret == 0 && opt) {
		LOG_INF("IPV6_V6ONLY option is on, turning it off.");

		opt = 0;
		ret = setsockopt(sock, IPPROTO_IPV6, IPV6_V6ONLY, &opt, optlen);
		if (ret < 0) {
			LOG_WRN("Cannot turn off IPV6_V6ONLY option");
		} else {
			LOG_INF("Sharing same socket between IPv6 and IPv4");
		}
	}

	if (bind(sock, (struct sockaddr *)addr, sizeof(*addr)) < 0) {
		LOG_ERR("bind: %d", -errno);
		close(sock);
		return -errno;
	}

	if (listen(sock, 5) < 0) {
		LOG_ERR("listen: %d", -errno);
		close(sock);
		return -errno;
	}

	return sock;
}

static int setup_udp_socket(struct sockaddr_in6 *addr)
{
	socklen_t optlen = sizeof(int);
	int ret, sock, opt;

	sock = socket(AF_INET6, SOCK_DGRAM, IPPROTO_UDP);
	if (sock < 0) {
		LOG_ERR("socket: %d", -errno);
		return -errno;
	}

	ret = getsockopt(sock, IPPROTO_IPV6, IPV6_V6ONLY, &opt, &optlen);
	if (ret == 0 && opt) {
		LOG_INF("IPV6_V6ONLY option is on, turning it off.");

		opt = 0;
		ret = setsockopt(sock, IPPROTO_IPV6, IPV6_V6ONLY, &opt, optlen);
		if (ret < 0) {
			LOG_WRN("Cannot turn off IPV6_V6ONLY option");
		} else {
			LOG_INF("Sharing same socket between IPv6 and IPv4");
		}
	}

	if (bind(sock, (struct sockaddr *)addr, sizeof(*addr)) < 0) {
		LOG_ERR("bind: %d", -errno);
		close(sock);
		return -errno;
	}

	return sock;
}

static int start_echo_service(void)
{
	struct pollfd sockfd_accept, sockfd_udp;
	int tcp_sock, udp_sock, ret;
	struct sockaddr_in6 addr = {
		.sin6_family = AF_INET6,
		.sin6_addr = IN6ADDR_ANY_INIT,
		.sin6_port = htons(MY_PORT),
	};

	client_list_init();

	tcp_sock = setup_tcp_socket(&addr);
	if (tcp_sock < 0) {
		LOG_ERR("Failed to setup tcp listening socket");
		return tcp_sock;
	}

	udp_sock = setup_udp_socket(&addr);
	if (udp_sock < 0) {
		LOG_ERR("Failed to setup udp socket");
		ret = udp_sock;
		goto cleanup_tcp;
	}

	/* Register TCP listening socket to service handler */
	sockfd_accept = (struct pollfd){ .fd = tcp_sock, .events = POLLIN };
	ret = net_socket_service_register(&service_accept, &sockfd_accept, 1, NULL);
	if (ret < 0) {
		LOG_ERR("Cannot register socket service handler (%d)", ret);
		goto cleanup_sockets;
	}

	/* Register UDP socket to service handler */
	sockfd_udp = (struct pollfd){ .fd = udp_sock, .events = POLLIN };
	ret = net_socket_service_register(&service_udp, &sockfd_udp, 1, NULL);
	if (ret < 0) {
		LOG_ERR("Cannot register socket service handler (%d)", ret);
		goto cleanup_sockets;
	}

	k_mutex_lock(&lock, K_FOREVER);
	tcp_socket = tcp_sock;
	udp_socket = udp_sock;
	k_mutex_unlock(&lock);

	LOG_INF("Single-threaded TCP/UDP echo server waits "
		"for a connection on port %d", MY_PORT);

	return 0;

cleanup_sockets:
	close(udp_sock);
cleanup_tcp:
	close(tcp_sock);
	return -1;

}

static int stop_echo_service(void)
{
	client_list_deinit();
	(void)net_socket_service_unregister(&service_udp);
	(void)net_socket_service_unregister(&service_accept);

	k_mutex_lock(&lock, K_FOREVER);
	if (tcp_socket >= 0) {
		close(tcp_socket);
		tcp_socket = -1;
	}
	if (udp_socket >= 0) {
		close(udp_socket);
		udp_socket = -1;
	}
	k_mutex_unlock(&lock);

	return 0;
}

static void restart_echo_service(void)
{
	stop_echo_service();
	start_echo_service();
}


int main(void)
{
	int ret;

	init_vpn();

	ret = start_echo_service();
	if (ret < 0) {
		return ret;
	}

	k_sleep(K_FOREVER);

	return 0;
}
```
