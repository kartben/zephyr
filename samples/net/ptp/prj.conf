## CMakeLists.txt
```
# SPDX-License-Identifier: Apache-2.0

cmake_minimum_required(VERSION 3.28.3)

find_package(Zephyr REQUIRED HINTS $ENV{ZEPHYR_BASE})

target_include_directories(app PRIVATE ${ZEPHYR_BASE}/subsys/net/lib)

project(ptp)
target_sources(app PRIVATE src/main.c)
```

## prj.conf
```kconfig
CONFIG_NETWORKING=y
CONFIG_NET_LOG=y
CONFIG_LOG=y
CONFIG_NET_IPV4=y
CONFIG_NET_DHCPV4=n
CONFIG_NET_UDP=y

CONFIG_TEST_RANDOM_GENERATOR=y

CONFIG_NET_PKT_RX_COUNT=32
CONFIG_NET_PKT_TX_COUNT=32
CONFIG_NET_BUF_RX_COUNT=32
CONFIG_NET_BUF_TX_COUNT=32
CONFIG_NET_MAX_CONTEXTS=10

CONFIG_INIT_STACKS=y
CONFIG_PRINTK=y
CONFIG_NET_SHELL=y

# Ethernet is needed for PTP
CONFIG_NET_L2_ETHERNET=y

CONFIG_NET_CONFIG_NEED_IPV4=y
CONFIG_NET_CONFIG_SETTINGS=y

# First ethernet interface will use these settings
CONFIG_NET_CONFIG_MY_IPV4_ADDR="192.0.2.3"
CONFIG_NET_CONFIG_PEER_IPV4_ADDR="192.0.2.2"

# PTP settings
CONFIG_PTP_CLOCK=y
CONFIG_PTP=y
# CONFIG_PTP_LOG_LEVEL_DBG=y

CONFIG_LOG_MODE_DEFERRED=y


CONFIG_PTP_TIME_RECEIVER_ONLY=y
```

## src/main.c
```c
/*
 * Copyright (c) 2024 BayLibre SAS
 *
 * SPDX-License-Identifier: Apache-2.0
 */

#include <zephyr/logging/log.h>
LOG_MODULE_REGISTER(net_ptp_sample, LOG_LEVEL_DBG);

#include <zephyr/kernel.h>

#include <errno.h>
#include <stdlib.h>

#include "ptp/clock.h"
#include "ptp/port.h"

static int run_duration = 10 ; // CONFIG_NET_SAMPLE_RUN_DURATION;
static struct k_work_delayable stop_sample;
static struct k_sem quit_lock;

static void stop_handler(struct k_work *work)
{
	ARG_UNUSED(work);

	printf("Starting stop handler\n");

	k_sem_give(&quit_lock);
}

static int get_current_status(void)
{
	printf("get_current_status\n");
	struct ptp_port *port;
	sys_slist_t *ports_list = ptp_clock_ports_list();

	printf("ports_list = %p\n", ports_list);
	if (!ports_list || sys_slist_len(ports_list) == 0) {
		return -EINVAL;
	}

	port = CONTAINER_OF(sys_slist_peek_head(ports_list), struct ptp_port, node);

	printf("port = %p\n", port);
	if (!port) {
		return -EINVAL;
	}

	printf("port state = %d\n", ptp_port_state(port));

	switch (ptp_port_state(port)) {
	case PTP_PS_INITIALIZING:
	case PTP_PS_FAULTY:
	case PTP_PS_DISABLED:
	case PTP_PS_LISTENING:
	case PTP_PS_PRE_TIME_TRANSMITTER:
	case PTP_PS_PASSIVE:
	case PTP_PS_UNCALIBRATED:
		printk("FAIL\n");
		return 0;
	case PTP_PS_TIME_RECEIVER:
		printk("TIME RECEIVER\n");
		return 2;
	case PTP_PS_TIME_TRANSMITTER:
	case PTP_PS_GRAND_MASTER:
		printk("TIME TRANSMITTER\n");
		return 1;
	}

	return -1;
}

void init_testing(void)
{
	uint32_t uptime = k_uptime_get_32();
	int ret;

	if (run_duration == 0) {
		return;
	}

	printf("Running PTP sample for %u seconds\n", run_duration);
	k_sem_init(&quit_lock, 0, K_SEM_MAX_LIMIT);

	printf("k_work_init_delayable\n");
	k_work_init_delayable(&stop_sample, stop_handler);
	printf("k_work_reschedule\n");
	k_work_reschedule(&stop_sample, K_SECONDS(run_duration));

	printf("k_sem_take\n");
	k_sem_take(&quit_lock, K_FOREVER);

	printf("Stopping after %u seconds\n",
		(k_uptime_get_32() - uptime) / 1000);

	/* Try to figure out what is the sync state.
	 * Return:
	 *  <0 - configuration error
	 *   0 - not time sync
	 *   1 - we are TimeTransmitter
	 *   2 - we are TimeReceiver
	 */
	ret = get_current_status();
	LOG_INF("Current status: %d", ret);
	LOG_INF("Current PTP time = xxx");


	//exit(ret);
}

int main(void)
{
	LOG_INF("Starting PTP sample");
	init_testing();
	return 0;
}
```
