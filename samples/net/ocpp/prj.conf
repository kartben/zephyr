## CMakeLists.txt
```
# SPDX-License-Identifier: Apache-2.0

cmake_minimum_required(VERSION 3.28.3)

find_package(Zephyr REQUIRED HINTS $ENV{ZEPHYR_BASE})
project(ocpp)

include(${ZEPHYR_BASE}/samples/net/common/common.cmake)
target_sources(app PRIVATE src/main.c)

set(gen_dir ${ZEPHYR_BINARY_DIR}/include/generated/)

if(CONFIG_NET_SOCKETS_SOCKOPT_TLS AND (NOT USE_DUMMY_CREDS))
generate_inc_file_for_target(
    app
    # <path-to-certificate-file> (e.g. src/credentials/device.crt)
    # <path-to-generated-.inc-file> (e.g. ${gen_dir}/device.crt.inc)
)
endif()
```

## Kconfig
```
# Config options for OCPP sample application

# Copyright (c) 2025 Linumiz GmbH
# SPDX-License-Identifier: Apache-2.0

mainmenu "OCPP sample application"
config NET_SAMPLE_OCPP_SERVER
	string "OCPP server ip"
	help
	  OCPP central system server ip address

config NET_SAMPLE_OCPP_PORT
	int "OCPP server port"
	help
	  OCPP central system server port

config NET_SAMPLE_OCPP_WS_PATH
	string "OCPP websocket path"
	default "/steve/websocket/CentralSystemService/zephyr"
	help
	  WebSocket URL path (excluding IP address and port) for OCPP connection to the central
	  system server.

config NET_SAMPLE_SNTP_SERVER
	string "SNTP server ip"
	help
	  SNTP server ip to get the time from network

config NET_SAMPLE_OCPP_NUM_CONNECTORS
	int "Number of OCPP connectors"
	default 2
	range 1 10
	help
	  Number of OCPP charge point connectors to create.
	  Each connector will run in its own thread.

source "Kconfig.zephyr"
```

## sample.yaml
```
sample:
  description: OCPP sample application
  name: OCPP charge point
tests:
  sample.net.ocpp:
    harness: net
    depends_on: netif
    tags:
      - net
      - ocpp
  sample.net.ocpp.gui:
    harness: display_capture
    tags:
      - net
      - ocpp
      - display
    harness_config:
      pytest_dut_scope: session
      fixture: fixture_display
      display_capture_config: "display_config.yaml"
```

## prj.conf
```kconfig
# HTTP & Websocket
CONFIG_HTTP_CLIENT=y
CONFIG_WEBSOCKET_CLIENT=y

# Networking config
CONFIG_NETWORKING=y
CONFIG_NET_IPV4=y
CONFIG_NET_IPV6=n
CONFIG_NET_CONNECTION_MANAGER=y
CONFIG_NET_CONFIG_SETTINGS=y
CONFIG_NET_TCP=y
CONFIG_NET_SOCKETS=y
CONFIG_NET_SOCKETS_POLL_MAX=4
CONFIG_NET_L2_ETHERNET=y
CONFIG_ETH_DRIVER=y
CONFIG_LOG=n
CONFIG_NET_LOG=n

# OCPP
CONFIG_OCPP=y

# Please set the server addresses when compiling the sample
CONFIG_NET_SAMPLE_SNTP_SERVER="129.6.15.28"
CONFIG_NET_SAMPLE_OCPP_SERVER="192.168.2.1"
CONFIG_NET_SAMPLE_OCPP_PORT=8092
CONFIG_NET_SAMPLE_OCPP_WS_PATH="/zephyr"

CONFIG_HEAP_MEM_POOL_SIZE=15000

CONFIG_JSON_LIBRARY=y
CONFIG_PICOLIBC=y
CONFIG_NET_ARP=y
CONFIG_NET_UDP=y
CONFIG_NET_DHCPV4=y
CONFIG_NET_DHCPV4_OPTION_CALLBACKS=y
CONFIG_TEST_RANDOM_GENERATOR=y

CONFIG_NET_TX_STACK_SIZE=2048
CONFIG_NET_RX_STACK_SIZE=2048
CONFIG_NET_PKT_RX_COUNT=28
CONFIG_NET_BUF_RX_COUNT=60
CONFIG_NET_MGMT=y
CONFIG_NET_MGMT_EVENT=y

CONFIG_SNTP=y

CONFIG_ZBUS=y
CONFIG_ZBUS_RUNTIME_OBSERVERS=y
CONFIG_POSIX_API=y
CONFIG_POSIX_CLOCK_SELECTION=y

# Display & LVGL GUI
CONFIG_DISPLAY=y
CONFIG_LVGL=y
CONFIG_LV_USE_LOG=y
CONFIG_LV_CONF_MINIMAL=y
CONFIG_LV_USE_FLEX=y
CONFIG_LV_USE_LABEL=y
CONFIG_LV_USE_BUTTON=y
CONFIG_LV_USE_BAR=y
CONFIG_LV_USE_THEME_SIMPLE=y
CONFIG_LV_FONT_MONTSERRAT_12=y
CONFIG_LV_FONT_MONTSERRAT_18=y
CONFIG_LV_FONT_MONTSERRAT_28=y
CONFIG_LV_Z_MEM_POOL_SIZE=20000
CONFIG_LV_DRAW_SW_SHADOW_CACHE_SIZE=20
CONFIG_LV_Z_VDB_ZEPHYR_REGION=y
CONFIG_LV_Z_VDB_ZEPHYR_REGION_NAME="PSRAM_VDB"
CONFIG_MAIN_STACK_SIZE=12000


CONFIG_LV_Z_FULL_REFRESH=n
CONFIG_LV_Z_DOUBLE_VDB=y

# Input subsystem for button support
CONFIG_INPUT=y
CONFIG_INPUT_GPIO_KEYS=y

CONFIG_CPU_LOAD_METRIC=y

# CONFIG_SHELL=y
CONFIG_INSTRUMENTATION=y
CONFIG_INSTRUMENTATION_EXCLUDE_FILE_LIST="cmsis_gcc.h,cmsis_gcc_m.h,kernel/,drivers/,subsys/,modules/"
CONFIG_IDLE_STACK_SIZE=4096
CONFIG_LOG_PROCESS_THREAD_STACK_SIZE=4096
CONFIG_SYSTEM_WORKQUEUE_STACK_SIZE=4096
CONFIG_NET_MGMT_EVENT_STACK_SIZE=4096
CONFIG_NET_CONNECTION_MANAGER_MONITOR_STACK_SIZE=4096


CONFIG_INSTRUMENTATION_TRIGGER_FUNCTION="user_notify_cb"
CONFIG_INSTRUMENTATION_STOPPER_FUNCTION="user_notify_cb"


CONFIG_RETENTION=n


# CONFIG_INSTRUMENTATION_MODE_CALLGRAPH_BUFFER_OVERWRITE=n
# CONFIG_INSTRUMENTATION_MODE_CALLGRAPH_TRACE_BUFFER_SIZE=100000
```

## overlay-citrineos.conf
```kconfig
# Configuration overlay for connecting to CitrineOS Central System
#
# CitrineOS is an open-source OCPP Central System implementation
# Default configuration assumes CitrineOS is running on the local network

# CitrineOS default configuration
CONFIG_NET_SAMPLE_OCPP_PORT=8080

# CitrineOS uses a different endpoint path than SteVe
# This will be set in the application code via overlay

# Optionally increase timeouts for CitrineOS if needed
# CONFIG_NET_SOCKETS_CONNECT_TIMEOUT=10000
```

## prj_citrineos.conf
```kconfig
# Configuration for OCPP CitrineOS demo
# This is a complete configuration file optimized for CitrineOS

# HTTP & Websocket
CONFIG_HTTP_CLIENT=y
CONFIG_WEBSOCKET_CLIENT=y

# Networking config
CONFIG_NETWORKING=y
CONFIG_NET_IPV4=y
CONFIG_NET_IPV6=n
CONFIG_NET_CONNECTION_MANAGER=y
CONFIG_NET_CONFIG_SETTINGS=y
CONFIG_NET_TCP=y
CONFIG_NET_SOCKETS=y
CONFIG_NET_SOCKETS_POLL_MAX=4
CONFIG_NET_L2_ETHERNET=y
CONFIG_ETH_DRIVER=y
CONFIG_LOG=y
CONFIG_NET_LOG=y

# OCPP
CONFIG_OCPP=y

# CitrineOS default configuration
# Server addresses should be set when compiling the sample
CONFIG_NET_SAMPLE_SNTP_SERVER=""
CONFIG_NET_SAMPLE_OCPP_SERVER=""
CONFIG_NET_SAMPLE_OCPP_PORT=8080

CONFIG_MAIN_STACK_SIZE=4096
CONFIG_HEAP_MEM_POOL_SIZE=15000

CONFIG_JSON_LIBRARY=y
CONFIG_PICOLIBC=y
CONFIG_NET_ARP=y
CONFIG_NET_UDP=y
CONFIG_NET_DHCPV4=y
CONFIG_NET_DHCPV4_OPTION_CALLBACKS=y
CONFIG_TEST_RANDOM_GENERATOR=y

CONFIG_NET_TX_STACK_SIZE=2048
CONFIG_NET_RX_STACK_SIZE=2048
CONFIG_NET_PKT_RX_COUNT=28
CONFIG_NET_BUF_RX_COUNT=60
CONFIG_NET_MGMT=y
CONFIG_NET_MGMT_EVENT=y

CONFIG_SNTP=y

CONFIG_ZBUS=y
CONFIG_ZBUS_RUNTIME_OBSERVERS=y
CONFIG_POSIX_API=y
CONFIG_POSIX_CLOCK_SELECTION=y
```

## prj_gui.conf
```kconfig
# HTTP & Websocket
CONFIG_HTTP_CLIENT=y
CONFIG_WEBSOCKET_CLIENT=y

# Networking config
CONFIG_NETWORKING=y
CONFIG_NET_IPV4=y
CONFIG_NET_IPV6=n
CONFIG_NET_CONNECTION_MANAGER=y
CONFIG_NET_CONFIG_SETTINGS=y
CONFIG_NET_TCP=y
CONFIG_NET_SOCKETS=y
CONFIG_NET_SOCKETS_POLL_MAX=4
CONFIG_NET_L2_ETHERNET=y
CONFIG_ETH_DRIVER=y
CONFIG_LOG=y
CONFIG_NET_LOG=y

# OCPP
CONFIG_OCPP=y

# Please set the server addresses when compiling the sample
CONFIG_NET_SAMPLE_SNTP_SERVER=""
CONFIG_NET_SAMPLE_OCPP_SERVER=""
CONFIG_NET_SAMPLE_OCPP_PORT=8180

CONFIG_MAIN_STACK_SIZE=8192
CONFIG_HEAP_MEM_POOL_SIZE=32000

CONFIG_JSON_LIBRARY=y
CONFIG_PICOLIBC=y
CONFIG_NET_ARP=y
CONFIG_NET_UDP=y
CONFIG_NET_DHCPV4=y
CONFIG_NET_DHCPV4_OPTION_CALLBACKS=y
CONFIG_TEST_RANDOM_GENERATOR=y

CONFIG_NET_TX_STACK_SIZE=2048
CONFIG_NET_RX_STACK_SIZE=2048
CONFIG_NET_PKT_RX_COUNT=28
CONFIG_NET_BUF_RX_COUNT=60
CONFIG_NET_MGMT=y
CONFIG_NET_MGMT_EVENT=y

CONFIG_SNTP=y

CONFIG_ZBUS=y
CONFIG_ZBUS_RUNTIME_OBSERVERS=y
CONFIG_POSIX_API=y
CONFIG_POSIX_CLOCK_SELECTION=y

# LVGL Configuration
CONFIG_LVGL=y
CONFIG_LV_Z_MEM_POOL_SIZE=32768
CONFIG_DISPLAY=y
CONFIG_INPUT=y

# LVGL Fonts
CONFIG_LV_FONT_MONTSERRAT_12=y
CONFIG_LV_FONT_MONTSERRAT_14=y
CONFIG_LV_FONT_MONTSERRAT_16=y
CONFIG_LV_FONT_MONTSERRAT_18=y

# LVGL Features
CONFIG_LV_USE_LABEL=y
CONFIG_LV_USE_OBJ=y
```

## shell.conf
```kconfig
# Overlay configuration to enable OCPP shell for testing
CONFIG_SHELL=y
CONFIG_OCPP_SHELL=y
```

## boards/native_sim.conf
```kconfig
# Network address config
CONFIG_NET_DHCPV4=n
CONFIG_NET_CONFIG_NEED_IPV4=y
CONFIG_NET_CONFIG_MY_IPV4_ADDR="192.0.2.1"
CONFIG_NET_CONFIG_PEER_IPV4_ADDR="192.0.2.2"
CONFIG_NET_CONFIG_MY_IPV4_GW="192.0.2.2"
```

## boards/stm32f769i_disco.conf
```kconfig
# Enable display driver
CONFIG_DISPLAY_STM32_LTDC=y

# LVGL memory configuration for larger display
CONFIG_LV_Z_MEM_POOL_SIZE=65536
```

## boards/native_sim.overlay
```dts
/*
 * Copyright (c) 2025 Linumiz GmbH
 *
 * SPDX-License-Identifier: Apache-2.0
 */

/ {
	chosen {
		zephyr,display = &sdl_dc;
	};

	lvgl_pointer {
		compatible = "zephyr,lvgl-pointer-input";
		input = <&sdl_dc>;
	};
};

&sdl_dc {
	width = <480>;
	height = <320>;
};
```

## src/main.c
```c
/*
 * Copyright (c) 2025 Linumiz GmbH
 *
 * SPDX-License-Identifier: Apache-2.0
 */

#undef _POSIX_C_SOURCE
#define _POSIX_C_SOURCE 200809L /* for strdup() */
#include <stdio.h>
#include <stdarg.h>
#include <string.h>
#include <time.h>

#include <zephyr/posix/sys/socket.h>
#include <zephyr/posix/arpa/inet.h>
#include <zephyr/posix/netinet/in.h>
#include <zephyr/posix/unistd.h>
#include <zephyr/posix/netdb.h>

#include <zephyr/net/net_if.h>
#include <zephyr/net/net_core.h>
#include <zephyr/net/net_context.h>
#include <zephyr/net/net_mgmt.h>
#include <zephyr/net/sntp.h>
#include <zephyr/net/ocpp.h>
#include <zephyr/random/random.h>
#include <zephyr/zbus/zbus.h>
#include <zephyr/usb/usbd.h>
#include <zephyr/usb/usb_device.h>
#include <zephyr/drivers/uart.h>
#include <sample_usbd.h>

#include "net_sample_common.h"

LOG_MODULE_REGISTER(main, LOG_LEVEL_INF);

#define NO_OF_CONN 2
K_KERNEL_STACK_ARRAY_DEFINE(cp_stk, NO_OF_CONN, 2 * 1024);

static struct k_thread tinfo[NO_OF_CONN];
static k_tid_t tid[NO_OF_CONN];
static char idtag[NO_OF_CONN][25];

/* USB High-Speed Data Logger for showcasing USB HS capabilities */
#if defined(CONFIG_USB_DEVICE_STACK_NEXT)
static const struct device *const usb_cdc_dev = DEVICE_DT_GET_ONE(zephyr_cdc_acm_uart);
static bool usb_enabled;
static uint32_t usb_bytes_sent;
static uint32_t meter_reading_count;

/* USB logging thread stack and data */
#define USB_LOG_STACK_SIZE 2048
K_THREAD_STACK_DEFINE(usb_log_stack, USB_LOG_STACK_SIZE);
static struct k_thread usb_log_thread_data;

/* Ring buffer for USB logging to demonstrate high-speed throughput */
#define USB_LOG_RING_BUF_SIZE 4096
K_MSGQ_DEFINE(usb_log_msgq, 128, 32, 4);

static void usb_log_data(const char *format, ...)
{
	char buf[128];
	va_list args;
	int len;

	if (!usb_enabled) {
		return;
	}

	va_start(args, format);
	len = vsnprintf(buf, sizeof(buf), format, args);
	va_end(args);

	if (len > 0 && len < sizeof(buf)) {
		/* Try to queue the message, drop if queue is full */
		k_msgq_put(&usb_log_msgq, buf, K_NO_WAIT);
	}
}

static void usb_logger_thread(void *p1, void *p2, void *p3)
{
	char msg[128];
	uint32_t dtr = 0;

	ARG_UNUSED(p1);
	ARG_UNUSED(p2);
	ARG_UNUSED(p3);

	if (!device_is_ready(usb_cdc_dev)) {
		LOG_ERR("USB CDC ACM device not ready");
		return;
	}

	LOG_INF("USB High-Speed logger started");
	LOG_INF("Connect to USB CDC ACM port to see charging data at high speed");

	while (1) {
		uart_line_ctrl_get(usb_cdc_dev, UART_LINE_CTRL_DTR, &dtr);
		if (dtr) {
			usb_enabled = true;
			/* Process queued log messages */
			while (k_msgq_get(&usb_log_msgq, msg, K_NO_WAIT) == 0) {
				int len = strlen(msg);

				uart_fifo_fill(usb_cdc_dev, msg, len);
				usb_bytes_sent += len;
			}
		} else {
			usb_enabled = false;
		}

		k_sleep(K_MSEC(10));
	}
}
#endif /* CONFIG_USB_DEVICE_STACK_NEXT */


static int ocpp_get_time_from_sntp(void)
{
	struct sntp_ctx ctx;
	struct sntp_time stime;
	struct sockaddr_in addr;
	struct timespec tv;
	int ret;

	/* ipv4 */
	memset(&addr, 0, sizeof(addr));
	addr.sin_family = AF_INET;
	addr.sin_port = htons(123);
	inet_pton(AF_INET, CONFIG_NET_SAMPLE_SNTP_SERVER, &addr.sin_addr);

	ret = sntp_init(&ctx, (struct sockaddr *) &addr,
			sizeof(struct sockaddr_in));
	if (ret < 0) {
		LOG_ERR("Failed to init SNTP IPv4 ctx: %d", ret);
		return ret;
	}

	ret = sntp_query(&ctx, 60, &stime);
	if (ret < 0) {
		LOG_ERR("SNTP IPv4 request failed: %d", ret);
		return ret;
	}

	LOG_INF("sntp succ since Epoch: %llu\n", stime.seconds);
	tv.tv_sec = stime.seconds;
	clock_settime(CLOCK_REALTIME, &tv);
	sntp_close(&ctx);
	return 0;
}

ZBUS_CHAN_DEFINE(ch_event, /* Name */
		 union ocpp_io_value,
		 NULL,			/* Validator */
		 NULL,			/* User data */
		 ZBUS_OBSERVERS_EMPTY,	/* observers */
		 ZBUS_MSG_INIT(0) /* Initial value {0} */
);

ZBUS_SUBSCRIBER_DEFINE(cp_thread0, 5);
ZBUS_SUBSCRIBER_DEFINE(cp_thread1, 5);
struct zbus_observer *obs[NO_OF_CONN] = {(struct zbus_observer *)&cp_thread0,
					 (struct zbus_observer *)&cp_thread1};

static void ocpp_cp_entry(void *p1, void *p2, void *p3);
static int user_notify_cb(enum ocpp_notify_reason reason,
			  union ocpp_io_value *io,
			  void *user_data)
{
	static int wh = 6 + NO_OF_CONN;
	int idx;
	int i;

	switch (reason) {
	case OCPP_USR_GET_METER_VALUE:
		if (OCPP_OMM_ACTIVE_ENERGY_TO_EV == io->meter_val.mes) {
			snprintf(io->meter_val.val, CISTR50, "%u",
				 wh + io->meter_val.id_con);

			wh++;
			LOG_DBG("mtr reading val %s con %d", io->meter_val.val,
				io->meter_val.id_con);

#if defined(CONFIG_USB_DEVICE_STACK_NEXT)
			/* USB High-Speed showcase: Log meter readings for analysis */
			meter_reading_count++;
			usb_log_data("[METER] Conn%d: %s Wh (reading #%u)\r\n",
				     io->meter_val.id_con, io->meter_val.val,
				     meter_reading_count);
#endif
			return 0;
		}
		break;

	case OCPP_USR_START_CHARGING:
		if (io->start_charge.id_con < 0) {
			for (i = 0; i < NO_OF_CONN; i++) {
				if (tid[i] == NULL) {
					break;
				}
			}

			if (i >= NO_OF_CONN) {
				return -EBUSY;
			}
			idx = i;
		} else {
			idx = io->start_charge.id_con - 1;
		}

		if (tid[idx] == NULL) {
			LOG_INF("Remote start charging idtag %s connector %d\n",
				idtag[idx], idx + 1);

#if defined(CONFIG_USB_DEVICE_STACK_NEXT)
			/* USB High-Speed showcase: Log charging session start */
			usb_log_data("[START] Connector %d: ID=%s\r\n",
				     idx + 1, io->start_charge.idtag);
#endif

			strncpy(idtag[idx], io->start_charge.idtag,
				sizeof(idtag[0]));

			tid[idx] = k_thread_create(&tinfo[idx], cp_stk[idx],
						   sizeof(cp_stk[idx]), ocpp_cp_entry,
						   (void *)(uintptr_t)(idx + 1), idtag[idx],
						   obs[idx], 7, 0, K_NO_WAIT);

			return 0;
		}
		break;

	case OCPP_USR_STOP_CHARGING:
#if defined(CONFIG_USB_DEVICE_STACK_NEXT)
		/* USB High-Speed showcase: Log charging session stop */
		usb_log_data("[STOP] Connector %d: Session ended\r\n",
			     io->stop_charge.id_con);
#endif
		zbus_chan_pub(&ch_event, io, K_MSEC(100));
		return 0;

	case OCPP_USR_UNLOCK_CONNECTOR:
		LOG_INF("unlock connector %d\n", io->unlock_con.id_con);
		return 0;
	}

	return -ENOTSUP;
}

static void ocpp_cp_entry(void *p1, void *p2, void *p3)
{
	int ret;
	int idcon = (int)(uintptr_t)p1;
	char *idtag = (char *)p2;
	struct zbus_observer *obs = (struct zbus_observer *)p3;
	ocpp_session_handle_t sh = NULL;
	enum ocpp_auth_status status;
	const uint32_t timeout_ms = 500;

	ret = ocpp_session_open(&sh);
	if (ret < 0) {
		LOG_ERR("ocpp open ses idcon %d> res %d\n", idcon, ret);
		return;
	}

	while (1) {
		/* Avoid quick retry since authorization request is possible only
		 * after Bootnotification process (handled in lib) completed.
		 */

		k_sleep(K_SECONDS(5));
		ret = ocpp_authorize(sh,
				     idtag,
				     &status,
				     timeout_ms);
		if (ret < 0) {
			LOG_ERR("ocpp auth %d> idcon %d status %d\n",
				ret, idcon, status);
		} else {
			LOG_INF("ocpp auth %d> idcon %d status %d\n",
				ret, idcon, status);
#if defined(CONFIG_USB_DEVICE_STACK_NEXT)
			usb_log_data("[AUTH] Connector %d: Authorized (status=%d)\r\n",
				     idcon, status);
#endif
			break;
		}
	}

	if (status != OCPP_AUTH_ACCEPTED) {
		LOG_ERR("ocpp start idcon %d> not authorized status %d\n",
			idcon, status);
		return;
	}

	ret = ocpp_start_transaction(sh, sys_rand32_get(), idcon, timeout_ms);
	if (ret == 0) {
		const struct zbus_channel *chan;
		union ocpp_io_value io;

		LOG_INF("ocpp start charging connector id %d\n", idcon);
		memset(&io, 0xff, sizeof(io));

		/* wait for stop charging event from main or remote CS */
		zbus_chan_add_obs(&ch_event, obs, K_SECONDS(1));
		do {
			zbus_sub_wait(obs, &chan, K_FOREVER);
			zbus_chan_read(chan, &io, K_SECONDS(1));

			if (io.stop_charge.id_con == idcon) {
				break;
			}

		} while (1);
	}

	ret = ocpp_stop_transaction(sh, sys_rand32_get(), timeout_ms);
	if (ret < 0) {
		LOG_ERR("ocpp stop txn idcon %d> %d\n", idcon, ret);
		return;
	}

	LOG_INF("ocpp stop charging connector id %d\n", idcon);
	k_sleep(K_SECONDS(1));
	ocpp_session_close(sh);
	tid[idcon - 1] = NULL;
	k_sleep(K_SECONDS(1));
	k_thread_abort(k_current_get());
}

static int ocpp_getaddrinfo(char *server, int port, char **ip)
{
	int ret;
	uint8_t retry = 5;
	char addr_str[INET_ADDRSTRLEN];
	struct sockaddr_storage b;
	struct addrinfo *result = NULL;
	struct addrinfo *addr;
	struct addrinfo hints = {
		.ai_family = AF_INET,
		.ai_socktype = SOCK_STREAM
	};

	LOG_INF("cs server %s %d", server, port);
	do {
		ret = getaddrinfo(server, NULL, &hints, &result);
		if (ret == -EAGAIN) {
			LOG_ERR("ERROR: getaddrinfo %d, rebind", ret);
			k_sleep(K_SECONDS(1));
		} else if (ret != 0) {
			LOG_ERR("ERROR: getaddrinfo failed %d", ret);
			return ret;
		}
	} while (--retry && ret);

	addr = result;
	while (addr != NULL) {
		/* IPv4 Address. */
		if (addr->ai_addrlen == sizeof(struct sockaddr_in)) {
			struct sockaddr_in *broker =
				((struct sockaddr_in *)&b);

			broker->sin_addr.s_addr =
				((struct sockaddr_in *)addr->ai_addr)
				->sin_addr.s_addr;
			broker->sin_family = AF_INET;
			broker->sin_port = htons(port);

			inet_ntop(AF_INET, &broker->sin_addr, addr_str,
				  sizeof(addr_str));

			*ip = strdup(addr_str);
			LOG_INF("IPv4 Address %s", addr_str);
			break;
		}

		LOG_ERR("error: ai_addrlen = %u should be %u or %u",
			(unsigned int)addr->ai_addrlen,
			(unsigned int)sizeof(struct sockaddr_in),
			(unsigned int)sizeof(struct sockaddr_in6));

		addr = addr->ai_next;
	}

	/* Free the address. */
	freeaddrinfo(result);

	return 0;
}

int main(void)
{
	int ret;
	int i;
	char *ip = NULL;

	struct ocpp_cp_info cpi = { "basic", "zephyr", .num_of_con = NO_OF_CONN };
	struct ocpp_cs_info csi = {NULL,
				   CONFIG_NET_SAMPLE_OCPP_WS_PATH,
				   CONFIG_NET_SAMPLE_OCPP_PORT,
				   AF_INET};

	printk("OCPP sample %s\n", CONFIG_BOARD);

#if defined(CONFIG_USB_DEVICE_STACK_NEXT)
	/* USB High-Speed showcase: Initialize USB CDC ACM for data logging */
	LOG_INF("Initializing USB High-Speed CDC ACM logger...");
	ret = usb_enable(NULL);
	if (ret != 0) {
		LOG_ERR("Failed to enable USB: %d", ret);
	} else {
		LOG_INF("USB High-Speed enabled - demonstrating fast data logging");
		/* Start USB logger thread */
		k_thread_create(&usb_log_thread_data, usb_log_stack,
				K_THREAD_STACK_SIZEOF(usb_log_stack),
				usb_logger_thread,
				NULL, NULL, NULL,
				K_PRIO_COOP(7), 0, K_NO_WAIT);
		k_thread_name_set(&usb_log_thread_data, "usb_logger");
		
		usb_log_data("\r\n=== OCPP USB High-Speed Logger ===\r\n");
		usb_log_data("This showcases USB High-Speed (480 Mbps) data transfer\r\n");
		usb_log_data("Logging charging session data in real-time\r\n\r\n");
	}
#endif

	wait_for_network();

	ret = ocpp_getaddrinfo(CONFIG_NET_SAMPLE_OCPP_SERVER, CONFIG_NET_SAMPLE_OCPP_PORT, &ip);
	if (ret < 0) {
		return ret;
	}

	csi.cs_ip = ip;

	ocpp_get_time_from_sntp();

	ret = ocpp_init(&cpi,
			&csi,
			user_notify_cb,
			NULL);
	if (ret < 0) {
		LOG_ERR("ocpp init failed %d\n", ret);
		return ret;
	}

	/* Spawn threads for each connector */
	for (i = 0; i < NO_OF_CONN; i++) {
		snprintf(idtag[i], sizeof(idtag[0]), "ZepId%02d", i);

		tid[i] = k_thread_create(&tinfo[i], cp_stk[i],
					 sizeof(cp_stk[i]),
					 ocpp_cp_entry, (void *)(uintptr_t)(i + 1),
					 idtag[i], obs[i], 7, 0, K_NO_WAIT);
	}

	/* Active charging session */
	k_sleep(K_SECONDS(30));

	/* Send stop charging to thread */
	for (i = 0; i < NO_OF_CONN; i++) {
		union ocpp_io_value io = {0};

		io.stop_charge.id_con = i + 1;

		zbus_chan_pub(&ch_event, &io, K_MSEC(100));
		k_sleep(K_SECONDS(1));
	}

#if defined(CONFIG_USB_DEVICE_STACK_NEXT)
	/* USB High-Speed showcase: Display throughput statistics */
	usb_log_data("\r\n=== Session Summary ===\r\n");
	usb_log_data("Total meter readings: %u\r\n", meter_reading_count);
	usb_log_data("USB data transferred: %u bytes\r\n", usb_bytes_sent);
	usb_log_data("Average throughput: ~%u bytes/sec\r\n",
		     usb_bytes_sent / 32); /* Approximate based on 30s session */
	usb_log_data("USB High-Speed (480 Mbps) enables efficient data logging\r\n");
#endif

	/* User could trigger remote start/stop transaction from CS server */
	k_sleep(K_SECONDS(1200));

	return 0;
}
```

## src/charge_sim.c
```c
/*
 * SPDX-FileCopyrightText: Copyright The Zephyr Project Contributors
 *
 * SPDX-License-Identifier: Apache-2.0
 */

#include "charge_sim.h"
#include <zephyr/random/random.h>
#include <zephyr/logging/log.h>

LOG_MODULE_REGISTER(charge_sim, LOG_LEVEL_DBG);

/* Charging constants */
#define CHARGING_VOLTAGE_V  480
#define CHARGING_CURRENT_A  120
#define CHARGING_POWER_W    (CHARGING_VOLTAGE_V * CHARGING_CURRENT_A)
/* Base meter reading per connector (Wh) */
#define BASE_METER_WH       10000
/* Battery capacity (assumed 50 kWh for typical EV) */
#define BATTERY_CAPACITY_WH 10000
/* Starting state of charge percentage */
#define START_SOC_PERCENT   20

/* Jitter ranges */
#define VOLTAGE_JITTER_V 10  /* ±10V */
#define CURRENT_JITTER_A 1   /* ±1A */
#define POWER_JITTER_W   200 /* ±200W */

void charge_sim_init_state(struct charge_sim_state *state, int conn_idx)
{
	if (state == NULL) {
		return;
	}

	state->start_time_ms = 0;
	state->start_meter_wh = 0;
	state->start_soc_percent = START_SOC_PERCENT;
	state->is_charging = false;
}

void charge_sim_start_session(struct charge_sim_state *state, int conn_idx, int64_t current_time_ms)
{
	if (state == NULL) {
		return;
	}

	state->start_time_ms = current_time_ms;
	state->start_meter_wh = BASE_METER_WH + (conn_idx * 1000);
	state->start_soc_percent = START_SOC_PERCENT;
	state->is_charging = true;

	LOG_DBG("Started charging session: conn=%d, start_meter=%u Wh, start_soc=%u%%", conn_idx,
		state->start_meter_wh, state->start_soc_percent);
}

void charge_sim_stop_session(struct charge_sim_state *state)
{
	if (state == NULL) {
		return;
	}

	state->is_charging = false;
	LOG_DBG("Stopped charging session");
}

uint32_t charge_sim_get_meter_value(const struct charge_sim_state *state, int conn_idx,
				    int64_t current_time_ms)
{
	int64_t elapsed_ms;
	double elapsed_hours;
	uint32_t energy_wh;
	uint32_t meter_value;

	if (state == NULL) {
		return BASE_METER_WH + (conn_idx * 1000);
	}

	if (!state->is_charging || state->start_time_ms == 0) {
		/* Not charging, return base meter reading */
		return BASE_METER_WH + (conn_idx * 1000);
	}

	/* Calculate elapsed time since start */
	elapsed_ms = current_time_ms - state->start_time_ms;
	elapsed_hours = (double)elapsed_ms / 3600000.0; /* Convert ms to hours */

	/* Calculate energy consumed: Power (W) * Time (h) = Energy (Wh) */
	energy_wh = (uint32_t)(CHARGING_POWER_W * elapsed_hours);

	/* Add jitter: ±1% of energy consumed */
	/* Generate jitter: -1% to +1% (99% to 101% of energy) */
	int jitter_percent = (sys_rand32_get() % 3) - 1; /* -1, 0, or +1 */
	/* Calculate jitter as signed to handle negative values correctly */
	int32_t jitter_wh_signed = (int32_t)(((int64_t)energy_wh * jitter_percent) / 100);

	/* Current meter reading = start meter + energy consumed (with jitter) */
	/* Use signed arithmetic to handle negative jitter, then clamp to ensure
	 * meter value never goes below start meter value
	 */
	int64_t meter_value_signed =
		(int64_t)state->start_meter_wh + (int64_t)energy_wh + jitter_wh_signed;
	if (meter_value_signed < (int64_t)state->start_meter_wh) {
		meter_value_signed = (int64_t)state->start_meter_wh;
	}
	meter_value = (uint32_t)meter_value_signed;

	return meter_value;
}

uint8_t charge_sim_get_soc_percent(const struct charge_sim_state *state, int64_t current_time_ms)
{
	int64_t elapsed_ms;
	double elapsed_hours;
	uint32_t energy_wh;
	uint32_t soc_percent;

	if (state == NULL) {
		return START_SOC_PERCENT;
	}

	if (!state->is_charging || state->start_time_ms == 0) {
		/* Not charging, return starting SOC */
		return state->start_soc_percent;
	}

	/* Calculate elapsed time since start */
	elapsed_ms = current_time_ms - state->start_time_ms;
	elapsed_hours = (double)elapsed_ms / 3600000.0; /* Convert ms to hours */

	/* Calculate energy consumed: Power (W) * Time (h) = Energy (Wh) */
	energy_wh = (uint32_t)(CHARGING_POWER_W * elapsed_hours);

	/* Calculate SOC increase: (energy_wh / battery_capacity_wh) * 100 */
	/* SOC = start_soc + (energy_consumed / battery_capacity * 100) */
	soc_percent =
		state->start_soc_percent + (uint32_t)((energy_wh * 100UL) / BATTERY_CAPACITY_WH);

	/* Cap SOC at 100% */
	if (soc_percent > 100) {
		soc_percent = 100;
	}

	return soc_percent;
}

int32_t charge_sim_get_voltage(bool is_charging)
{
	int32_t voltage_v;

	if (!is_charging) {
		return 0;
	}

	/* Return voltage value with jitter (in V) */
	voltage_v = CHARGING_VOLTAGE_V;
	int32_t jitter = (sys_rand32_get() % (2 * VOLTAGE_JITTER_V + 1)) - VOLTAGE_JITTER_V;
	voltage_v = voltage_v + jitter;

	/* Ensure voltage doesn't go negative */
	if (voltage_v < 0) {
		voltage_v = 0;
	}

	return voltage_v;
}

int32_t charge_sim_get_current(bool is_charging)
{
	int32_t current_a;

	if (!is_charging) {
		return 0;
	}

	/* Return current value with jitter (in A) */
	current_a = CHARGING_CURRENT_A;
	int32_t jitter = (sys_rand32_get() % (2 * CURRENT_JITTER_A + 1)) - CURRENT_JITTER_A;
	current_a = current_a + jitter;

	/* Ensure current doesn't go negative */
	if (current_a < 0) {
		current_a = 0;
	}

	return current_a;
}

int32_t charge_sim_get_power(bool is_charging)
{
	int32_t power_w;

	if (!is_charging) {
		return 0;
	}

	/* Return power value with jitter */
	power_w = CHARGING_POWER_W;
	int32_t jitter = (sys_rand32_get() % (2 * POWER_JITTER_W + 1)) - POWER_JITTER_W;
	power_w = power_w + jitter;

	/* Ensure power doesn't go negative */
	if (power_w < 0) {
		power_w = 0;
	}

	return power_w;
}

void charge_sim_get_all_params(const struct charge_sim_state *state, int conn_idx,
			       int64_t current_time_ms, struct charge_sim_params *params)
{
	if (params == NULL) {
		return;
	}

	params->meter_wh = charge_sim_get_meter_value(state, conn_idx, current_time_ms);
	params->soc_percent = charge_sim_get_soc_percent(state, current_time_ms);
	params->voltage_v = charge_sim_get_voltage(state ? state->is_charging : false);
	params->current_a = charge_sim_get_current(state ? state->is_charging : false);
	params->power_w = charge_sim_get_power(state ? state->is_charging : false);
}

uint32_t charge_sim_get_start_meter(const struct charge_sim_state *state)
{
	if (state == NULL) {
		return 0;
	}

	return state->start_meter_wh;
}
```

## src/charge_sim.h
```c
/*
 * Copyright (c) 2025 Linumiz GmbH
 *
 * SPDX-License-Identifier: Apache-2.0
 */

#ifndef CHARGE_SIM_H
#define CHARGE_SIM_H

#include <stdint.h>
#include <stdbool.h>

/**
 * @brief Charging simulation module
 *
 * This module simulates EV charging with realistic energy consumption,
 * state of charge (SOC) progression, and electrical parameters with jitter.
 */

/* Per-connector charging session state */
struct charge_sim_state {
	int64_t start_time_ms;     /* Start time in milliseconds */
	uint32_t start_meter_wh;   /* Meter reading at start (Wh) */
	uint8_t start_soc_percent; /* State of charge at start (%) */
	bool is_charging;          /* Whether currently charging */
};

/* Charging electrical parameters */
struct charge_sim_params {
	uint32_t meter_wh;   /* Current meter reading (Wh) */
	uint8_t soc_percent; /* Current state of charge (%) */
	int32_t voltage_v;   /* Current voltage (V) */
	int32_t current_a;   /* Current current (A) */
	int32_t power_w;     /* Current power (W) */
};

/**
 * @brief Initialize charging simulation state for a connector
 *
 * @param state Pointer to connector state structure
 * @param conn_idx Connector index (0-based)
 */
void charge_sim_init_state(struct charge_sim_state *state, int conn_idx);

/**
 * @brief Start a charging session
 *
 * @param state Pointer to connector state structure
 * @param conn_idx Connector index (0-based)
 * @param current_time_ms Current time in milliseconds
 */
void charge_sim_start_session(struct charge_sim_state *state, int conn_idx,
			      int64_t current_time_ms);

/**
 * @brief Stop a charging session
 *
 * @param state Pointer to connector state structure
 */
void charge_sim_stop_session(struct charge_sim_state *state);

/**
 * @brief Calculate current meter value for a connector
 *
 * @param state Pointer to connector state structure
 * @param conn_idx Connector index (0-based)
 * @param current_time_ms Current time in milliseconds
 * @return Current meter reading in Wh
 */
uint32_t charge_sim_get_meter_value(const struct charge_sim_state *state, int conn_idx,
				    int64_t current_time_ms);

/**
 * @brief Calculate current state of charge percentage
 *
 * @param state Pointer to connector state structure
 * @param current_time_ms Current time in milliseconds
 * @return Current state of charge (0-100%)
 */
uint8_t charge_sim_get_soc_percent(const struct charge_sim_state *state, int64_t current_time_ms);

/**
 * @brief Calculate current voltage with jitter
 *
 * @param is_charging Whether the connector is currently charging
 * @return Current voltage in V (0 if not charging)
 */
int32_t charge_sim_get_voltage(bool is_charging);

/**
 * @brief Calculate current current with jitter
 *
 * @param is_charging Whether the connector is currently charging
 * @return Current current in A (0 if not charging)
 */
int32_t charge_sim_get_current(bool is_charging);

/**
 * @brief Calculate current power with jitter
 *
 * @param is_charging Whether the connector is currently charging
 * @return Current power in W (0 if not charging)
 */
int32_t charge_sim_get_power(bool is_charging);

/**
 * @brief Get all charging parameters at once
 *
 * @param state Pointer to connector state structure
 * @param conn_idx Connector index (0-based)
 * @param current_time_ms Current time in milliseconds
 * @param params Output structure to fill with current parameters
 */
void charge_sim_get_all_params(const struct charge_sim_state *state, int conn_idx,
			       int64_t current_time_ms, struct charge_sim_params *params);

/**
 * @brief Get the start meter value for a connector session
 *
 * @param state Pointer to connector state structure
 * @return Start meter reading in Wh
 */
uint32_t charge_sim_get_start_meter(const struct charge_sim_state *state);

#endif /* CHARGE_SIM_H */
```

## src/gui.c
```c
/* SPDX-License-Identifier: Apache-2.0 */

#include <zephyr/device.h>
#include <zephyr/devicetree.h>
#include <zephyr/drivers/display.h>
#include <zephyr/kernel.h>
#include <zephyr/logging/log.h>
#include <zephyr/sys/cpu_load.h>
#include <lvgl.h>
#include <string.h>

#include "gui.h"

/* External font declaration */
LV_FONT_DECLARE(lv_font_spacemono_70);

LOG_MODULE_REGISTER(gui, CONFIG_LOG_DEFAULT_LEVEL);

#define NUM_CONNECTORS 2

struct connector_view {
	lv_obj_t *card;
	lv_obj_t *title;
	lv_obj_t *soc_bar;
	lv_obj_t *soc_label;
	lv_obj_t *voltage_label; /* Voltage value and unit */
	lv_obj_t *current_label; /* Current value and unit */
	bool is_charging;
};

struct gui_state {
	bool network_up;
	char ocpp_status[32];
	struct {
		uint32_t meter_wh;
		uint8_t soc_percent;
		int voltage_v;
		int current_a;
		int power_w;
		bool is_charging;
	} connector[NUM_CONNECTORS];
	char notification[64];
	uint32_t cpu_load;
};

static struct gui_state state;
static struct connector_view views[NUM_CONNECTORS];
static lv_obj_t *status_badge_net;
static lv_obj_t *status_badge_ocpp;
static lv_obj_t *cpu_load_label;
static lv_obj_t *notif_toast;
static const struct device *display_dev;
static struct k_mutex state_lock;
static struct k_thread ui_thread;
K_KERNEL_STACK_DEFINE(ui_stack, 12000);

static void with_lock(void (*fn)(void *), void *arg)
{
	k_mutex_lock(&state_lock, K_FOREVER);
	fn(arg);
	k_mutex_unlock(&state_lock);
}

static lv_obj_t *make_badge(const char *text, lv_color_t color)
{
	lv_obj_t *badge = lv_button_create(lv_screen_active());
	lv_obj_set_style_bg_color(badge, color, 0);
	lv_obj_set_style_bg_opa(badge, LV_OPA_COVER, 0);
	lv_obj_set_style_radius(badge, 16, 0);
	lv_obj_set_style_pad_all(badge, 12, 0);
	lv_obj_clear_flag(badge, LV_OBJ_FLAG_CLICKABLE);
	lv_obj_t *label = lv_label_create(badge);
	lv_obj_set_style_text_color(label, lv_color_white(), 0);
	lv_obj_set_style_text_font(label, &lv_font_montserrat_12, 0);
	lv_label_set_text(label, text);
	return badge;
}

static void style_card(lv_obj_t *card)
{
	lv_obj_set_style_bg_opa(card, LV_OPA_COVER, 0);
	lv_obj_set_style_bg_color(card, lv_color_make(45, 50, 58), 0);
	lv_obj_set_style_radius(card, 30, 0);
	// lv_obj_set_style_pad_all(card, 20, 0);
	lv_obj_set_style_shadow_width(card, 20, 0);
	lv_obj_set_style_shadow_color(card, lv_color_make(0, 0, 0), 0);
	lv_obj_set_style_shadow_opa(card, LV_OPA_50, 0);
	lv_obj_set_style_border_width(card, 4, 0);
	lv_obj_set_style_border_color(card, lv_color_make(140, 140, 140), 0);
}

static void build_connector_card(int idx)
{
	struct connector_view *v = &views[idx];
	v->card = lv_obj_create(lv_screen_active());
	style_card(v->card);

	char title[32];
	snprintk(title, sizeof(title), "Connector %d", idx + 1);
	v->title = lv_label_create(v->card);
	lv_obj_set_style_text_color(v->title, lv_color_white(), 0);
	lv_obj_set_style_text_font(v->title, &lv_font_montserrat_18, 0);
	lv_label_set_text(v->title, title);
	lv_obj_set_style_pad_bottom(v->title, 16, 0);

	v->soc_label = lv_label_create(v->card);
	lv_obj_set_style_text_color(v->soc_label, lv_color_white(), 0);
	lv_obj_set_style_text_font(v->soc_label, &lv_font_montserrat_12, 0);
	lv_label_set_text(v->soc_label, "SOC 0%");
	lv_obj_set_style_pad_bottom(v->soc_label, 8, 0);

	v->soc_bar = lv_bar_create(v->card);
	lv_obj_set_size(v->soc_bar, 320, 24);
	lv_bar_set_range(v->soc_bar, 0, 100);
	lv_bar_set_value(v->soc_bar, 0, LV_ANIM_OFF);
	lv_obj_set_style_bg_color(v->soc_bar, lv_color_make(30, 35, 40), 0);
	lv_obj_set_style_bg_opa(v->soc_bar, LV_OPA_COVER, 0);
	lv_obj_set_style_radius(v->soc_bar, 12, 0);
	lv_obj_set_style_pad_all(v->soc_bar, 3, 0);
	lv_obj_set_style_bg_color(v->soc_bar, lv_color_make(60, 180, 100), LV_PART_INDICATOR);
	lv_obj_set_style_bg_opa(v->soc_bar, LV_OPA_COVER, LV_PART_INDICATOR);
	lv_obj_set_style_radius(v->soc_bar, 10, LV_PART_INDICATOR);
	lv_obj_set_style_pad_all(v->soc_bar, 3, LV_PART_INDICATOR);
	lv_obj_set_style_border_width(v->soc_bar, 0, LV_PART_INDICATOR);
	lv_obj_set_style_outline_width(v->soc_bar, 0, LV_PART_INDICATOR);
	lv_obj_set_style_pad_bottom(v->soc_bar, 16, 0);

	/* Voltage display with large monospace font */
	v->voltage_label = lv_label_create(v->card);
	lv_obj_set_style_text_color(v->voltage_label, lv_color_make(200, 200, 200), 0);
	lv_obj_set_style_text_font(v->voltage_label, &lv_font_spacemono_70, 0);
	lv_obj_set_style_pad_top(v->voltage_label, 70, 0);
	lv_obj_set_style_pad_left(v->voltage_label, 50, 0);
	lv_obj_set_style_pad_bottom(v->voltage_label, 20, 0);
	lv_label_set_text(v->voltage_label, "000 V");

	/* Current display with large monospace font */
	v->current_label = lv_label_create(v->card);
	lv_obj_set_style_text_color(v->current_label, lv_color_make(200, 200, 200), 0);
	lv_obj_set_style_text_font(v->current_label, &lv_font_spacemono_70, 0);
	lv_obj_set_style_pad_left(v->current_label, 50, 0);
	lv_label_set_text(v->current_label, "000 A");

	/* Layout inside card */
	lv_obj_set_flex_flow(v->card, LV_FLEX_FLOW_COLUMN);
	lv_obj_set_flex_align(v->card, LV_FLEX_ALIGN_START, LV_FLEX_ALIGN_START,
			      LV_FLEX_ALIGN_CENTER);
	lv_obj_set_size(v->card, 360, 360);
}

static void layout_screen(void)
{
	lv_obj_t *root = lv_screen_active();

	/* Gradient background with better contrast */
	static lv_style_t bg_style;
	lv_style_init(&bg_style);
	lv_style_set_bg_opa(&bg_style, LV_OPA_COVER);
	lv_style_set_bg_grad_dir(&bg_style, LV_GRAD_DIR_VER);
	lv_style_set_bg_color(&bg_style, lv_color_make(15, 18, 22));
	lv_style_set_bg_grad_color(&bg_style, lv_color_make(8, 10, 12));
	lv_obj_add_style(root, &bg_style, 0);

	/* Header title */
	lv_obj_t *title = lv_label_create(root);
	lv_obj_set_style_text_color(title, lv_color_white(), 0);
	lv_obj_set_style_text_font(title, &lv_font_montserrat_18, 0);
	lv_label_set_text(title, "EV Charging Station");
	lv_obj_align(title, LV_ALIGN_TOP_LEFT, 20, 20);

	/* Status badges */
	status_badge_net = make_badge("NET: offline", lv_color_make(200, 50, 50));
	lv_obj_align(status_badge_net, LV_ALIGN_TOP_RIGHT, -20, 20);

	status_badge_ocpp = make_badge("OCPP: init", lv_color_make(200, 120, 50));
	lv_obj_align(status_badge_ocpp, LV_ALIGN_TOP_RIGHT, -150, 20);

	/* CPU Load display */
	cpu_load_label = lv_label_create(root);
	lv_obj_set_style_text_color(cpu_load_label, lv_color_white(), 0);
	lv_obj_set_style_text_font(cpu_load_label, &lv_font_montserrat_12, 0);
	lv_label_set_text(cpu_load_label, "CPU: 0%");
	lv_obj_align(cpu_load_label, LV_ALIGN_BOTTOM_LEFT, 20, -20);

	/* Connector cards side-by-side with better spacing */
	build_connector_card(0);
	build_connector_card(1);
	lv_obj_align(views[0].card, LV_ALIGN_LEFT_MID, 20, 20);
	lv_obj_align(views[1].card, LV_ALIGN_RIGHT_MID, -20, 20);

	/* Notification toast with better visibility */
	notif_toast = lv_label_create(root);
	lv_obj_set_style_text_color(notif_toast, lv_color_make(255, 180, 60), 0);
	lv_obj_set_style_text_font(notif_toast, &lv_font_montserrat_12, 0);
	lv_label_set_text(notif_toast, "");
	lv_obj_align(notif_toast, LV_ALIGN_BOTTOM_MID, 0, -16);
}

static void update_badges_locked(void *unused)
{
	ARG_UNUSED(unused);
	const char *net_txt = state.network_up ? "NET: online" : "NET: offline";
	lv_obj_set_style_bg_color(
		status_badge_net,
		state.network_up ? lv_color_make(50, 200, 120) : lv_color_make(200, 50, 50), 0);
	lv_label_set_text(lv_obj_get_child(status_badge_net, 0), net_txt);

	lv_label_set_text(lv_obj_get_child(status_badge_ocpp, 0), state.ocpp_status);
}

static void update_connectors_locked(void *unused)
{
	ARG_UNUSED(unused);
	for (int i = 0; i < NUM_CONNECTORS; i++) {
		struct connector_view *v = &views[i];
		const uint8_t soc = state.connector[i].soc_percent;
		char buf[32];
		lv_bar_set_value(v->soc_bar, soc, LV_ANIM_ON);
		snprintk(buf, sizeof(buf), "SOC %u%%", soc);
		lv_label_set_text(v->soc_label, buf);

		/* Update voltage display */
		snprintk(buf, sizeof(buf), "%03d V", state.connector[i].voltage_v);
		lv_label_set_text(v->voltage_label, buf);

		/* Update current display */
		snprintk(buf, sizeof(buf), "%03d A", state.connector[i].current_a);
		lv_label_set_text(v->current_label, buf);

		/* Enhanced visual cue if charging with better contrast */
		lv_obj_set_style_bg_color(v->card,
					  state.connector[i].is_charging
						  ? lv_color_make(50, 80, 60)
						  : lv_color_make(45, 50, 58),
					  0);
		lv_obj_set_style_border_color(v->card,
					      state.connector[i].is_charging
						      ? lv_color_make(60, 180, 100)
						      : lv_color_make(70, 75, 85),
					      0);
	}
}

static void update_notification_locked(void *unused)
{
	ARG_UNUSED(unused);
	lv_label_set_text(notif_toast, state.notification);
}

static void update_cpu_load_locked(void *unused)
{
	ARG_UNUSED(unused);
	char buf[32];

	snprintk(buf, sizeof(buf), "CPU: %u%%", state.cpu_load);
	lv_label_set_text(cpu_load_label, buf);
}

static void ui_thread_entry(void *a, void *b, void *c)
{
	ARG_UNUSED(a);
	ARG_UNUSED(b);
	ARG_UNUSED(c);

	display_dev = DEVICE_DT_GET(DT_CHOSEN(zephyr_display));
	if (!device_is_ready(display_dev)) {
		LOG_ERR("Display device not ready");
		return;
	}

	layout_screen();
	/* Perform a couple of refresh ticks before unblank to avoid top-line artifacts */
	for (int i = 0; i < 3; i++) {
		lv_timer_handler();
		k_msleep(10);
	}
	display_blanking_off(display_dev);

	/* First refresh must happen immediately, before any network/OCPP work */
	with_lock(update_badges_locked, NULL);
	with_lock(update_connectors_locked, NULL);
	with_lock(update_notification_locked, NULL);
	with_lock(update_cpu_load_locked, NULL);

	/* Track last rendered state to avoid redundant LVGL updates */
	struct gui_state prev_state;
	memset(&prev_state, 0, sizeof(prev_state));
	uint32_t last_cpu_update_ms = 0U;

	while (1) {
		bool cpu_updated = false;
		uint32_t now = k_uptime_get_32();

		/* Sample CPU load less frequently (1s) */
		if ((now - last_cpu_update_ms) >= 1000U) {
			k_mutex_lock(&state_lock, K_FOREVER);
			state.cpu_load = cpu_load_metric_get(0);
			k_mutex_unlock(&state_lock);
			last_cpu_update_ms = now;
			cpu_updated = true;
		}

		/* Snapshot current state for change detection */
		struct gui_state snapshot;
		k_mutex_lock(&state_lock, K_FOREVER);
		snapshot = state;
		k_mutex_unlock(&state_lock);

		/* Periodic GUI maintenance */
		lv_timer_handler();

		/* Only push LVGL updates when state actually changed or on CPU update tick */
		if (cpu_updated || memcmp(&snapshot, &prev_state, sizeof(snapshot)) != 0) {
			with_lock(update_badges_locked, NULL);
			with_lock(update_connectors_locked, NULL);
			with_lock(update_notification_locked, NULL);
			with_lock(update_cpu_load_locked, NULL);
			prev_state = snapshot;
		}

		/* Back off refresh rate to reduce CPU usage */
		k_sleep(K_MSEC(200));
	}
}

int gui_init(void)
{
	k_mutex_init(&state_lock);
	/* Defaults */
	k_mutex_lock(&state_lock, K_FOREVER);
	state.network_up = false;
	snprintk(state.ocpp_status, sizeof(state.ocpp_status), "OCPP: init");
	for (int i = 0; i < NUM_CONNECTORS; i++) {
		state.connector[i].meter_wh = 0;
		state.connector[i].soc_percent = 0;
		state.connector[i].voltage_v = 0;
		state.connector[i].current_a = 0;
		state.connector[i].power_w = 0;
		state.connector[i].is_charging = false;
	}
	state.notification[0] = '\0';
	state.cpu_load = 0;
	k_mutex_unlock(&state_lock);

	/* Launch UI thread immediately */
	k_thread_create(&ui_thread, ui_stack, K_KERNEL_STACK_SIZEOF(ui_stack), ui_thread_entry,
			NULL, NULL, NULL, K_PRIO_PREEMPT(7), 0, K_NO_WAIT);
	k_thread_name_set(&ui_thread, "ui");
	return 0;
}

void gui_set_network_status(bool is_up)
{
	k_mutex_lock(&state_lock, K_FOREVER);
	state.network_up = is_up;
	k_mutex_unlock(&state_lock);
}

void gui_set_ocpp_status(const char *status_text)
{
	k_mutex_lock(&state_lock, K_FOREVER);
	snprintk(state.ocpp_status, sizeof(state.ocpp_status), "%s",
		 status_text ? status_text : "");
	k_mutex_unlock(&state_lock);
}

void gui_update_connector(int id, uint32_t meter_wh, uint8_t soc_percent, int voltage_v,
			  int current_a, int power_w, bool is_charging)
{
	if (id < 1 || id > NUM_CONNECTORS) {
		return;
	}
	const int idx = id - 1;
	k_mutex_lock(&state_lock, K_FOREVER);
	state.connector[idx].meter_wh = meter_wh;
	state.connector[idx].soc_percent = soc_percent;
	state.connector[idx].voltage_v = voltage_v;
	state.connector[idx].current_a = current_a;
	state.connector[idx].power_w = power_w;
	state.connector[idx].is_charging = is_charging;
	k_mutex_unlock(&state_lock);
}

void gui_show_notification(const char *text)
{
	k_mutex_lock(&state_lock, K_FOREVER);
	snprintk(state.notification, sizeof(state.notification), "%s", text ? text : "");
	k_mutex_unlock(&state_lock);
}
```

## src/gui.h
```c
/* SPDX-License-Identifier: Apache-2.0 */

#pragma once

#include <stdbool.h>
#include <stdint.h>

/* Initialize GUI immediately at boot; returns 0 on success. */
int gui_init(void);

/* Status setters (thread-safe). These do not touch LVGL directly from caller threads. */
void gui_set_network_status(bool is_up);
void gui_set_ocpp_status(const char *status_text);

/* Update connector telemetry (thread-safe). id is 1-based connector index. */
void gui_update_connector(int id, uint32_t meter_wh, uint8_t soc_percent, int voltage_v,
			  int current_a, int power_w, bool is_charging);

/* Optional transient notification at the bottom of the screen. */
void gui_show_notification(const char *text);
```

## src/ocpp_gui.c
```c
/*
 * Copyright (c) 2025 Linumiz GmbH
 *
 * SPDX-License-Identifier: Apache-2.0
 */

#include <zephyr/kernel.h>
#include <zephyr/device.h>
#include <zephyr/devicetree.h>
#include <zephyr/drivers/display.h>
#include <lvgl.h>
#include <stdio.h>
#include <string.h>
#include "ocpp_gui.h"

LOG_MODULE_REGISTER(ocpp_gui, LOG_LEVEL_INF);

/* GUI Elements */
static lv_obj_t *main_screen;
static lv_obj_t *status_label;
static lv_obj_t *connector1_panel;
static lv_obj_t *connector2_panel;
static lv_obj_t *connector1_status;
static lv_obj_t *connector1_energy;
static lv_obj_t *connector1_power;
static lv_obj_t *connector2_status;
static lv_obj_t *connector2_energy;
static lv_obj_t *connector2_power;
static lv_obj_t *cs_status_label;

/* Color definitions for modern look */
#define COLOR_PRIMARY     0x2196F3  /* Blue */
#define COLOR_SUCCESS     0x4CAF50  /* Green */
#define COLOR_WARNING     0xFF9800  /* Orange */
#define COLOR_DANGER      0xF44336  /* Red */
#define COLOR_BACKGROUND  0x212121  /* Dark Gray */
#define COLOR_SURFACE     0x424242  /* Medium Gray */
#define COLOR_TEXT        0xFFFFFF  /* White */

static lv_obj_t *create_connector_panel(lv_obj_t *parent, const char *title, int y_offset)
{
	lv_obj_t *panel = lv_obj_create(parent);
	lv_obj_set_size(panel, 280, 140);
	lv_obj_align(panel, LV_ALIGN_TOP_MID, 0, y_offset);
	lv_obj_set_style_bg_color(panel, lv_color_hex(COLOR_SURFACE), 0);
	lv_obj_set_style_border_width(panel, 2, 0);
	lv_obj_set_style_border_color(panel, lv_color_hex(COLOR_PRIMARY), 0);
	lv_obj_set_style_radius(panel, 10, 0);
	lv_obj_set_style_pad_all(panel, 12, 0);

	/* Title */
	lv_obj_t *title_label = lv_label_create(panel);
	lv_label_set_text(title_label, title);
	lv_obj_set_style_text_font(title_label, &lv_font_montserrat_20, 0);
	lv_obj_set_style_text_color(title_label, lv_color_hex(COLOR_PRIMARY), 0);
	lv_obj_align(title_label, LV_ALIGN_TOP_LEFT, 0, 0);

	return panel;
}

static lv_obj_t *create_info_label(lv_obj_t *parent, const char *text, int y_offset)
{
	lv_obj_t *label = lv_label_create(parent);
	lv_label_set_text(label, text);
	lv_obj_set_style_text_font(label, &lv_font_montserrat_14, 0);
	lv_obj_set_style_text_color(label, lv_color_hex(COLOR_TEXT), 0);
	lv_obj_align(label, LV_ALIGN_TOP_LEFT, 0, y_offset);
	return label;
}

void ocpp_gui_init(void)
{
	const struct device *display_dev;

	display_dev = DEVICE_DT_GET(DT_CHOSEN(zephyr_display));
	if (!device_is_ready(display_dev)) {
		LOG_ERR("Display device not ready");
		return;
	}

	/* Create main screen with dark theme */
	main_screen = lv_screen_active();
	lv_obj_set_style_bg_color(main_screen, lv_color_hex(COLOR_BACKGROUND), 0);

	/* Header */
	lv_obj_t *header = lv_label_create(main_screen);
	lv_label_set_text(header, "OCPP Charging Station");
	lv_obj_set_style_text_font(header, &lv_font_montserrat_24, 0);
	lv_obj_set_style_text_color(header, lv_color_hex(COLOR_PRIMARY), 0);
	lv_obj_align(header, LV_ALIGN_TOP_MID, 0, 10);

	/* Central System Status */
	cs_status_label = lv_label_create(main_screen);
	lv_label_set_text(cs_status_label, "CS: Disconnected");
	lv_obj_set_style_text_font(cs_status_label, &lv_font_montserrat_14, 0);
	lv_obj_set_style_text_color(cs_status_label, lv_color_hex(COLOR_DANGER), 0);
	lv_obj_align(cs_status_label, LV_ALIGN_TOP_MID, 0, 40);

	/* Connector 1 Panel */
	connector1_panel = create_connector_panel(main_screen, "Connector 1", 70);
	connector1_status = create_info_label(connector1_panel, "Status: Available", 30);
	connector1_energy = create_info_label(connector1_panel, "Energy: 0 Wh", 55);
	connector1_power = create_info_label(connector1_panel, "Power: 0 W", 80);

	/* Connector 2 Panel */
	connector2_panel = create_connector_panel(main_screen, "Connector 2", 220);
	connector2_status = create_info_label(connector2_panel, "Status: Available", 30);
	connector2_energy = create_info_label(connector2_panel, "Energy: 0 Wh", 55);
	connector2_power = create_info_label(connector2_panel, "Power: 0 W", 80);

	/* Status bar at bottom */
	status_label = lv_label_create(main_screen);
	lv_label_set_text(status_label, "Ready");
	lv_obj_set_style_text_font(status_label, &lv_font_montserrat_14, 0);
	lv_obj_set_style_text_color(status_label, lv_color_hex(0x9E9E9E), 0);
	lv_obj_align(status_label, LV_ALIGN_BOTTOM_MID, 0, -5);

	lv_timer_handler();
	display_blanking_off(display_dev);

	LOG_INF("OCPP GUI initialized");
}

void ocpp_gui_update_cs_status(bool connected)
{
	if (cs_status_label) {
		if (connected) {
			lv_label_set_text(cs_status_label, "CS: Connected");
			lv_obj_set_style_text_color(cs_status_label, lv_color_hex(COLOR_SUCCESS), 0);
		} else {
			lv_label_set_text(cs_status_label, "CS: Disconnected");
			lv_obj_set_style_text_color(cs_status_label, lv_color_hex(COLOR_DANGER), 0);
		}
	}
}

void ocpp_gui_update_connector_status(int connector_id, const char *status)
{
	lv_obj_t *status_obj = (connector_id == 1) ? connector1_status : connector2_status;
	lv_obj_t *panel = (connector_id == 1) ? connector1_panel : connector2_panel;
	
	if (status_obj && panel) {
		char buf[64];
		snprintf(buf, sizeof(buf), "Status: %s", status);
		lv_label_set_text(status_obj, buf);

		/* Update panel border color based on status */
		lv_color_t border_color;
		if (strcmp(status, "Charging") == 0) {
			border_color = lv_color_hex(COLOR_SUCCESS);
		} else if (strcmp(status, "Preparing") == 0 || strcmp(status, "Finishing") == 0) {
			border_color = lv_color_hex(COLOR_WARNING);
		} else {
			border_color = lv_color_hex(COLOR_PRIMARY);
		}
		lv_obj_set_style_border_color(panel, border_color, 0);
	}
}

void ocpp_gui_update_connector_energy(int connector_id, int energy_wh)
{
	lv_obj_t *energy_obj = (connector_id == 1) ? connector1_energy : connector2_energy;
	
	if (energy_obj) {
		char buf[64];
		snprintf(buf, sizeof(buf), "Energy: %d Wh", energy_wh);
		lv_label_set_text(energy_obj, buf);
	}
}

void ocpp_gui_update_connector_power(int connector_id, int power_w)
{
	lv_obj_t *power_obj = (connector_id == 1) ? connector1_power : connector2_power;
	
	if (power_obj) {
		char buf[64];
		snprintf(buf, sizeof(buf), "Power: %d W", power_w);
		lv_label_set_text(power_obj, buf);
	}
}

void ocpp_gui_update_status(const char *status_text)
{
	if (status_label) {
		lv_label_set_text(status_label, status_text);
	}
}

void ocpp_gui_task(void)
{
	lv_timer_handler();
}
```
