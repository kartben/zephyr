## CMakeLists.txt
```
# SPDX-License-Identifier: Apache-2.0

cmake_minimum_required(VERSION 3.20.0)

find_package(Zephyr REQUIRED HINTS $ENV{ZEPHYR_BASE})
project(hello_world)

target_sources(app PRIVATE src/main.c)


   include(git)

   git_describe(${CMAKE_CURRENT_SOURCE_DIR} GIT_DESCRIPTION)
   if(DEFINED GIT_DESCRIPTION)
     message(STATUS "Git description: ${GIT_DESCRIPTION}")
   endif()
```

## sample.yaml
```
sample:
  description: Hello World sample, the simplest Zephyr
    application
  name: hello world
common:
  min_ram: 2
  min_flash: 16
  tags: introduction
  integration_platforms:
    - native_sim
  harness: build
  harness_config:
#    expect_failure: true
    type: multi_line
    ordered: true
    regex:
      - "Linking C static library zephyr/kernel/libkernel.a"
      - "Converted to uf2, output size: \\d+, start address: 0x4000"
tests:
  sample.basic.helloworld:
    tags: introduction
```

## prj.conf
```kconfig
CONFIG_CPP=y
# CONFIG_COMMON_LIBC_MALLOC_ARENA_SIZE=-1
CONFIG_REQUIRES_FULL_LIBCPP=y
CONFIG_MAIN_STACK_SIZE=20000
```

## src/main.c
```c
/*
 * Copyright (c) 2012-2014 Wind River Systems, Inc.
 *
 * SPDX-License-Identifier: Apache-2.0
 * xxx
 */

#include <stdio.h>

int main(void)
{
	printf("Hello World! %s\n", CONFIG_BOARD_TARGET);

	return 0;
}
```

## src/main.cpp
```c
#include <zephyr/kernel.h>
#include "edge-impulse-sdk/classifier/ei_run_classifier.h"
#include "edge-impulse-sdk/dsp/numpy.hpp"

#include <cfloat>

static const float features[] = {
	605, 61, 143, 63, 604, 62, 141, 62, 606, 62, 140, 62, 605, 62, 140, 62, 605, 62, 139, 62,
	606, 62, 137, 63, 605, 61, 137, 63, 606, 62, 136, 61, 606, 62, 134, 62, 606, 62, 133, 61,
	606, 61, 133, 62, 607, 62, 131, 62, 608, 62, 129, 61, 607, 62, 129, 61, 607, 61, 127, 61,
	607, 62, 127, 61, 608, 62, 125, 62, 608, 62, 124, 62, 610, 61, 123, 62, 608, 61, 122, 0};

int raw_feature_get_data(size_t offset, size_t length, float *out_ptr)
{
	memcpy(out_ptr, features + offset, length * sizeof(float));
	return 0;
}

int main()
{
	// This is needed so that output of printf is output immediately without buffering
	setvbuf(stdout, NULL, _IONBF, 0);

	printk("Edge Impulse standalone inferencing (Zephyr)\n");

	if (sizeof(features) / sizeof(float) != EI_CLASSIFIER_DSP_INPUT_FRAME_SIZE) {
		printk("The size of your 'features' array is not correct. Expected %d items, but "
		       "had %u\n",
		       EI_CLASSIFIER_DSP_INPUT_FRAME_SIZE, sizeof(features) / sizeof(float));
		return 1;
	}

	ei_impulse_result_t result = {0};

	while (1) {
		// the features are stored into flash, and we don't want to load everything into RAM
		signal_t features_signal;
		features_signal.total_length = sizeof(features) / sizeof(features[0]);
		features_signal.get_data = &raw_feature_get_data;

		// invoke the impulse
		EI_IMPULSE_ERROR res = run_classifier(&features_signal, &result, true);
		printk("run_classifier returned: %d\n", res);

		if (res != 0) {
			return 1;
		}

		printk("Predictions (DSP: %d ms., Classification: %d ms., Anomaly: %d ms.): \n",
		       result.timing.dsp, result.timing.classification, result.timing.anomaly);
#if EI_CLASSIFIER_OBJECT_DETECTION == 1
		bool bb_found = result.bounding_boxes[0].value > 0;
		for (size_t ix = 0; ix < result.bounding_boxes_count; ix++) {
			auto bb = result.bounding_boxes[ix];
			if (bb.value == 0) {
				continue;
			}
			printk("    %s (%f) [ x: %u, y: %u, width: %u, height: %u ]\n", bb.label,
			       bb.value, bb.x, bb.y, bb.width, bb.height);
		}
		if (!bb_found) {
			printk("    No objects found\n");
		}
#else
		for (size_t ix = 0; ix < EI_CLASSIFIER_LABEL_COUNT; ix++) {
			printk("    %s: %.5f\n", result.classification[ix].label,
			       result.classification[ix].value);
		}
#if EI_CLASSIFIER_HAS_ANOMALY == 1
		printk("    anomaly score: %.3f\n", result.anomaly);
#endif
#endif
		k_msleep(2000);
	}
}
```

## src/interp.h
```c
/* This Source Code Form is subject to the terms of the Mozilla Public
 * License, v. 2.0. If a copy of the MPL was not distributed with this
 * file, You can obtain one at http://mozilla.org/MPL/2.0/. */

// Copyright 2018 John Maloney, Bernat Romagosa, and Jens Mönig

// interp.h - Simple interpreter based on 32-bit opcodes
// John Maloney, April 2017

#ifdef __cplusplus
extern "C" {
#endif

// Instruction Format

#define OP(opcode, arg) (((unsigned) arg << 8) | (opcode & 0xFF))
#define CMD(n) (n & 0x7F) // use only low 7 bits for now
#define ARG(n) (n >> 8)

// Global Variables

#define MAX_VARS 100
extern OBJ vars[MAX_VARS];

// Code Chunks

// The code chunk table is an array of CodeChunkRecords. A code chunk is referenced by its
// index in this table. This "chunk index" is used for several purposes:
//
//	1. to specify the called function in function calls
//	2. to specify the code to run when starting a task
//	3. to communicate with the client IDE about code chunks and tasks
//
// Referencing code chunks via their index in the code chunk table allows the actual code
// chunk objects, which may be located in either Flash or RAM memory, to be updated by user
// or edits. When code chunks are stored in Flash (which is write-once until it is erased),
// newer versions of a chunk are appended to the end of Flash. At startup time, Flash memory
// is scanned, and the chunks[] table is reconstructed with references to the latest version
// of each chunk.

typedef enum {
	unusedChunk = 0,
	command = 1,
	reporter = 2,
	functionHat = 3,
	startHat = 4,
	whenConditionHat = 5,
	broadcastHat = 6,
	buttonAHat = 7,
	buttonBHat = 8,
	buttonsAandBHat = 9,
} ChunkType_t;

typedef struct {
	OBJ code;
	uint8 chunkType;
} CodeChunkRecord;

#define MAX_CHUNKS 255
extern CodeChunkRecord chunks[MAX_CHUNKS];

// Task List

// The task list is an array of taskCount Tasks. Each Task has a chunkIndex for
// the top-level block of the task, as well as for the current function chunk when
// inside a call to user-defined function. It also holds the task status, processor
// state (instruction pointer (ip), stack pointer (sp), and frame pointer (fp)),
// and the wakeTime (used when a task is waiting on the microsecond clock).
// In the current design, Tasks have a fixed-size stack built in. In the future,
// this will become a reference to a growable stack object in memory.
//
// "When <condition>" hats have their condition test compiled into them. They
// loop back and suspend themselves when the condition is false. When the condition
// becomes true, execution proceeds to the blocks under the hat.

typedef enum {
	unusedTask = 0, // task entry is available
	waiting_micros = 1, // waiting for microseconds to reach wakeTime
	running = 2,
} MicroBlocksTaskStatus_t;

#define STACK_LIMIT 54 // Task size is 6 + STACK_LIMIT words

typedef struct {
	uint8 status; // MicroBlocksTaskStatus_t, stored as a byte
	uint8 taskChunkIndex; // chunk index of the top-level stack for this task
	uint8 currentChunkIndex; // chunk index when inside a function
	uint32 wakeTime;
	OBJ code;
	int ip;
	int sp;
	int fp;
	OBJ stack[STACK_LIMIT];
} Task;

// Task list shared by interp.c and runtime.c

#define MAX_TASKS 10
extern Task tasks[MAX_TASKS];
extern int taskCount;

// Extra delay used to limit serial transmission speed

extern int extraByteDelay;

// Serial Protocol Messages: IDE -> Board

#define chunkCodeMsg			1	// bidirectional
#define deleteChunkMsg			2
#define startChunkMsg			3
#define stopChunkMsg			4
#define startAllMsg				5
#define stopAllMsg				6
#define getVarMsg				7	// value returned to IDE via varValueMsg
#define setVarMsg				8
#define getVarNamesMsg			9
#define clearVarsMsg			10
#define getChunkCRCMsg			11
#define getVersionMsg			12
#define getAllCodeMsg			13
#define deleteAllCodeMsg		14
#define systemResetMsg			15

// Serial Protocol Messages: Board -> IDE

#define taskStartedMsg			16
#define taskDoneMsg				17
#define taskReturnedValueMsg	18
#define taskErrorMsg			19
#define outputValueMsg			20
#define varValueMsg				21
#define versionMsg				22
#define chunkCRCMsg				23

// Serial Protocol Messages: Bidirectional

#define pingMsg					26
#define broadcastMsg			27
#define chunkAttributeMsg		28
#define varNameMsg				29
#define extendedMsg				30

// Serial Protocol Messages: CRC Exchange

#define getAllCRCsMsg			38
#define allCRCsMsg				39
#define LAST_MSG				39

// Error Codes (codes 1-9 are reserved for protocol errors; 10 and up are runtime errors)

#define noError					0	// No error
#define unspecifiedError		1	// Unknown error
#define badChunkIndexError		2	// Unknown chunk index

#define insufficientMemoryError	10	// Insufficient memory to allocate object
#define needsListError			11	// Needs a list
#define needsBooleanError		12	// Needs a boolean
#define needsIntegerError		13	// Needs an integer
#define needsStringError		14	// Needs a string
#define nonComparableError		15	// Those objects cannot be compared for equality
#define arraySizeError			16	// List size must be a non-negative integer
#define needsIntegerIndexError	17	// List or string index must be an integer
#define indexOutOfRangeError	18	// List or string index out of range
#define byteArrayStoreError		19	// A ByteArray can only store integer values between 0 and 255
#define hexRangeError			20	// Hexadecimal input must between between -1FFFFFFF and 1FFFFFFF
#define i2cDeviceIDOutOfRange	21	// I2C device ID must be between 0 and 127
#define i2cRegisterIDOutOfRange	22	// I2C register must be between 0 and 255
#define i2cValueOutOfRange		23	// I2C value must be between 0 and 255
#define notInFunction			24	// Attempt to access an argument outside of a function
#define badForLoopArg			25	// for-loop argument must be a positive integer or list
#define stackOverflow			26	// Insufficient stack space
#define primitiveNotImplemented	27	// Primitive not implemented in this virtual machine
#define notEnoughArguments		28	// Not enough arguments passed to primitive
#define waitTooLong				29	// The maximum wait time is 3600000 milliseconds (one hour)
#define noWiFi					30	// This board does not support WiFi
#define zeroDivide				31	// Division (or modulo) by zero is not defined
#define argIndexOutOfRange		32	// Argument index out of range
#define needsIndexable			33	// Needs an indexable type such as a string or list
#define joinArgsNotSameType		34	// All arguments to join must be the same type (e.g. lists)
#define i2cTransferFailed		35	// I2C transfer failed
#define needsByteArray			36	// Needs a byte array
#define serialPortNotOpen		37	// Serial port not open
#define serialWriteTooBig		38	// Serial port write is limited to 128 bytes
#define needsListOfIntegers		39	// Needs a list of integers
#define byteOutOfRange			40	// Needs a value between 0 and 255
#define needsPositiveIncrement	41	// Range increment must be a positive integer
#define needsIntOrListOfInts	42	// Needs an integer or a list of integers
#define wifiNotConnected		43	// Not connected to a WiFi network
#define cannotConvertToInteger	44	// Cannot convert that to an integer
#define cannotConvertToBoolean	45	// Cannot convert that to a boolean
#define cannotConvertToList		46	// Cannot convert that to a list
#define cannotConvertToByteArray 47	// Cannot convert that to a byte array
#define unknownDatatype			48	// Unknown datatype
#define invalidUnicodeValue		49	// Unicode values must be between 0 and 1114111 (0x10FFFF)
#define sleepSignal				255	// Not a real error; used to make current task sleep

// Runtime Operations

OBJ fail(uint8 errCode);
int failure();
void initTasks(void);
void startAll();
void stopAllTasksButThis(Task *task);
void startReceiversOfBroadcast(char *msg, int byteCount);
void processMessage(void);
int hasOutputSpace(int byteCount);
void logData(char *s);
void outputString(const char *s);
void sendTaskDone(uint8 chunkIndex);
void sendTaskError(uint8 chunkIndex, uint8 errorCode, int where);
void sendTaskReturnValue(uint8 chunkIndex, OBJ returnValue);
void sendBroadcastToIDE(char *s, int len);
int broadcastMatches(uint8 chunkIndex, char *msg, int byteCount);
void sendSayForChunk(char *s, int len, uint8 chunkIndex);
void vmLoop(void);
void interpretStep();
void taskSleep(int msecs);
void vmPanic(const char *s);
int indexOfVarNamed(const char *varName);
void processFileMessage(int msgType, int dataSize, char *data);
void waitAndSendMessage(int msgType, int chunkIndex, int dataSize, char *data);
void suspendCodeFileUpdates();
void resumeCodeFileUpdates();

// Integer Evaluation

static inline int evalInt(OBJ obj) {
	if (isInt(obj)) {
		return obj2int(obj);
	} else if (IS_TYPE(obj, StringType)) {
		// try to parse an int out of a string
		return strtol(obj2str(obj), NULL, 10); // returns 0 if string is not a number
	} else if (IS_TYPE(obj, ByteArrayType)) {
		// try to parse an int out of a byte array (treating it as a string)
		return strtol((char *) &FIELD(obj, 0), NULL, 10); // returns 0 if string is not a number
	} else {
		fail(needsIntegerError);
		return 0;
	}
}

// Testing Support

void startTaskForChunk(uint8 chunkIndex);
void runTasksUntilDone(void);

void interpTests1(void);
void taskTest(void);

void compactCodeStore();
void outputRecordHeaders();

// Platform Specific Operations

uint32 microsecs(void);
uint32 millisecs(void);

int serialConnected();
int recvBytes(uint8 *buf, int count);
int sendByte(char aByte);
void restartSerial();

const char *boardType();
void hardwareInit(void);

int readI2CReg(int deviceID, int reg);
void writeI2CReg(int deviceID, int reg, int value);

// I/O Support

extern int mbDisplayColor;

int pinCount();
int mapDigitalPinNum(int userPinNum);
void setPinMode(int pin, int newMode);
void turnOffPins();
int hasI2CPullups();
void updateMicrobitDisplay();
void checkButtons();
void resetRadio();
void stopPWM();
void stopServos();
void stopTone();
int readAnalogMicrophone();
void setPicoEdSpeakerPin(int pin);
void showMicroBitPixels(int microBitDisplayBits, int xPos, int yPos);
void setAllNeoPixels(int pin, int ledCount, int color);

// Primitives

OBJ primNewList(int argCount, OBJ *args);
OBJ primFillList(int argCount, OBJ *args);
OBJ primAt(int argCount, OBJ *args);
OBJ primAtPut(int argCount, OBJ *args);
OBJ primLength(int argCount, OBJ *args);

OBJ primHexToInt(int argCount, OBJ *args);

OBJ primBroadcastToIDEOnly(int argCount, OBJ *args);

OBJ primAnalogPins(OBJ *args);
OBJ primDigitalPins(OBJ *args);
OBJ primAnalogRead(int argCount, OBJ *args);
void primAnalogWrite(OBJ *args);
OBJ primDigitalRead(int argCount, OBJ *args);
void primDigitalWrite(OBJ *args);
void primDigitalSet(int pinNum, int flag);
OBJ primButtonA(OBJ *args);
OBJ primButtonB(OBJ *args);
void primSetUserLED(OBJ *args);

OBJ primI2cGet(OBJ *args);
OBJ primI2cSet(OBJ *args);
OBJ primSPISend(OBJ *args);
OBJ primSPIRecv(OBJ *args);

OBJ primMBDisplay(int argCount, OBJ *args);
OBJ primMBDisplayOff(int argCount, OBJ *args);
OBJ primMBEnableDisplay(int argCount, OBJ *args);
OBJ primMBPlot(int argCount, OBJ *args);
OBJ primMBUnplot(int argCount, OBJ *args);

OBJ primMBDrawShape(int argCount, OBJ *args);
OBJ primMBShapeForLetter(int argCount, OBJ *args);

OBJ primMBTiltX(int argCount, OBJ *args);
OBJ primMBTiltY(int argCount, OBJ *args);
OBJ primMBTiltZ(int argCount, OBJ *args);
OBJ primMBTemp(int argCount, OBJ *args);

OBJ primNeoPixelSend(int argCount, OBJ *args);
OBJ primNeoPixelSetPin(int argCount, OBJ *args);
void turnOffInternalNeoPixels();

// TFT Support

extern int useTFT;

void tftInit();
void tftClear();
void tftSetHugePixel(int x, int y, int state);
void tftSetHugePixelBits(int bits);

// Primitive Sets

void addDataPrims();
void addDisplayPrims();
void addFilePrims();
void addIOPrims();
void addMiscPrims();
void addNetPrims();
void addRadioPrims();
void addSensorPrims();
void addSerialPrims();
void addTFTPrims();
void addVarPrims();
void addHIDPrims();
void addOneWirePrims();
void addCameraPrims();

// Named Primitive Support

typedef OBJ (*PrimitiveFunction)(int argCount, OBJ *args);

typedef const struct {
	const char *primName;
	PrimitiveFunction primFunc;
} PrimEntry;

void addPrimitiveSet(const char *setName, int entryCount, PrimEntry *entries);
OBJ callPrimitive(int argCount, OBJ *args);
void primsInit();

#ifdef __cplusplus
}
#endif
```

## src/mem.h
```c
/* This Source Code Form is subject to the terms of the Mozilla Public
 * License, v. 2.0. If a copy of the MPL was not distributed with this
 * file, You can obtain one at http://mozilla.org/MPL/2.0/. */

// Copyright 2018 John Maloney, Bernat Romagosa, and Jens Mönig

// mem.h - Object memory definitions using 32-bit object references
// John Maloney, April 2017

#ifndef _MEM_H_
#define _MEM_H_

#ifdef __cplusplus
extern "C" {
#endif

// Unsigned integer types

typedef unsigned char uint8;
typedef unsigned int uint32;

// Boolean constants for readability (if not already defined)

#if !defined(true) || !defined(false)
	#define true 1
	#define false 0
#endif

// Object reference type (32-bits)

typedef int * OBJ;

// Type IDs

#define FREE_CHUNK 0
#define BooleanType 1
#define IntegerType 2
#define ByteArrayType 3
#define StringType 4
// types 5-7 reserved for future non-pointer objects
#define BinaryObjectTypes 7 // objects with type ID's <= 7 do not contain pointers
#define ArrayType 8
#define ListType 9

// Booleans
// Note: These are constants, not pointers to objects in memory.

#define falseObj ((OBJ) 0)
#define trueObj ((OBJ) 4)

#define isBoolean(obj) ((obj) <= trueObj)

// Integers

// Integers are encoded in object references; they have no memory object.
// They have a 1 in their lowest bit and a signed value in their top 31 bits.

#define isInt(obj) (((int) (obj)) & 1)
#define int2obj(n) ((OBJ) (((n) << 1) | 1))
#define obj2int(obj) ((int)(obj) >> 1)
#define zeroObj ((OBJ) 1)

// Memory Objects
//
// Even-valued object references (except true and false) point to an object in memory.
// Memory objects start with one or more header words.

#define HEADER_WORDS 1
#define HEADER(typeID, wordCount) (((wordCount) << 4) | ((typeID) & 0xF))
#define WORDS(obj) ((*((uint32*) (obj)) >> 4) & 0xFFFF)
#define TYPE(obj) (*((uint32*) (obj)) & 0xF)

static inline int objWords(OBJ obj) {
	if (isInt(obj) || isBoolean(obj)) return 0;
	return WORDS(obj);
}

// ByteArray Objects
//
// ByteArray objects use two bits in the object header to adjust their size in bytes so that
// they are not limited to multiples of four bytes. To get the size in bytes, this field
// is subtracted from 4 * WORDS(obj).

#define BYTECOUNT_ADJUST(obj) ((*((uint32*) (obj)) >> 29) & 0x3)
#define BYTES(obj) (4 * WORDS(obj) - BYTECOUNT_ADJUST(obj))

static inline void setByteCountAdjust(OBJ obj, int byteCount) {
	if (isInt(obj) || isBoolean(obj) || (ByteArrayType != TYPE(obj))) return;
	int delta = 4 - (byteCount & 3); // # of bytes to subtract from 4 * WORDS(obj)
	*obj = ((delta & 3) << 29) | ((*obj) & 0x9FFFFFFF);
}

// Types

static inline int objType(OBJ obj) {
	if (isInt(obj)) return IntegerType;
	if (isBoolean(obj)) return BooleanType;
	return TYPE(obj);
}

// Type check for non-integer/boolean objects
// (Note: Use isInt() and isBoolean() to test for integers and booleans)

#define IS_TYPE(obj, typeID) (((((int) obj) & 1) == 0) && ((obj) > trueObj) && (TYPE(obj) == typeID))

// FIELD() macro can be used either to get or set an object field (zero-based)

#define FIELD(obj, i) (((OBJ *) obj)[HEADER_WORDS + (i)])

// Global temporary GC root for use by primitives that do multiple allocations.

extern OBJ tempGCRoot;

// Object Memory Operations

void memInit();
void memClear();
int wordsFree();
void gc();

OBJ newObj(int typeID, int wordCount, OBJ fill);
OBJ resizeObj(OBJ obj, int wordCount);
OBJ newString(int byteCount);
OBJ newStringFromBytes(const char *bytes, int byteCount);
char* obj2str(OBJ obj);

// Debugging Support

void reportNum(const char *msg, int n);
void reportHex(const char *msg, int n);
void reportObj(const char *msg, OBJ obj);
void dumpObjectStore(void);
void memDumpObj(OBJ obj);

#ifdef __cplusplus
}
#endif

#endif // _MEM_H_
```

## src/sensorPrims.c
```c
/* This Source Code Form is subject to the terms of the Mozilla Public
 * License, v. 2.0. If a copy of the MPL was not distributed with this
 * file, You can obtain one at http://mozilla.org/MPL/2.0/. */

// Copyright 2018 John Maloney, Bernat Romagosa, and Jens Mönig

// sensorPrims.cpp - Microblocks I2C, SPI, tilt, and temperature primitives
// John Maloney, May 2018

#include <stdio.h>
#include <stdlib.h>

#include "mem.h"
#include "interp.h"

OBJ primAcceleration(int argCount, OBJ *args) {
	int x, y, z;
	x = 3;
	y = 3;
	z = 3;

	int accel = (int) sqrt((x * x) + (y * y) + (z * z));
	return int2obj(accel);
}

static PrimEntry entries[] = {
	{"acceleration", primAcceleration},
	// {"temperature", primMBTemp},
	// {"tiltX", primMBTiltX},
	// {"tiltY", primMBTiltY},
	// {"tiltZ", primMBTiltZ},
	// {"setAccelerometerRange", primSetAccelerometerRange},
	// {"magneticField", primMagneticField},
	// {"touchRead", primTouchRead},
	// {"i2cRead", primI2cRead},
	// {"i2cWrite", primI2cWrite},
	// {"i2cSetClockSpeed", primI2cSetClockSpeed},
	// {"spiExchange", primSPIExchange},
	// {"spiSetup", primSPISetup},
	// {"readDHT", primReadDHT},
	// {"microphone", primMicrophone},
};

void addSensorPrims() {
	addPrimitiveSet("sensors", sizeof(entries) / sizeof(PrimEntry), entries);
}
```
