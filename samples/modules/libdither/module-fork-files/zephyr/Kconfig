## tests/benchmarks/thread_metric/Kconfig
```kconfig
# Copyright (c) 2024 Intel Corporation
# SPDX-License-Identifier: Apache-2.0

mainmenu "Eclipse ThreadX Thread-Metric RTOS Test Suite"

choice TM_TEST
	prompt "Select a Thread-Metric test to execute"
	default TM_PREEMPTIVE
	help
	  The Thread-Metric benchmark suite consists of eight RTOS tests.
	  These tests measure the total number of RTOS events that can be
	  processed during a 30 second time interval.

config TM_BASIC
	bool "Baseline basic benchmark"
	help
	  The baseline basic benchmark consists of a single thread that counts
	  the number of times it performs a set of calculations. This number
	  is reported every 30 seconds.

config TM_COOPERATIVE
	bool "Cooperative context switching"
	help
	  The cooperative context switching benchmark spawns five (5) threads
	  of equal priority that yield to each other and increment counters
	  on each context switch. The sum total of the counters is reported
	  every 30 seconds.

config TM_INTERRUPT
	bool "Interrupt processing"
	select TEST
	select IRQ_OFFLOAD
	help
	  The interrupt processing benchmark has a single thread that causes
	  an interrupt which results in its ISR incrementing a counter and then
	  posting a semaphore. The thread then increments its own counter and
	  takes that semaphore. The sum total of the counters is reported
	  every 30 seconds.

config TM_INTERRUPT_PREEMPTION
	bool "Interrupt processing preemption"
	select TEST
	select IRQ_OFFLOAD
	help
	  The interrupt preemption benchmark counts the number of times that
	  an ISR from a software generated interrupt results in the preemption
	  of a thread. The total number of context switches is reported every
	  30 seconds.

config TM_MEMORY_ALLOCATION
	bool "Memory allocation"
	help
	  The memory allocation benchmark counts the number of times a thread
	  is able to allocate and then release a 128-byte block. This number
	  is reported every 30 seconds.

config TM_MESSAGE
	bool "Message processing"
	help
	  The message processing benchmark counts the number of times that a
	  thread can send and receive a 16-byte message from a message queue.
	  This number is reported every 30 seconds.

config TM_PREEMPTIVE
	bool "Preemptive context switching"
	help
	  The preemptive context switching benchmark creates five (5) threads
	  of different priorities that suspend and resume each other in a
	  cyclical pattern. The total number of context switches is reported
	  every 30 seconds.

config TM_SYNCHRONIZATION
	bool "Synchronization"
	help
	  The synchronization benchmark counts the number of times that a
	  thread can give and take a semaphore without blocking. This number
	  is reported every 30 seconds.

endchoice

choice TM_PORTING_LAYER
	prompt "Select the Thread-Metric porting layer implementation"
	default TM_PORTING_LAYER_ZEPHYR
	help
	  Select which RTOS abstraction the Thread-Metric porting layer is
	  mapped onto. This allows the very same benchmarks to be run either
	  directly against the native Zephyr kernel API or through Zephyr's
	  POSIX API in order to compare the two.

config TM_PORTING_LAYER_ZEPHYR
	bool "Native Zephyr kernel API"
	help
	  Implement the porting layer using the native Zephyr kernel API
	  (k_thread, k_sem, k_msgq, k_mem_slab).

config TM_PORTING_LAYER_POSIX
	bool "POSIX API"
	select POSIX_API
	select POSIX_MESSAGE_PASSING
	select POSIX_PRIORITY_SCHEDULING
	help
	  Implement the porting layer using Zephyr's POSIX API (pthreads,
	  POSIX semaphores, and POSIX message queues). Running the benchmarks
	  through this layer measures the additional overhead introduced by
	  the POSIX abstraction relative to the native Zephyr porting layer.

endchoice

# The scheduling benchmarks keep up to five test threads alive at once, so make
# sure the POSIX thread pool is large enough for them.
config POSIX_THREAD_THREADS_MAX
	default 8 if TM_PORTING_LAYER_POSIX

source "Kconfig.zephyr"
```
