## samples/modules/libdither/module-fork-files/zephyr/Kconfig
```kconfig
# Copyright (c) 2026 Anthropic
# SPDX-License-Identifier: Apache-2.0

config ZEPHYR_LIBDITHER_MODULE
	bool

config LIBDITHER
	bool "libdither image dithering library"
	select REQUIRES_FULL_LIBC
	help
	  Enable the libdither library for black-and-white and color image
	  dithering. Supports error diffusion (Floyd-Steinberg, Atkinson, and
	  others), ordered (Bayer), pattern, and other algorithms.
```

## samples/modules/lvgl/accelerometer_chart/boards/m5stack_core2.conf
```kconfig
CONFIG_LOG=y
CONFIG_LED_STRIP=y
CONFIG_LED_STRIP_LOG_LEVEL_DBG=y
CONFIG_WS2812_STRIP=y
CONFIG_WS2812_STRIP_SPI=y
CONFIG_SPI=y

CONFIG_MAIN_STACK_SIZE=4096

CONFIG_SAMPLE_CHART_POINTS_PER_SERIES=16
CONFIG_SAMPLE_ACCEL_SAMPLING_RATE=40
```

## samples/modules/lvgl/demos/boards/native_sim.conf
```kconfig
# Copyright 2023 Fabian Blatz <fabianblatz@gmail.com>
# SPDX-License-Identifier: Apache-2.0

CONFIG_LV_COLOR_DEPTH_16=y
CONFIG_DISPLAY_COLOR_PALETTE=y
CONFIG_DISPLAY_COLOR_PALETTE_MAX_SIZE=16
CONFIG_DISPLAY_PALETTE_DITHER=y
CONFIG_DISPLAY_PALETTE_DITHER_RGB565=y
CONFIG_DISPLAY_PALETTE_DITHER_DEFAULT_RGB565=y
```

## samples/net/mqtt_publisher/boards/nrf7002dk_nrf5340_cpuapp.conf
```kconfig
CONFIG_MAIN_STACK_SIZE=5200
CONFIG_SHELL_STACK_SIZE=5200
CONFIG_NET_TX_STACK_SIZE=2048
CONFIG_NET_RX_STACK_SIZE=2048

CONFIG_NET_DHCPV4=y

CONFIG_NET_SHELL=y

CONFIG_NET_STATISTICS=y
CONFIG_NET_STATISTICS_PERIODIC_OUTPUT=n

CONFIG_WIFI=y
CONFIG_WIFI_LOG_LEVEL_ERR=y
CONFIG_NET_L2_WIFI_SHELL=y

CONFIG_NET_MGMT_EVENT_QUEUE_TIMEOUT=5000
CONFIG_NET_MGMT_EVENT_QUEUE_SIZE=16

CONFIG_WIFI_CREDENTIALS=y
CONFIG_WIFI_CREDENTIALS_BACKEND_SETTINGS=y
CONFIG_SETTINGS=y
CONFIG_FLASH=y
CONFIG_FLASH_MAP=y
CONFIG_ZMS=y

CONFIG_NET_CONFIG_PEER_IPV4_ADDR="34.243.217.54"
CONFIG_NET_MAX_CONN=20
CONFIG_MQTT_VERSION_5_0=y
CONFIG_DNS_RESOLVER=y
```

## samples/sensor/distance_polling/sample.yaml
```yaml
sample:
  name: Distance measurement sample
common:
  tags: sensors
  harness: console
  harness_config:
    type: one_line
    regex:
      - "^[a-zA-Z0-9_,+-.]*: [0-9\\.]+m$"
tests:
  sample.sensor.distance_polling:
    filter: dt_alias_exists("distance0")
    integration_platforms:
      - arduino_nicla_vision/stm32h747xx/m7     # vl53l1x
      - mikroe_clicker_ra4m1/r7fa4m1ab3cfm      # mikroe_lightranger_2_click shield
    extra_args:
      - platform:mikroe_clicker_ra4m1/r7fa4m1ab3cfm:SHIELD="mikroe_lightranger_2_click"
```

## samples/sensor/mr60bha2/sample.yaml
```yaml
sample:
  name: Seeed Studio MR60BHA2 sample
tests:
  sample.sensor.mr60bha2:
    tags:
      - sensors
      - shield
    extra_args: SHIELD=seeed_xiao_mr60bha2
    platform_allow:
      - xiao_esp32c6/esp32c6/hpcore
    integration_platforms:
      - xiao_esp32c6/esp32c6/hpcore
    filter: dt_compat_enabled("seeed,mr60bha2")
```

## samples/subsys/instrumentation/boards/stm32n6570_dk_sb.conf
```kconfig
# STM32N6570_DK configuration for instrumentation sample

# Enable stack debugging features
CONFIG_THREAD_STACK_INFO=y
CONFIG_THREAD_NAME=y
CONFIG_EXTRA_EXCEPTION_INFO=y

CONFIG_RETENTION=n
CONFIG_REBOOT=n
CONFIG_RETAINED_MEM=n

# CONFIG_ARM_MPU=n
```

## samples/subsys/ipc/openamp/boards/mimxrt1180_evk_mimxrt1189_cm33.conf
```kconfig
CONFIG_SECOND_CORE_MCUX=y
CONFIG_INCLUDE_REMOTE_DIR=y
CONFIG_IPM=y
CONFIG_MBOX=y
```

## samples/subsys/testsuite/pytest/display_capture/testcase.yaml
```yaml
common:
  tags:
    - test_framework
    - pytest
    - display
    - display_capture
  filter: dt_chosen_enabled("zephyr,display")
  integration_platforms:
    - native_sim

tests:
  # Basic pytest test without actual display capture
  # This demonstrates the test structure but doesn't require camera setup
  sample.pytest.display_capture:
    platform_allow:
      - native_sim
    harness: pytest
    harness_config:
      pytest_root:
        - "pytest/test_display_demo.py"

  # Example test using display_capture harness
  # This shows how to configure the display_capture harness
  # To use this test, you need to:
  # 1. Set up a camera to capture display output
  # 2. Generate fingerprints using camera_shield (see README.rst)
  # 3. Set DISPLAY_TEST_DIR environment variable
  # 4. Uncomment the test below and run on supported hardware
  #
  # sample.pytest.display_capture.with_camera:
  #   platform_allow:
  #     - frdm_mcxn947/mcxn947/cpu0
  #   harness: display_capture
  #   harness_config:
  #     pytest_dut_scope: session
  #     fixture: fixture_display
  #     display_capture_config: "${DISPLAY_TEST_DIR}/display_config.yaml"
  #   extra_args: SHIELD=lcd_par_s035_8080
```

## samples/subsys/usb/host_uvc/boards/frdm_rw612.conf
```kconfig
# FRDM-RW612 + some UVC devices (e.g. Logitech C920): SET_INTERFACE may fail on the
# highest isoch alternate while a slightly lower alternate works. Cap max payload so
# strict alternate selection can prefer e.g. alt 10 (2688 B) before alt 11 (3060 B).
CONFIG_USBH_UVC_HOST_MAX_PAYLOAD_CAP=2688
```

## samples/subsys/usb/host_uvc/boards/rd_rw612_bga.conf
```kconfig
# Same rationale as frdm_rw612: prefer a non-max isoch alternate when the top one fails SET_INTERFACE.
CONFIG_USBH_UVC_HOST_MAX_PAYLOAD_CAP=2688
```

## samples/subsys/zbus/proxy_agent_ipc/boards/frdm_mcxn947_mcxn947_cpu0.conf
```kconfig
CONFIG_SECOND_CORE_MCUX=y
CONFIG_HEAP_MEM_POOL_SIZE=4096
CONFIG_OPENAMP=y
CONFIG_OPENAMP_SLAVE=n
```
