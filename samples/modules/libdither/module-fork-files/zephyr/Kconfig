## scripts/kconfig/kconfig.py
```kconfig
#!/usr/bin/env python3

# Copyright (c) 2018-2023 Nordic Semiconductor ASA and Ulf Magnusson
# Originally modified from:
# https://github.com/ulfalizer/Kconfiglib/blob/master/examples/merge_config.py

# SPDX-License-Identifier: ISC

# Writes/updates the zephyr/.config configuration file by merging configuration
# files passed as arguments, e.g. board *_defconfig and application prj.conf
# files.
#
# When fragments haven't changed, zephyr/.config is both the input and the
# output, which just updates it. This is handled in the CMake files.
#
# Also does various checks (most via Kconfiglib warnings).

import argparse
import contextlib
import glob
import hashlib
import io
import json
import os
import pickle
import re
import sys
import textwrap

# Zephyr doesn't use tristate symbols. They're supported here just to make the
# script a bit more generic.
from kconfiglib import (
    AND,
    BOOL,
    OR,
    TRI_TO_STR,
    TRISTATE,
    TYPE_TO_STR,
    Kconfig,
    Symbol,
    expr_str,
    expr_value,
    split_expr,
)


def main():
    args = parse_args()

    if args.zephyr_base:
        os.environ['ZEPHYR_BASE'] = args.zephyr_base

    if stamp_is_up_to_date(args):
        return

    # Capture everything this script prints to stderr (warnings) so that it
    # can be stored in the stamp file and replayed on later runs where the
    # reparse is skipped.
    sys.stderr = _Tee(sys.stderr)

    print("Parsing " + args.kconfig_file)
    kconf = Kconfig(args.kconfig_file, warn_to_stderr=False,
                    suppress_traceback=True)

    if args.handwritten_input_configs:
        # Warn for assignments to undefined symbols, but only for handwritten
        # fragments, to avoid warnings-turned-errors when using an old
        # configuration file together with updated Kconfig files
        kconf.warn_assign_undef = True

        # prj.conf may override settings from the board configuration, so
        # disable warnings about symbols being assigned more than once
        kconf.warn_assign_override = False
        kconf.warn_assign_redun = False

    if args.forced_input_configs:
        # Do not warn on a redundant config.
        # The reason is that a regular .config will be followed by the forced
        # config which under normal circumstances should be identical to the
        # configured setting.
        # Only if user has modified to a value that gets overruled by the forced
        # a warning shall be issued.
        kconf.warn_assign_redun = False

    # Load files
    print(kconf.load_config(args.configs_in[0]))
    for config in args.configs_in[1:]:
        # replace=False creates a merged configuration
        print(kconf.load_config(config, replace=False))

    if args.handwritten_input_configs:
        # Check that there are no assignments to promptless symbols, which
        # have no effect.
        #
        # This only makes sense when loading handwritten fragments and not when
        # loading zephyr/.config, because zephyr/.config is configuration
        # output and also assigns promptless symbols.
        check_no_promptless_assign(kconf)

        # Print warnings for symbols that didn't get the assigned value. Only
        # do this for handwritten input too, to avoid likely unhelpful warnings
        # when using an old configuration and updating Kconfig files.
        check_assigned_sym_values(kconf)
        check_assigned_choice_values(kconf)

    if kconf.syms.get('WARN_DEPRECATED', kconf.y).tri_value == 2:
        check_deprecated(kconf)

    if kconf.syms.get('WARN_EXPERIMENTAL', kconf.y).tri_value == 2:
        check_experimental(kconf)

    check_not_secure(kconf)

    # Hack: Force all symbols to be evaluated, to catch warnings generated
    # during evaluation. Wait till the end to write the actual output files, so
    # that we don't generate any output if there are warnings-turned-errors.
    #
    # Kconfiglib caches calculated symbol values internally, so this is still
    # fast.
    kconf.write_config(os.devnull)

    warn_only = r"warning:.*set more than once."

    if kconf.warnings:
        if args.forced_input_configs:
            error_out = False
        else:
            error_out = True

        # Put a blank line between warnings to make them easier to read
        for warning in kconf.warnings:
            print("\n" + warning, file=sys.stderr)

            if not error_out and not re.search(warn_only, warning):
                # The warning is not a warn_only, fail the Kconfig.
                error_out = True

        # Turn all warnings into errors, so that e.g. assignments to undefined
        # Kconfig symbols become errors.
        #
        # A warning is generated by this script whenever a symbol gets a
        # different value than the one it was assigned. Keep that one as just a
        # warning for now.
        if error_out:
            err("Aborting due to Kconfig warnings")

    # Write the merged configuration and the C header
    print(kconf.write_config(args.config_out))
    print(kconf.write_autoconf(args.header_out))

    # Write value origin information for the merged configuration
    trace_data = collect_trace_data(kconf)
    with open(args.config_out + '-trace.pickle', 'wb') as f:
        pickle.dump(trace_data, f)
    with open(args.config_out + '-trace.json', 'w') as f:
        json.dump(trace_data, f, indent=2)

    # Write the list of parsed Kconfig files to a file
    write_kconfig_filenames(kconf, args.kconfig_list_out)

    write_stamp(args, kconf)


# The stamp file allows kconfig.py to skip the full Kconfig parse on later
# runs when it can prove that nothing which could influence any of its outputs
# has changed. A full Zephyr Kconfig tree parse takes seconds, and CMake
# reruns this script on every (re)configure, usually with everything
# unchanged.
#
# The stamp records, from the last successful run:
#
# - the command line arguments,
# - name and value of every environment variable that can influence parsing:
#   the variables kconfiglib and kconfigfunctions read directly, plus every
#   variable the Kconfig files referenced,
# - the content (mtime/size, with a content hash fallback) of every parsed
#   Kconfig file, every input configuration file, this script and its helper
#   modules, and the EDT pickle consulted by the devicetree preprocessor
#   functions,
# - every 'source' statement pattern and the set of files it matched, so that
#   adding a file which an 'osource' would now pick up invalidates the stamp,
# - the content hash of every output file, so that externally modified or
#   deleted outputs (e.g. a hand-edited .config) trigger a full run,
# - the standard error output of the run, so warnings can be replayed.
#
# Any mismatch, error, or unexpected content simply results in a full run,
# which rewrites the stamp. Set the ZEPHYR_KCONFIG_NO_SKIP environment
# variable to a non-empty value to disable the mechanism entirely.

STAMP_VERSION = 1

_STAMP_ENV_VARS = (
    # Read by kconfiglib.
    "srctree",
    "CONFIG_",
    "KCONFIG_ALLCONFIG",
    "KCONFIG_AUTOHEADER",
    "KCONFIG_AUTOHEADER_HEADER",
    "KCONFIG_CONFIG",
    "KCONFIG_CONFIG_HEADER",
    "KCONFIG_FUNCTIONS",
    "KCONFIG_STRICT",
    "KCONFIG_WARN_UNDEF",
    "KCONFIG_WARN_UNDEF_ASSIGN",
    # Read by kconfigfunctions.
    "EDT_PICKLE",
    "KCONFIG_DOC_MODE",
    "SHIELD_AS_LIST",
    "ZEPHYR_BASE",
)


class _Tee:
    # Duplicates writes to 'stream' into an in-memory buffer.

    def __init__(self, stream):
        self.stream = stream
        self.buffer = io.StringIO()

    def write(self, data):
        self.stream.write(data)
        self.buffer.write(data)

    def flush(self):
        self.stream.flush()


def stamp_path(args):
    # One stamp per command line variant: the build system alternates between
    # invoking this script with the handwritten configuration fragments and
    # with the generated .config as input, and each variant can be skipped
    # independently when nothing relevant to it has changed.
    argv_tag = hashlib.sha256(
        "\0".join(sys.argv[1:]).encode('utf-8')).hexdigest()[:12]
    return f"{args.config_out}-stamp-{argv_tag}.json"


def _file_digest(path):
    with open(path, 'rb') as f:
        return hashlib.sha256(f.read()).hexdigest()


def _stamp_file_entry(path):
    st = os.stat(path)
    return [path, st.st_mtime_ns, st.st_size, _file_digest(path)]


def _stamp_input_files(args, kconf):
    paths = {os.path.join(kconf.srctree, path)
             for path in kconf.kconfig_filenames}
    paths.update(args.configs_in)
    # The scripts implementing the Kconfig processing.
    script_dir = os.path.dirname(os.path.abspath(__file__))
    paths.add(os.path.abspath(__file__))
    paths.add(os.path.join(script_dir, "kconfiglib.py"))
    paths.add(os.path.join(script_dir, "kconfigfunctions.py"))
    # The devicetree the Kconfig preprocessor functions consult.
    edt_pickle = os.environ.get("EDT_PICKLE")
    if edt_pickle and os.path.exists(edt_pickle):
        paths.add(edt_pickle)
    return sorted(paths)


def write_stamp(args, kconf):
    try:
        stamp = {
            "version": STAMP_VERSION,
            "argv": sys.argv[1:],
            "env": {name: os.environ.get(name) for name in
                    sorted(set(_STAMP_ENV_VARS) | kconf.env_vars)},
            "files": [_stamp_file_entry(p) for p in
                      _stamp_input_files(args, kconf)],
            "globs": [[pattern, matches] for pattern, matches in
                      kconf.source_globs],
            "outputs": [[p, _file_digest(p)] for p in
                        (args.config_out, args.header_out,
                         args.kconfig_list_out,
                         args.config_out + '-trace.pickle',
                         args.config_out + '-trace.json')],
            "stderr": sys.stderr.buffer.getvalue(),
        }
        with open(stamp_path(args), 'w', encoding='utf-8') as f:
            json.dump(stamp, f)
    except Exception:
        # A missing stamp only means the next run is a full run.
        with contextlib.suppress(OSError):
            os.unlink(stamp_path(args))


def _first_changed_glob(recorded):
    # Returns the first recorded source pattern whose set of matched files
    # would differ on a re-parse, or None.
    for pattern, matches in recorded:
        if glob.has_magic(pattern):
            if sorted(glob.iglob(pattern)) != matches:
                return pattern
        else:
            # For a pattern without wildcards, iglob() returns [pattern] if
            # the path exists and [] otherwise, so a stat is all it takes.
            if matches != ([pattern] if os.path.lexists(pattern) else []):
                return pattern
    return None


def _first_changed_file(recorded):
    # Returns the first recorded input file which changed, or None.
    for path, mtime_ns, size, digest in recorded:
        try:
            st = os.stat(path)
        except OSError:
            return path
        if st.st_mtime_ns == mtime_ns and st.st_size == size:
            continue
        # A rewritten file: fall back to comparing content. Several generated
        # input files (e.g. the devicetree Kconfig and the EDT pickle) are
        # rewritten with identical content on every configure.
        if st.st_size != size or _file_digest(path) != digest:
            return path
    return None


def _stamp_debug(reason):
    if os.environ.get("ZEPHYR_KCONFIG_STAMP_DEBUG"):
        print(f"kconfig stamp: full run: {reason}", file=sys.stderr)


def stamp_is_up_to_date(args):
    if os.environ.get("ZEPHYR_KCONFIG_NO_SKIP"):
        return False

    try:
        with open(stamp_path(args), encoding='utf-8') as f:
            stamp = json.load(f)

        if stamp["version"] != STAMP_VERSION:
            _stamp_debug("stamp version changed")
            return False
        if stamp["argv"] != sys.argv[1:]:
            _stamp_debug(f"arguments changed: {stamp['argv']} "
                         f"-> {sys.argv[1:]}")
            return False
        for name, value in stamp["env"].items():
            if os.environ.get(name) != value:
                _stamp_debug(f"environment variable {name} changed")
                return False
        for path, digest in stamp["outputs"]:
            if _file_digest(path) != digest:
                _stamp_debug(f"output changed or missing: {path}")
                return False
        changed = _first_changed_file(stamp["files"])
        if changed is not None:
            _stamp_debug(f"input changed: {changed}")
            return False
        changed = _first_changed_glob(stamp["globs"])
        if changed is not None:
            _stamp_debug(f"sourced files changed for: {changed}")
            return False
    except Exception as e:
        _stamp_debug(f"no usable stamp ({e!r})")
        return False

    # Nothing that can influence the outputs has changed and the outputs
    # themselves are intact: skip the parse and replay the warnings of the
    # previous run, which would be generated again by a full run.
    print("Kconfig configuration is up to date "
          "(inputs unchanged since the last run, skipping the reparse; "
          "set ZEPHYR_KCONFIG_NO_SKIP=1 to force a full run)")
    err_output = stamp.get("stderr", "")
    if err_output:
        sys.stderr.write(err_output)
    return True


def check_no_promptless_assign(kconf):
    # Checks that no promptless symbols are assigned

    for sym in kconf.unique_defined_syms:
        if sym.user_value is not None and promptless(sym):
            err(f"""\
{sym.name_and_loc} is assigned in a configuration file, but is not directly
user-configurable (has no prompt). It gets its value indirectly from other
symbols. """ + SYM_INFO_HINT.format(sym))


def check_assigned_sym_values(kconf):
    # Verifies that the values assigned to symbols "took" (matches the value
    # the symbols actually got), printing warnings otherwise. Choice symbols
    # are checked separately, in check_assigned_choice_values().

    for sym in kconf.unique_defined_syms:
        if sym.choice:
            continue

        user_value = sym.user_value
        if user_value is None:
            continue

        # Tristate values are represented as 0, 1, 2. Having them as "n", "m",
        # "y" is more convenient here, so convert.
        if sym.type in (BOOL, TRISTATE):
            user_value = TRI_TO_STR[user_value]

        if user_value != sym.str_value:
            msg = f"{sym.name_and_loc} was assigned the value '{user_value}'" \
                  f" but got the value '{sym.str_value}'. "

            # List any unsatisfied 'depends on' dependencies in the warning
            mdeps = missing_deps(sym)
            if mdeps:
                expr_strs = []
                for expr in mdeps:
                    estr = expr_str(expr)
                    if isinstance(expr, tuple):
                        # Add () around dependencies that aren't plain symbols.
                        # Gives '(FOO || BAR) (=n)' instead of
                        # 'FOO || BAR (=n)', which might be clearer.
                        estr = f"({estr})"
                    expr_strs.append(f"{estr} "
                                     f"(={TRI_TO_STR[expr_value(expr)]})")

                msg += "Check these unsatisfied dependencies: " + \
                    ", ".join(expr_strs) + ". "

            warn(msg + SYM_INFO_HINT.format(sym))


def missing_deps(sym):
    # check_assigned_sym_values() helper for finding unsatisfied dependencies.
    #
    # Given direct dependencies
    #
    #     depends on <expr> && <expr> && ... && <expr>
    #
    # on 'sym' (which can also come from e.g. a surrounding 'if'), returns a
    # list of all <expr>s with a value less than the value 'sym' was assigned
    # ("less" instead of "not equal" just to be general and handle tristates,
    # even though Zephyr doesn't use them).
    #
    # For string/int/hex symbols, just looks for <expr> = n.
    #
    # Note that <expr>s can be something more complicated than just a symbol,
    # like 'FOO || BAR' or 'FOO = "string"'.

    deps = split_expr(sym.direct_dep, AND)

    if sym.type in (BOOL, TRISTATE):
        return [dep for dep in deps if expr_value(dep) < sym.user_value]
    # string/int/hex
    return [dep for dep in deps if expr_value(dep) == 0]


def check_assigned_choice_values(kconf):
    # Verifies that any choice symbols that were selected (by setting them to
    # y) ended up as the selection, printing warnings otherwise.
    #
    # We check choice symbols separately to avoid warnings when two different
    # choice symbols within the same choice are set to y. This might happen if
    # a choice selection from a board defconfig is overridden in a prj.conf,
    # for example. The last choice symbol set to y becomes the selection (and
    # all other choice symbols get the value n).
    #
    # Without special-casing choices, we'd detect that the first symbol set to
    # y ended up as n, and print a spurious warning.

    for choice in kconf.unique_choices:
        if choice.user_selection and \
           choice.user_selection is not choice.selection:

            warn(f"""\
The choice symbol {choice.user_selection.name_and_loc} was selected (set =y),
but {choice.selection.name_and_loc if choice.selection else "no symbol"} ended
up as the choice selection. """ + SYM_INFO_HINT.format(choice.user_selection))


# Hint on where to find symbol information. Used like
# SYM_INFO_HINT.format(sym).
SYM_INFO_HINT = """\
See http://docs.zephyrproject.org/latest/kconfig.html#CONFIG_{0.name} and/or
look up {0.name} in the menuconfig/guiconfig interface. The Application
Development Primer, Setting Configuration Values, and Kconfig - Tips and Best
Practices sections of the manual might be helpful too.\
"""


def check_deprecated(kconf):
    deprecated = kconf.syms.get('DEPRECATED')
    dep_expr = kconf.n if deprecated is None else deprecated.rev_dep

    if dep_expr is not kconf.n:
        selectors = [s for s in split_expr(dep_expr, OR) if expr_value(s) == 2]
        for selector in selectors:
            selector_name = split_expr(selector, AND)[0].name
            warn(f'Deprecated symbol {selector_name} is enabled.')


def check_experimental(kconf):
    experimental = kconf.syms.get('EXPERIMENTAL')
    dep_expr = kconf.n if experimental is None else experimental.rev_dep

    if dep_expr is not kconf.n:
        selectors = [s for s in split_expr(dep_expr, OR) if expr_value(s) == 2]
        for selector in selectors:
            selector_name = split_expr(selector, AND)[0].name
            warn(f'Experimental symbol {selector_name} is enabled.')

def check_not_secure(kconf):
    not_secure = kconf.syms.get('NOT_SECURE')
    dep_expr = kconf.n if not_secure is None else not_secure.rev_dep

    if dep_expr is not kconf.n:
        selectors = [s for s in split_expr(dep_expr, OR) if expr_value(s) == 2]
        for selector in selectors:
            selector_name = split_expr(selector, AND)[0].name
            warn(f'Not secure symbol {selector_name} is enabled.')


def promptless(sym):
    # Returns True if 'sym' has no prompt. Since the symbol might be defined in
    # multiple locations, we need to check all locations.

    return not any(node.prompt for node in sym.nodes)


def collect_trace_data(kconf):
    """
    Collects trace data for all symbols in 'kconf'. The output is currently a
    list of 6-tuples with one entry per symbol definition, with the following
    layout:

        (name, visibility, type, value, kind, location)

    where the first 4 entries are the string representation of the symbol's
    properties, and 'kind' and 'location' are taken from its 'origin'
    attribute.
    """

    # NOTE: this data is used by scripts/kconfig/traceconfig.py and the tests
    # under tests/kconfig/tracing. Make sure to keep them aligned if the
    # format changes in any way.

    trace_data = []
    for node in kconf.node_iter(True):
        item = node.item
        if not isinstance(item, Symbol):
            continue

        origin = item.origin
        if origin is None:
            continue

        name = kconf.config_prefix + item.name
        kind, loc = origin
        value = None if kind == "unset" else item.str_value

        trace_entry = (name, TRI_TO_STR[item.visibility],
                       TYPE_TO_STR[item.type], value, kind, loc)
        trace_data.append(trace_entry)

    return trace_data


def write_kconfig_filenames(kconf, kconfig_list_path):
    # Writes a sorted list with the absolute paths of all parsed Kconfig files
    # to 'kconfig_list_path'. The paths are realpath()'d, and duplicates are
    # removed. This file is used by CMake to look for changed Kconfig files. It
    # needs to be deterministic.

    with open(kconfig_list_path, 'w') as out:
        for path in sorted({os.path.realpath(os.path.join(kconf.srctree, path))
                            for path in set(kconf.kconfig_filenames)}):
            print(path, file=out)


def parse_args():
    parser = argparse.ArgumentParser(allow_abbrev=False)

    parser.add_argument("--handwritten-input-configs",
                        action="store_true",
                        help="Assume the input configuration fragments are "
                             "handwritten fragments and do additional checks "
                             "on them, like no promptless symbols being "
                             "assigned")
    parser.add_argument("--forced-input-configs",
                        action="store_true",
                        help="Indicate the input configuration files are "
                             "followed by an forced configuration file."
                             "The forced configuration is used to forcefully "
                             "set specific configuration settings to a "
                             "pre-defined value and thereby remove any user "
                             " adjustments.")
    parser.add_argument("--zephyr-base",
                        help="Path to current Zephyr installation")
    parser.add_argument("kconfig_file",
                        help="Top-level Kconfig file")
    parser.add_argument("config_out",
                        help="Output configuration file")
    parser.add_argument("header_out",
                        help="Output header file")
    parser.add_argument("kconfig_list_out",
                        help="Output file for list of parsed Kconfig files")
    parser.add_argument("configs_in",
                        nargs="+",
                        help="Input configuration fragments. Will be merged "
                             "together.")

    return parser.parse_args()


def warn(msg):
    # Use a large fill() width to try to avoid linebreaks in the symbol
    # reference link, and add some extra newlines to set the message off from
    # surrounding text (this usually gets printed as part of spammy CMake
    # output)
    print("\n" + textwrap.fill("warning: " + msg, 100) + "\n", file=sys.stderr)


def err(msg):
    sys.exit("\n" + textwrap.fill("error: " + msg, 100) + "\n")


if __name__ == "__main__":
    main()
```
