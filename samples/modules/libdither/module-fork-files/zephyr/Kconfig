## subsys/homeassistant/Kconfig
```kconfig
# Copyright (c) 2024 Benjamin Cabé
# SPDX-License-Identifier: Apache-2.0

menuconfig HOMEASSISTANT
	bool "Home Assistant integration support"
	select ZBUS
	select ZBUS_RUNTIME_OBSERVERS
	select MQTT_LIB
	select NET_IPV4
	select NET_SOCKETS
	help
	  Enable Home Assistant integration. This module provides
	  easy integration with Home Assistant via MQTT by automatically
	  bridging Zbus channels to MQTT topics.

if HOMEASSISTANT

config HOMEASSISTANT_MQTT_BROKER_HOSTNAME
	string "MQTT broker hostname"
	default "homeassistant.local"
	help
	  The hostname or IP address of the MQTT broker (typically your Home Assistant instance).

config HOMEASSISTANT_MQTT_BROKER_PORT
	int "MQTT broker port"
	default 1883
	help
	  The port of the MQTT broker.

config HOMEASSISTANT_MQTT_CLIENT_ID
	string "MQTT client ID"
	default "zephyr_device"
	help
	  The MQTT client ID to use when connecting to the broker.

config HOMEASSISTANT_MQTT_USERNAME
	string "MQTT username"
	default ""
	help
	  The MQTT username for authentication (leave empty if not required).

config HOMEASSISTANT_MQTT_PASSWORD
	string "MQTT password"
	default ""
	help
	  The MQTT password for authentication (leave empty if not required).

config HOMEASSISTANT_DEVICE_NAME
	string "Device name"
	default "zephyr_device"
	help
	  The device name to use in Home Assistant.

config HOMEASSISTANT_STACK_SIZE
	int "Home Assistant thread stack size"
	default 4096
	help
	  Stack size for the Home Assistant background thread.

config HOMEASSISTANT_THREAD_PRIORITY
	int "Home Assistant thread priority"
	default 5
	help
	  Priority for the Home Assistant background thread.

config HOMEASSISTANT_MAX_CHANNELS
	int "Maximum number of channels to monitor"
	default 16
	help
	  Maximum number of Zbus channels that can be registered with Home Assistant.

config HOMEASSISTANT_MQTT_BUFFER_SIZE
	int "MQTT buffer size"
	default 1024
	help
	  Size of the MQTT TX/RX buffers.

config HOMEASSISTANT_AUTO_DISCOVERY
	bool "Enable Home Assistant auto-discovery"
	default y
	help
	  Enable automatic discovery of sensors in Home Assistant via MQTT discovery protocol.

config HOMEASSISTANT_DISCOVERY_PREFIX
	string "Discovery topic prefix"
	default "homeassistant"
	depends on HOMEASSISTANT_AUTO_DISCOVERY
	help
	  The prefix for Home Assistant MQTT discovery topics.

module = HOMEASSISTANT
module-str = homeassistant
source "subsys/logging/Kconfig.template.log_config"

endif # HOMEASSISTANT
```

## subsys/meshtastic/Kconfig
```kconfig
# Meshtastic mesh radio stack
#
# Copyright (c) 2026 The Zephyr Project Contributors
# SPDX-License-Identifier: Apache-2.0

menuconfig MESHTASTIC
	bool "Meshtastic mesh radio stack [EXPERIMENTAL]"
	depends on ZEPHYR_NANOPB_MODULE
	select LORA
	select NANOPB
	select PSA_CRYPTO
	select PSA_WANT_ALG_CTR
	select PSA_WANT_KEY_TYPE_AES
	select EXPERIMENTAL
	help
	  Enable the Meshtastic mesh radio stack.

	  Provides a wire-compatible implementation of the Meshtastic protocol
	  (https://meshtastic.org) on top of the Zephyr raw LoRa driver API.
	  Supports text messaging (PortNum 1) and raw data delivery over the
	  LongFast channel parameters (SF 11, BW 250 kHz, CR 4/5).

	  Requires a LoRa transceiver supported by the Zephyr LoRa driver
	  (e.g. SX1276, SX1262) and the nanopb module in the west workspace.

if MESHTASTIC

module = MESHTASTIC
module-str = meshtastic
source "subsys/logging/Kconfig.template.log_config"

config MESHTASTIC_THREAD_STACK_SIZE
	int "Receive thread stack size (bytes)"
	default 2048
	help
	  Stack size for the Meshtastic background receive thread.
	  Must accommodate lora_recv(), nanopb decoding, and PSA crypto
	  operations.  Increase if stack overflows are observed.

config MESHTASTIC_THREAD_PRIORITY
	int "Receive thread priority"
	default 7
	help
	  Cooperative (negative) or preemptive (non-negative) priority of the
	  Meshtastic background receive thread.

config MESHTASTIC_RX_TIMEOUT_MS
	int "Per-receive-window timeout (ms)"
	default 500
	help
	  The background receive thread calls lora_recv() with this timeout.
	  A shorter value reduces TX latency (the receive loop yields to a
	  pending transmit more quickly) at the cost of slightly more CPU
	  activity.  A longer value reduces CPU overhead but increases the
	  worst-case time before a pending transmission is sent.

config MESHTASTIC_DEFAULT_HOP_LIMIT
	int "Default hop limit for outgoing packets"
	default 3
	range 1 7
	help
	  Number of times an outgoing packet may be relayed by intermediate
	  nodes.  3 is the Meshtastic firmware default; higher values increase
	  range at the cost of additional channel utilisation.

config MESHTASTIC_TX_POWER
	int "Default TX power (dBm)"
	default 17
	help
	  Default LoRa transmit power used when meshtastic_config.tx_power is
	  zero.  Most LoRa modules support 2–20 dBm; consult your hardware
	  datasheet for the allowed range.

config MESHTASTIC_DUP_CACHE_SIZE
	int "Duplicate-packet cache size (entries)"
	default 16
	range 4 64
	help
	  Number of (src, packet_id) pairs retained for duplicate suppression.
	  Each entry consumes 8 bytes of RAM.  Increase if duplicate packets
	  are observed in dense mesh deployments.

endif # MESHTASTIC
```

## subsys/meshtastic/Kconfig.nodedb
```kconfig
# Copyright (c) 2026 The Zephyr Project Contributors
# SPDX-License-Identifier: Apache-2.0

config MESHTASTIC_NODEDB
	bool "Meshtastic in-RAM NodeDB"
	default y
	help
	  Track mesh nodes heard by the Meshtastic subsystem in RAM. This
	  initial implementation is volatile and does not persist entries to
	  flash.

if MESHTASTIC_NODEDB

config MESHTASTIC_NODEDB_MAX_NODES
	int "Maximum NodeDB entries"
	default 16
	range 1 256
	help
	  Maximum number of nodes kept in the in-RAM Meshtastic NodeDB,
	  including the local node entry.

endif # MESHTASTIC_NODEDB
```

## subsys/mgmt/homeassistant/Kconfig
```kconfig
# Home Assistant integration configuration options

# Copyright (c) 2025 Benjamin Cabé
# SPDX-License-Identifier: Apache-2.0

menuconfig HOMEASSISTANT
	bool "Home Assistant Integration"
	depends on ZBUS
	depends on NET_TCP
	depends on NET_SOCKETS
	depends on HTTP_CLIENT
	help
	  Enable Home Assistant integration via Zbus channels.
	  This module automatically bridges Zbus channels to Home Assistant,
	  allowing devices to expose data without manual networking code.

if HOMEASSISTANT

config HOMEASSISTANT_SERVER_ADDR
	string "Home Assistant server address"
	default "192.168.1.100"
	help
	  IP address or hostname of the Home Assistant server.

config HOMEASSISTANT_SERVER_PORT
	int "Home Assistant server port"
	default 8123
	help
	  Port number of the Home Assistant server (default: 8123).

config HOMEASSISTANT_API_TOKEN
	string "Home Assistant API token"
	default ""
	help
	  Long-lived access token for Home Assistant API authentication.
	  Generate this from your Home Assistant profile settings.

config HOMEASSISTANT_DEVICE_NAME
	string "Device name"
	default "Zephyr Device"
	help
	  Name of the device as it will appear in Home Assistant.

config HOMEASSISTANT_UPDATE_INTERVAL
	int "Update interval in milliseconds"
	default 5000
	range 100 3600000
	help
	  Interval at which to check for Zbus channel updates and
	  send them to Home Assistant (in milliseconds).

config HOMEASSISTANT_THREAD_STACK_SIZE
	int "Thread stack size"
	default 4096
	help
	  Stack size for the Home Assistant integration thread.
	  This thread handles HTTP communication with Home Assistant.

module = HOMEASSISTANT
module-str = homeassistant
module-help = Enables logging for Home Assistant integration.
source "subsys/logging/Kconfig.template.log_config"

endif # HOMEASSISTANT
```

## subsys/net/lib/ocpp/Kconfig.shell
```kconfig
# Copyright (c) 2025 Linumiz GmbH
# SPDX-License-Identifier: Apache-2.0

menuconfig OCPP_SHELL
	bool "OCPP shell commands"
	depends on OCPP
	depends on SHELL
	help
	  Enable shell commands for OCPP (Open Charge Point Protocol).

if OCPP_SHELL

endif # OCPP_SHELL
```

## subsys/net/lib/webrtc/Kconfig
```kconfig
# WebRTC Data Channel support
#
# SPDX-FileCopyrightText: Copyright The Zephyr Project Contributors
# SPDX-License-Identifier: Apache-2.0

config WEBRTC
	bool "WebRTC Data Channel support [EXPERIMENTAL]"
	select NET_SOCKETS
	select NET_SOCKETS_ENABLE_DTLS
	select NET_UDP
	select TLS_CREDENTIALS
	select PSA_CRYPTO
	select PSA_WANT_ALG_SHA_256
	select PSA_WANT_ALG_SHA_1
	select PSA_WANT_ALG_HMAC
	select CRC
	select EXPERIMENTAL
	help
	  Enable the Zephyr WebRTC data channel library.

	  This implements a subset of the W3C WebRTC API focused on
	  RTCDataChannel support over UDP/DTLS.  ICE host candidate
	  gathering and STUN-based connectivity checks are included.

	  NOTE: The data channel wire protocol uses a Zephyr-specific
	  lightweight framing over DTLS rather than the standard
	  SCTP-over-DTLS defined in RFC 8832.  Interoperability with
	  browsers or standard W3C WebRTC endpoints requires a future
	  SCTP upgrade.  Only host ICE candidates are gathered; STUN
	  server-reflexive and TURN relay candidates are not supported
	  in this version.

if WEBRTC

config WEBRTC_MAX_PEER_CONNECTIONS
	int "Maximum number of simultaneous peer connections"
	default 1
	range 1 8
	help
	  Number of rtc_peer_connection contexts allocated in the static
	  pool.  Increase this value when multiple concurrent peer
	  connections are required.

config WEBRTC_MAX_ICE_CANDIDATES
	int "Maximum number of ICE candidates per side"
	default 4
	range 1 16
	help
	  Maximum number of ICE candidates that can be stored for each
	  side (local and remote) of a peer connection.

config WEBRTC_MAX_DATA_CHANNELS
	int "Maximum number of data channels per peer connection"
	default 4
	range 1 16
	help
	  Maximum number of simultaneous RTCDataChannels per peer
	  connection.  Each channel is allocated dynamically from the
	  system heap.

config WEBRTC_DATA_CHANNEL_LABEL_LEN
	int "Maximum data channel label length (characters)"
	default 64
	range 1 255
	help
	  Maximum length of an RTCDataChannel label string, not including
	  the NUL terminator.

config WEBRTC_SDP_MAX_LEN
	int "Maximum SDP buffer size in bytes"
	default 1024
	range 256 4096
	help
	  Size of the SDP string buffer used when generating offer or
	  answer descriptions.  Increase this value if ICE candidates
	  cause the generated SDP to exceed the default size.

config WEBRTC_CERT_BUF_SIZE
	int "Certificate copy buffer size in bytes"
	default 2048
	range 512 8192
	help
	  Size of the static buffer used when reading a DER-encoded X.509
	  certificate from the TLS credentials store during peer connection
	  initialisation.  Must be at least as large as the DER-encoded
	  certificate registered under the DTLS credential tag.

config WEBRTC_IO_RECV_BUF_SIZE
	int "I/O receive buffer size in bytes"
	default 1500
	range 256 65535
	help
	  Size of the internal receive buffer used by the background I/O
	  work handler.  Should be at least as large as the largest
	  expected DTLS record.

config WEBRTC_IO_POLL_INTERVAL_MS
	int "I/O polling interval in milliseconds"
	default 20
	range 1 1000
	help
	  Period at which the background I/O work item wakes to check for
	  incoming STUN responses and DTLS data.  Lower values reduce
	  latency at the cost of CPU load.

module = NET_WEBRTC
module-dep = NET_LOG
module-str = Log level for WebRTC
module-help = Enable debug messages from the WebRTC library.
source "subsys/net/Kconfig.template.log_config.net"

endif # WEBRTC
```

## subsys/portability/freertos/Kconfig
```kconfig
# Copyright (c) 2025 The Zephyr Project Contributors
# SPDX-License-Identifier: Apache-2.0

config FREERTOS_COMPAT
	bool "FreeRTOS Compatibility API"
	depends on THREAD_NAME
	depends on NUM_PREEMPT_PRIORITIES >= 7
	help
	  This enables a FreeRTOS compatibility layer which allows
	  applications using FreeRTOS APIs to build on Zephyr.

if FREERTOS_COMPAT

config FREERTOS_MAX_PRIORITIES
	int "Maximum number of FreeRTOS priority levels"
	default 7
	help
	  Maps to configMAX_PRIORITIES in FreeRTOS. Must not exceed
	  NUM_PREEMPT_PRIORITIES.

config FREERTOS_TASK_MAX_COUNT
	int "Maximum dynamically-created task count"
	default 10
	range 0 255
	help
	  Maximum number of tasks that can be created dynamically
	  with xTaskCreate.

config FREERTOS_TASK_DEFAULT_STACK_SIZE
	int "Default task stack size in bytes"
	default 1024
	help
	  Default stack size allocated for dynamically-created tasks.

config FREERTOS_TIMER_MAX_COUNT
	int "Maximum dynamically-created timer count"
	default 5
	range 0 255
	help
	  Maximum number of software timers that can be created.

config FREERTOS_SEMAPHORE_MAX_COUNT
	int "Maximum dynamically-created semaphore count"
	default 10
	range 0 255
	help
	  Maximum number of binary and counting semaphores that can
	  be created dynamically.

config FREERTOS_MUTEX_MAX_COUNT
	int "Maximum dynamically-created mutex count"
	default 5
	range 0 255
	help
	  Maximum number of mutexes that can be created dynamically.

config FREERTOS_QUEUE_MAX_COUNT
	int "Maximum dynamically-created queue count"
	default 5
	range 0 255
	help
	  Maximum number of message queues that can be created dynamically.

endif # FREERTOS_COMPAT
```

## tests/benchmarks/net/loopback/testcase.yaml
```yaml
common:
  tags:
    - net
    - benchmark
  # The benchmark measures host wall-clock time via the native simulator
  # real time clock, so it can only run on native_sim.
  platform_allow:
    - native_sim
    - native_sim/native/64
  timeout: 600
  harness: console
  harness_config:
    type: one_line
    regex:
      - "BENCH DONE"

tests:
  benchmark.net.loopback: {}
```

## tests/benchmarks/sched/testcase.yaml
```yaml
tests:
  benchmark.kernel.scheduler:
    platform_key:
      - arch
    tags:
      - benchmark
      - kernel
    integration_platforms:
      - mps2/an385
      - qemu_x86
      - qemu_riscv64/qemu_virt_riscv64/smp
    slow: true
    harness: console
    harness_config:
      type: one_line
      record:
        regex:
          - "S,(?P<suite>[^,]+),(?P<benchmark>[^,]+),(?P<samples>[^,]+),(?P<total_cycles>[^,]+),(?P<mean>[^,]+),(?P<stddev>[^,]+),(?P<stderr>[^,]+),(?P<min>[^,]+),(?P<min_sample>[^,]+),(?P<max>[^,]+),(?P<max_sample>[^,]+)"
      regex:
        - "PROJECT EXECUTION SUCCESSFUL"
```

## tests/benchmarks/sched_userspace/testcase.yaml
```yaml
tests:
  benchmark.kernel.scheduler_userspace:
    arch_allow: arm64
    tags:
      - kernel
      - benchmark
      - userspace
    filter: CONFIG_ARCH_HAS_USERSPACE
    slow: true
    arch_exclude:
      - posix
    timeout: 300
    harness: console
    harness_config:
      type: one_line
      record:
        regex:
          - "S,(?P<suite>[^,]+),(?P<benchmark>[^,]+),(?P<samples>[^,]+),(?P<total_cycles>[^,]+),(?P<mean>[^,]+),(?P<stddev>[^,]+),(?P<stderr>[^,]+),(?P<min>[^,]+),(?P<min_sample>[^,]+),(?P<max>[^,]+),(?P<max_sample>[^,]+)"
      regex:
        - "PROJECT EXECUTION SUCCESSFUL"
```
