/ {
	aliases {
		accel0 = &mpu6050_i2c;
	};

        // chosen {
        //         zephyr,display = &ili9341;
        // };
};

&i2c0 {
	mpu6050_i2c: mpu6050@68 {
		compatible = "invensense,mpu6050";
		reg = <0x68>;
	};
};


// &spi3 {
//         status = "okay";
// 	ili9341: ili9341@0 {
// 		compatible = "ilitek,ili9341";
// 		spi-max-frequency = <25000000>;
// 		reg = <0>;
// 		cmd-data-gpios = <&gpio0 2 GPIO_ACTIVE_LOW>;
// 		pixel-format = <0>;
// 		rotation = <270>;
// 		width = <320>;
// 		height = <240>;
// 	};
// };

