## CMakeLists.txt
```
# SPDX-FileCopyrightText: Copyright The Zephyr Project Contributors
# SPDX-License-Identifier: Apache-2.0

cmake_minimum_required(VERSION 3.20.0)

# Glue building ESP-DL from an ESP-DL source tree
list(APPEND ZEPHYR_EXTRA_MODULES ${CMAKE_CURRENT_SOURCE_DIR}/modules/esp-dl)

find_package(Zephyr REQUIRED HINTS $ENV{ZEPHYR_BASE})
project(mpipe_espdet)

target_sources(app PRIVATE
  src/main.c
  src/espdet_overlay.c
  src/overlay.c
  src/detector.cpp
)
target_link_libraries(app PRIVATE esp_dl_interface)

# The model, an .espdl file exported by ESP-Detection or taken from the ESP-DL
# model zoo, is embedded in the application.
if(NOT DEFINED ESPDET_MODEL OR NOT EXISTS ${ESPDET_MODEL})
  message(FATAL_ERROR "No model to embed: pass -DESPDET_MODEL=<path to an .espdl file>")
endif()
message(STATUS "ESPDet model: ${ESPDET_MODEL}")

set(gen_dir ${ZEPHYR_BINARY_DIR}/include/generated)
generate_inc_file_for_target(app ${ESPDET_MODEL} ${gen_dir}/espdet_model.inc)
```

## Kconfig
```
# SPDX-FileCopyrightText: Copyright The Zephyr Project Contributors
# SPDX-License-Identifier: Apache-2.0

mainmenu "ESPDet-Pico object detection pipeline sample"

menu "Camera"

config VIDEO_FRAME_WIDTH
	int "Width of the camera frame"
	default 320

config VIDEO_FRAME_HEIGHT
	int "Height of the camera frame"
	default 240

config VIDEO_PIXEL_FORMAT
	string "Pixel format of the camera frame"
	default "RGBR"
	help
	  Four-character code of the camera pixel format: "RGBR" for RGB565X
	  (big-endian) or "RGBP" for RGB565.

config VIDEO_CTRL_HFLIP
	bool "Mirror the camera frame horizontally"

config VIDEO_CTRL_VFLIP
	bool "Mirror the camera frame vertically"

endmenu

menu "Object detection"

config ESPDET_CLASS_LABELS
	string "Class labels"
	default "person,phone"
	help
	  Comma-separated labels of the classes of the model, in the order of
	  its training dataset. Up to 8 classes are named.

config ESPDET_SCORE_THRESHOLD
	int "Detection score threshold, in percent"
	range 1 99
	default 50

config ESPDET_NMS_THRESHOLD
	int "Non-maximum suppression IoU threshold, in percent"
	range 1 99
	default 70

config ESPDET_TOP_K
	int "Maximum number of candidates kept before non-maximum suppression"
	default 10

config ESPDET_MAX_BOXES
	int "Maximum number of detections drawn"
	default 10

config ESPDET_MAX_INTERNAL_SIZE
	int "Internal SRAM the model may use for its activations, in bytes"
	default 98304
	help
	  ESP-DL keeps as many activation buffers as fit in this budget in
	  internal SRAM and the rest in PSRAM. It must fit in
	  ESP_DL_INTERNAL_HEAP_SIZE.

config ESPDET_THREAD_STACK_SIZE
	int "Stack size of the detection thread"
	default 4096

config ESPDET_THREAD_PRIORITY
	int "Priority of the detection thread"
	default 10
	help
	  Keep it lower (numerically higher) than the pipeline thread so that
	  the video keeps flowing while a frame is being analyzed.

config ESPDET_LOG_DETECTIONS
	bool "Log every detection"

endmenu

source "Kconfig.zephyr"
```

## prj.conf
```kconfig
CONFIG_LOG=y

CONFIG_MPIPE=y
CONFIG_MPIPE_STRUCTURE_MAX_FIELDS=4
CONFIG_MPIPE_BASE=y
CONFIG_MPIPE_BASE_CAPS_FILTER=y
CONFIG_MPIPE_VID=y
CONFIG_MPIPE_DISP=y
CONFIG_MPIPE_PLAYER=y

# The bus carries end-of-stream and errors, never data
CONFIG_ZBUS_PRIORITY_BOOST=n
CONFIG_ZBUS_LOG_LEVEL_ERR=y

CONFIG_CPP=y
CONFIG_STD_CPP20=y
# ESP-DL computes in floating point: keep the FPU registers of each thread
CONFIG_FPU=y
CONFIG_FPU_SHARING=y
CONFIG_ESP_DL=y
CONFIG_ESP_SPIRAM=y
# ESP-DL heap, video buffers and the frame copy the detector works on
CONFIG_ESP_SPIRAM_HEAP_SIZE=4194304

# Three 320x240 RGB565 camera frames and the copy the detector works on, in PSRAM
CONFIG_VIDEO_BUFFER_POOL_NUM_MAX=4
CONFIG_VIDEO_BUFFER_POOL_HEAP_SIZE=614400
CONFIG_VIDEO_BUFFER_POOL_ALIGN=32
CONFIG_VIDEO_BUFFER_USE_SHARED_MULTI_HEAP=y
CONFIG_VIDEO_BUFFER_SMH_ATTRIBUTE=2
CONFIG_DMA_ESP32_MAX_DESCRIPTOR_NUM=64

CONFIG_MAIN_STACK_SIZE=4096
```

## src/main.c
```c
/*
 * SPDX-FileCopyrightText: Copyright The Zephyr Project Contributors
 * SPDX-License-Identifier: Apache-2.0
 */

#include <zephyr/drivers/video.h>
#include <zephyr/logging/log.h>
#include <zephyr/mpipe/mpipe.h>
#include <zephyr/mpipe/base/mpipe_caps_filter.h>
#include <zephyr/mpipe/disp/mpipe_disp_sink.h>
#include <zephyr/mpipe/utils/mpipe_player.h>
#include <zephyr/mpipe/vid/mpipe_vid_src.h>
#include <zephyr/sys/util_macro.h>
#include <zephyr/video/controls.h>

#include "espdet_overlay.h"

LOG_MODULE_REGISTER(main, CONFIG_LOG_DEFAULT_LEVEL);

enum {
	PIPE_ID,
	VID_SRC_ID,
	CAPS_FILTER_ID,
	ESPDET_ID,
	DISP_SINK_ID,
};

static struct mpipe pipe;
static struct mpipe_vid_src vid_src;
static struct mpipe_caps_filter caps_filter;
static struct espdet_overlay espdet;
static struct mpipe_disp_sink disp_sink;
static struct mpipe_player player;

int main(void)
{
	struct mpipe_structure caps;
	int ret;

	ret = mpipe_pipeline_init(&pipe, PIPE_ID);
	if (ret == 0) {
		ret = mpipe_vid_src_init(&vid_src, VID_SRC_ID);
	}
	if (ret == 0) {
		ret = mpipe_caps_filter_init(&caps_filter, CAPS_FILTER_ID);
	}
	if (ret == 0) {
		ret = espdet_overlay_init(&espdet, ESPDET_ID);
	}
	if (ret == 0) {
		ret = mpipe_disp_sink_init(&disp_sink, DISP_SINK_ID);
	}
	if (ret != 0) {
		LOG_ERR("Failed to initialize the elements (%d)", ret);
		return 0;
	}

	/* clang-format off */
	ret = mpipe_object_set_properties((struct mpipe_object *)&vid_src,
		IF_ENABLED(CONFIG_VIDEO_CTRL_HFLIP, (VIDEO_CID_HFLIP, 1,))
		IF_ENABLED(CONFIG_VIDEO_CTRL_VFLIP, (VIDEO_CID_VFLIP, 1,))
		MPIPE_PROP_LIST_END);
	/* clang-format on */
	if (ret != 0) {
		LOG_ERR("Cannot set the camera flip controls (%d)", ret);
		return 0;
	}

	/* The camera frame the detector and the display both work on */
	ret = mpipe_structure_init_fields(
		&caps, MPIPE_MEDIA_VIDEO, MPIPE_CAPS_PIXEL_FORMAT, MPIPE_TYPE_UINT,
		VIDEO_FOURCC_FROM_STR(CONFIG_VIDEO_PIXEL_FORMAT), MPIPE_CAPS_IMAGE_WIDTH,
		MPIPE_TYPE_UINT, CONFIG_VIDEO_FRAME_WIDTH, MPIPE_CAPS_IMAGE_HEIGHT, MPIPE_TYPE_UINT,
		CONFIG_VIDEO_FRAME_HEIGHT, MPIPE_CAPS_END);
	if (ret == 0) {
		ret = mpipe_object_set_properties((struct mpipe_object *)&caps_filter,
						  MPIPE_PROP_BASE_CAPS_FILTER_CAPS, &caps,
						  MPIPE_PROP_LIST_END);
	}
	if (ret != 0) {
		LOG_ERR("Failed to set the frame format (%d)", ret);
		return 0;
	}

	ret = mpipe_bin_add((struct mpipe_bin *)&pipe, (struct mpipe_element *)&vid_src,
			    (struct mpipe_element *)&caps_filter, (struct mpipe_element *)&espdet,
			    (struct mpipe_element *)&disp_sink, NULL);
	if (ret != 0) {
		LOG_ERR("Failed to add the elements (%d)", ret);
		return 0;
	}

	ret = mpipe_element_link(
		(struct mpipe_element *)&vid_src, (struct mpipe_element *)&caps_filter,
		(struct mpipe_element *)&espdet, (struct mpipe_element *)&disp_sink, NULL);
	if (ret != 0) {
		LOG_ERR("Failed to link the elements (%d)", ret);
		return 0;
	}

	ret = mpipe_player_init(&player, &pipe);
	if (ret != 0) {
		LOG_ERR("Failed to initialize the player (%d)", ret);
		return 0;
	}

	LOG_INF("camera -> espdet overlay -> display");

	(void)mpipe_player_play(&player);
	(void)mpipe_player_wait_quit(&player);
	(void)mpipe_player_deinit(&player);

	return 0;
}
```

## src/detector.cpp
```c
/*
 * SPDX-FileCopyrightText: Copyright The Zephyr Project Contributors
 * SPDX-License-Identifier: Apache-2.0
 */

/* ESPDet-Pico inference with ESP-DL */

#include <errno.h>

#include <zephyr/kernel.h>
#include <zephyr/logging/log.h>

#include "dl_model_base.hpp"
#include "dl_image_preprocessor.hpp"
#include "dl_detect_espdet_postprocessor.hpp"

#include "detector.h"

LOG_MODULE_REGISTER(detector, CONFIG_LOG_DEFAULT_LEVEL);

/* ESP-DL reads the parameters in place, 16-byte aligned, then copies them to PSRAM */
static const uint8_t espdet_model[] __aligned(16) = {
#include "espdet_model.inc"
};

static dl::Model *model;
static dl::image::ImagePreprocessor *preprocessor;
static dl::detect::ESPDetPostProcessor *postprocessor;

/* The three output stages of ESPDet-Pico, of stride 8, 16 and 32 */
static const std::vector<dl::detect::anchor_point_stage_t> stages = {
	{8, 8, 4, 4},
	{16, 16, 8, 8},
	{32, 32, 16, 16},
};

extern "C" int detector_init(void)
{
	const float score_thr = CONFIG_ESPDET_SCORE_THRESHOLD / 100.0f;
	const float nms_thr = CONFIG_ESPDET_NMS_THRESHOLD / 100.0f;

	model = new dl::Model(reinterpret_cast<const char *>(espdet_model),
			      fbs::MODEL_LOCATION_IN_FLASH_RODATA, CONFIG_ESPDET_MAX_INTERNAL_SIZE);
	if (model == nullptr || model->get_inputs().empty()) {
		LOG_ERR("Cannot load the model");
		return -ENOMEM;
	}

	model->minimize();

	/* Pixels normalized to [0, 1], letterboxed with the gray of the training */
	preprocessor = new dl::image::ImagePreprocessor(model, {0, 0, 0}, {255, 255, 255});
	preprocessor->enable_letterbox({114, 114, 114});
	postprocessor = new dl::detect::ESPDetPostProcessor(model, preprocessor, score_thr, nms_thr,
							    CONFIG_ESPDET_TOP_K, stages);

	auto *input = preprocessor->get_model_input();

	LOG_INF("Model loaded, input %dx%d", input->shape[2], input->shape[1]);

	return 0;
}

extern "C" int detector_run(const void *frame, uint16_t width, uint16_t height, bool big_endian,
			    struct detector_box *boxes, size_t max_boxes)
{
	dl::image::img_t img = {
		.data = const_cast<void *>(frame),
		.width = width,
		.height = height,
		.pix_type = big_endian ? dl::image::DL_IMAGE_PIX_TYPE_RGB565BE
				       : dl::image::DL_IMAGE_PIX_TYPE_RGB565LE,
	};
	size_t count = 0;

	if (postprocessor == nullptr) {
		return -EINVAL;
	}

	preprocessor->preprocess(img);
	model->run();
	postprocessor->clear_result();
	postprocessor->postprocess();

	for (const auto &res : postprocessor->get_result(width, height)) {
		if (count == max_boxes) {
			break;
		}

		boxes[count].x0 = res.box[0];
		boxes[count].y0 = res.box[1];
		boxes[count].x1 = res.box[2];
		boxes[count].y1 = res.box[3];
		boxes[count].category = res.category;
		boxes[count].score = (uint8_t)(res.score * 100.0f);
		count++;
	}

	return count;
}
```

## src/detector.h
```c
/*
 * SPDX-FileCopyrightText: Copyright The Zephyr Project Contributors
 * SPDX-License-Identifier: Apache-2.0
 */

#ifndef DETECTOR_H_
#define DETECTOR_H_

#include <stddef.h>
#include <stdint.h>

#ifdef __cplusplus
extern "C" {
#endif

/** One detected object, in the coordinates of the analyzed frame */
struct detector_box {
	int16_t x0;
	int16_t y0;
	int16_t x1;
	int16_t y1;
	/** Index of the class in the model's label list */
	uint8_t category;
	/** Confidence, in percent */
	uint8_t score;
};

/**
 * @brief Load the embedded model and set up pre- and post-processing.
 *
 * @retval 0 Success
 * @retval -ENOMEM The model could not be loaded
 */
int detector_init(void);

/**
 * @brief Detect objects in an RGB565 frame.
 *
 * The frame is letterboxed and resized to the model input, and the boxes are
 * mapped back to the frame coordinates.
 *
 * @param frame RGB565 pixels, @p width x @p height, no padding between lines
 * @param width Frame width in pixels
 * @param height Frame height in pixels
 * @param big_endian True for RGB565X (big-endian) pixels
 * @param boxes Array receiving the detections, best score first
 * @param max_boxes Capacity of @p boxes
 *
 * @return The number of detections written to @p boxes, or -EINVAL if
 *	   detector_init() did not succeed.
 */
int detector_run(const void *frame, uint16_t width, uint16_t height, bool big_endian,
		 struct detector_box *boxes, size_t max_boxes);

#ifdef __cplusplus
}
#endif

#endif /* DETECTOR_H_ */
```

## src/espdet_overlay.c
```c
/*
 * SPDX-FileCopyrightText: Copyright The Zephyr Project Contributors
 * SPDX-License-Identifier: Apache-2.0
 */

#include <stdio.h>
#include <string.h>

#include <zephyr/cache.h>
#include <zephyr/drivers/video.h>
#include <zephyr/logging/log.h>
#include <zephyr/mpipe/mpipe_dispatch.h>
#include <zephyr/mpipe/mpipe_pad.h>
#include <zephyr/mpipe/mpipe_structure.h>
#include <zephyr/mpipe/mpipe_value.h>

#include "espdet_overlay.h"
#include "overlay.h"

LOG_MODULE_REGISTER(espdet_overlay, CONFIG_LOG_DEFAULT_LEVEL);

#define FRAME_SIZE_MIN 16
#define FRAME_SIZE_MAX 1280

#define LABEL_SCALE   2
#define LABEL_PAD     2
#define LABEL_HEIGHT  (OVERLAY_FONT_HEIGHT * LABEL_SCALE + 2 * LABEL_PAD)
#define BOX_THICKNESS 2
#define MAX_CLASSES   8
#define MAX_LABEL_LEN 16

#define COLOR_BLACK OVERLAY_RGB(0, 0, 0)
#define COLOR_WHITE OVERLAY_RGB(255, 255, 255)

static const uint16_t class_colors[MAX_CLASSES] = {
	OVERLAY_RGB(0, 230, 118),  OVERLAY_RGB(255, 145, 0),  OVERLAY_RGB(41, 182, 246),
	OVERLAY_RGB(255, 64, 129), OVERLAY_RGB(255, 235, 59), OVERLAY_RGB(179, 136, 255),
	OVERLAY_RGB(0, 229, 255),  OVERLAY_RGB(255, 82, 82),
};

static char class_labels[MAX_CLASSES][MAX_LABEL_LEN];
static size_t class_count;

K_THREAD_STACK_DEFINE(espdet_stack, CONFIG_ESPDET_THREAD_STACK_SIZE);
static struct k_thread espdet_thread;

/* Split the comma-separated class list of the model */
static void parse_class_labels(void)
{
	const char *p = CONFIG_ESPDET_CLASS_LABELS;

	while (*p != '\0' && class_count < MAX_CLASSES) {
		const char *end = strchr(p, ',');
		size_t len = (end != NULL) ? (size_t)(end - p) : strlen(p);

		snprintf(class_labels[class_count], MAX_LABEL_LEN, "%.*s", (int)len, p);
		class_count++;

		if (end == NULL) {
			break;
		}
		p = end + 1;
	}
}

static void espdet_thread_fn(void *p1, void *p2, void *p3)
{
	struct espdet_overlay *self = p1;
	struct detector_box boxes[CONFIG_ESPDET_MAX_BOXES];
	int64_t start;
	int ret;

	ARG_UNUSED(p2);
	ARG_UNUSED(p3);

	self->init_err = detector_init();
	if (self->init_err != 0) {
		/* Leave busy set: no frame is ever handed over */
		return;
	}

	atomic_clear(&self->busy);

	while (true) {
		k_sem_take(&self->frame_ready, K_FOREVER);

		start = k_uptime_get();
		ret = detector_run(self->snapshot->buffer, self->width, self->height,
				   self->big_endian, boxes, ARRAY_SIZE(boxes));

		k_mutex_lock(&self->lock, K_FOREVER);
		self->box_count = MAX(ret, 0);
		memcpy(self->boxes, boxes, self->box_count * sizeof(boxes[0]));
		self->infer_ms = (uint32_t)(k_uptime_get() - start);
		self->infer_count++;
		k_mutex_unlock(&self->lock);

		if (IS_ENABLED(CONFIG_ESPDET_LOG_DETECTIONS)) {
			for (int i = 0; i < ret; i++) {
				LOG_INF("%s %u%% (%d,%d)-(%d,%d)",
					boxes[i].category < class_count
						? class_labels[boxes[i].category]
						: "?",
					boxes[i].score, boxes[i].x0, boxes[i].y0, boxes[i].x1,
					boxes[i].y1);
			}
		}

		atomic_clear(&self->busy);
	}
}

static void draw_detection(const struct overlay_frame *frame, const struct detector_box *box)
{
	uint16_t color = class_colors[box->category % MAX_CLASSES];
	char label[MAX_LABEL_LEN + 8];
	int label_y;
	int label_w;

	snprintf(label, sizeof(label), "%s %u%%",
		 box->category < class_count ? class_labels[box->category] : "?", box->score);
	label_w = overlay_text_width(label, LABEL_SCALE) + 2 * LABEL_PAD;

	overlay_rect(frame, box->x0, box->y0, box->x1, box->y1, BOX_THICKNESS, color);

	/* Label above the box, or inside it when the box touches the top of the frame */
	label_y = (box->y0 >= LABEL_HEIGHT) ? box->y0 - LABEL_HEIGHT : box->y0;
	overlay_fill(frame, box->x0, label_y, box->x0 + label_w - 1, label_y + LABEL_HEIGHT - 1,
		     color);
	overlay_text(frame, box->x0 + LABEL_PAD, label_y + LABEL_PAD, label, LABEL_SCALE,
		     COLOR_BLACK);
}

static void draw_status(struct espdet_overlay *self, const struct overlay_frame *frame,
			uint32_t infer_ms)
{
	char status[64];
	int y = frame->height - OVERLAY_FONT_HEIGHT - 2 * LABEL_PAD;

	if (self->init_err != 0) {
		snprintf(status, sizeof(status), "model load failed (%d)", self->init_err);
	} else if (infer_ms == 0U) {
		snprintf(status, sizeof(status), "loading model...");
	} else {
		snprintf(status, sizeof(status), "ESPDet-Pico %u ms | video %u.%u fps", infer_ms,
			 self->fps_x10 / 10U, self->fps_x10 % 10U);
	}

	overlay_fill(frame, 0, y, overlay_text_width(status, 1) + 2 * LABEL_PAD - 1,
		     frame->height - 1, COLOR_BLACK);
	overlay_text(frame, LABEL_PAD, y + LABEL_PAD, status, 1, COLOR_WHITE);
}

static void update_fps(struct espdet_overlay *self)
{
	int64_t now = k_uptime_get();

	self->frame_count++;
	if (now - self->fps_start >= MSEC_PER_SEC) {
		self->fps_x10 = (uint32_t)(self->frame_count * 10000U / (now - self->fps_start));
		self->frame_count = 0;
		self->fps_start = now;
	}
}

static int espdet_overlay_chain(struct mpipe_pad *pad, struct net_buf *buf,
				struct net_buf **out_buf)
{
	struct espdet_overlay *self = (struct espdet_overlay *)pad->object.container;
	size_t frame_size = self->pitch * self->height;
	struct detector_box boxes[CONFIG_ESPDET_MAX_BOXES];
	struct overlay_frame frame;
	uint32_t infer_ms;
	size_t count;

	/* Drawing happens in place: the same buffer goes downstream */
	*out_buf = buf;

	if (buf == NULL) {
		return 0;
	}

	/* Only whole frames in one piece can be analyzed and drawn on */
	if (buf->frags != NULL || mpipe_buffer_get_meta(buf)->bytes_used < frame_size ||
	    self->snapshot == NULL) {
		return 0;
	}

	/* The camera wrote the frame by DMA: drop what the cache holds of the last one */
	(void)sys_cache_data_invd_range(buf->data, frame_size);

	/* Hand the frame over only when the detector is idle, and before drawing on it */
	if (atomic_cas(&self->busy, 0, 1)) {
		memcpy(self->snapshot->buffer, buf->data, frame_size);
		k_sem_give(&self->frame_ready);
	}

	update_fps(self);

	k_mutex_lock(&self->lock, K_FOREVER);
	count = self->box_count;
	memcpy(boxes, self->boxes, count * sizeof(boxes[0]));
	infer_ms = self->infer_ms;
	k_mutex_unlock(&self->lock);

	frame = (struct overlay_frame){
		.buf = buf->data,
		.width = self->width,
		.height = self->height,
		.pitch = self->pitch,
		.big_endian = self->big_endian,
	};

	for (size_t i = 0; i < count; i++) {
		draw_detection(&frame, &boxes[i]);
	}

	draw_status(self, &frame, infer_ms);

	return 0;
}

/* RGB565 in either byte order, which is what the detector and the overlay handle */
static int espdet_overlay_enum_caps(struct mpipe_pad *pad, uint32_t index,
				    const struct mpipe_structure *filter,
				    struct mpipe_structure *out)
{
	static const uint32_t formats[] = {VIDEO_PIX_FMT_RGB565X, VIDEO_PIX_FMT_RGB565};
	struct mpipe_structure candidate;
	int ret;

	ARG_UNUSED(pad);

	if (index >= ARRAY_SIZE(formats)) {
		return -ENOENT;
	}

	ret = mpipe_structure_init_fields(&candidate, MPIPE_MEDIA_VIDEO, MPIPE_CAPS_PIXEL_FORMAT,
					  MPIPE_TYPE_UINT, formats[index], MPIPE_CAPS_IMAGE_WIDTH,
					  MPIPE_TYPE_UINT_RANGE, FRAME_SIZE_MIN, FRAME_SIZE_MAX, 1,
					  MPIPE_CAPS_IMAGE_HEIGHT, MPIPE_TYPE_UINT_RANGE,
					  FRAME_SIZE_MIN, FRAME_SIZE_MAX, 1, MPIPE_CAPS_END);
	if (ret != 0) {
		return ret;
	}

	return mpipe_pad_enum_filter(&candidate, filter, out);
}

static int espdet_overlay_set_caps(struct mpipe_transform *transform,
				   enum mpipe_pad_direction direction,
				   const struct mpipe_structure *caps)
{
	struct espdet_overlay *self = (struct espdet_overlay *)transform;
	const struct mpipe_value *fmt = mpipe_structure_get_value(caps, MPIPE_CAPS_PIXEL_FORMAT);
	const struct mpipe_value *width = mpipe_structure_get_value(caps, MPIPE_CAPS_IMAGE_WIDTH);
	const struct mpipe_value *height = mpipe_structure_get_value(caps, MPIPE_CAPS_IMAGE_HEIGHT);
	size_t frame_size;

	if (direction != MPIPE_PAD_SINK) {
		return mpipe_transform_set_caps(transform, direction, caps);
	}

	if (fmt == NULL || width == NULL || height == NULL) {
		return -EINVAL;
	}

	self->width = mpipe_value_get_uint(width);
	self->height = mpipe_value_get_uint(height);
	self->pitch = self->width * 2U;
	self->big_endian = mpipe_value_get_uint(fmt) == VIDEO_PIX_FMT_RGB565X;
	frame_size = self->pitch * self->height;

	/* The frame copy only ever grows, and not while the detector reads it */
	if (self->snapshot == NULL || frame_size > self->snapshot->size) {
		if (self->snapshot != NULL) {
			if (!atomic_cas(&self->busy, 0, 1)) {
				return -EBUSY;
			}
			(void)video_buffer_release(self->snapshot);
			self->snapshot = NULL;
			atomic_clear(&self->busy);
		}

		self->snapshot = video_buffer_aligned_alloc(
			frame_size, CONFIG_VIDEO_BUFFER_POOL_ALIGN, K_NO_WAIT);
		if (self->snapshot == NULL) {
			LOG_ERR("Cannot allocate a %zu-byte frame copy", frame_size);
			return -ENOMEM;
		}
	}

	LOG_INF("Detecting on %ux%u %s frames", self->width, self->height,
		self->big_endian ? "RGB565X" : "RGB565");

	return mpipe_transform_set_caps(transform, direction, caps);
}

/* Drawing in place changes nothing to the buffers: pass the pool negotiation through */
static int espdet_overlay_decide_buffer_pool(struct mpipe_transform *transform,
					     struct mpipe_dispatch *query)
{
	struct espdet_overlay *self = (struct espdet_overlay *)transform;

	self->down_pool = query->pool;
	self->down_pool_cfg = query->pool_cfg;

	return 0;
}

static int espdet_overlay_propose_buffer_pool(struct mpipe_transform *transform,
					      struct mpipe_dispatch *query)
{
	struct espdet_overlay *self = (struct espdet_overlay *)transform;

	query->pool = self->down_pool;
	query->pool_cfg = self->down_pool_cfg;

	return 0;
}

int espdet_overlay_init(struct espdet_overlay *self, uint8_t id)
{
	struct mpipe_transform *transform = &self->transform;
	int ret;

	ret = mpipe_transform_init(transform, id);
	if (ret != 0) {
		return ret;
	}

	mpipe_element_set_name(&transform->element, "espdet_overlay");

	transform->mode = MPIPE_MODE_INPLACE;
	transform->set_caps = espdet_overlay_set_caps;
	transform->decide_buffer_pool = espdet_overlay_decide_buffer_pool;
	transform->propose_buffer_pool = espdet_overlay_propose_buffer_pool;
	transform->sink_pad.chain_fn = espdet_overlay_chain;
	transform->sink_pad.enum_caps_fn = espdet_overlay_enum_caps;
	transform->src_pad.enum_caps_fn = espdet_overlay_enum_caps;

	k_sem_init(&self->frame_ready, 0, 1);
	k_mutex_init(&self->lock);
	atomic_set(&self->busy, 1);
	self->fps_start = k_uptime_get();

	parse_class_labels();

	k_thread_create(&espdet_thread, espdet_stack, K_THREAD_STACK_SIZEOF(espdet_stack),
			espdet_thread_fn, self, NULL, NULL, CONFIG_ESPDET_THREAD_PRIORITY, 0,
			K_NO_WAIT);
	k_thread_name_set(&espdet_thread, "espdet");

	return 0;
}
```

## src/espdet_overlay.h
```c
/*
 * SPDX-FileCopyrightText: Copyright The Zephyr Project Contributors
 * SPDX-License-Identifier: Apache-2.0
 */

#ifndef ESPDET_OVERLAY_H_
#define ESPDET_OVERLAY_H_

#include <zephyr/kernel.h>
#include <zephyr/video/video.h>
#include <zephyr/mpipe/mpipe_buffer.h>
#include <zephyr/mpipe/mpipe_transform.h>

#include "detector.h"

/**
 * In-place transform that hands frames to an object detector running on its
 * own thread and draws the latest detections on every frame going through.
 *
 * The stream never waits for the detector: a frame is copied for detection
 * only when the previous detection is done, so the video runs at the camera
 * rate while the boxes refresh at the detector rate.
 */
struct espdet_overlay {
	/** Base transform, must be first */
	struct mpipe_transform transform;

	/* Negotiated frame layout */
	uint16_t width;
	uint16_t height;
	uint32_t pitch;
	bool big_endian;

	/* Downstream buffer pool proposal, handed over to upstream */
	struct mpipe_buffer_pool *down_pool;
	struct mpipe_buffer_pool_config down_pool_cfg;

	/* Copy of the frame being analyzed, a buffer of the video buffer pool */
	struct video_buffer *snapshot;
	atomic_t busy;
	struct k_sem frame_ready;

	/* Latest detections */
	struct k_mutex lock;
	struct detector_box boxes[CONFIG_ESPDET_MAX_BOXES];
	size_t box_count;
	uint32_t infer_ms;
	uint32_t infer_count;
	int init_err;

	/* Frame rate of the video stream */
	uint32_t frame_count;
	int64_t fps_start;
	uint32_t fps_x10;
};

int espdet_overlay_init(struct espdet_overlay *self, uint8_t id);

#endif /* ESPDET_OVERLAY_H_ */
```

## src/overlay.c
```c
/*
 * SPDX-FileCopyrightText: Copyright The Zephyr Project Contributors
 * SPDX-License-Identifier: Apache-2.0
 */

/* Boxes and text drawn straight into RGB565 frames */

#include <string.h>

#include <zephyr/sys/byteorder.h>
#include <zephyr/sys/util.h>

#include "overlay.h"

#define FONT_FIRST_CHAR 0x20
#define FONT_LAST_CHAR  0x7e
#define FONT_WIDTH      5
#define FONT_SPACING    1

/* 5x7 font, one byte per column, least significant bit at the top */
static const uint8_t font5x7[][FONT_WIDTH] = {
	{0x00, 0x00, 0x00, 0x00, 0x00}, /*   */
	{0x00, 0x00, 0x5f, 0x00, 0x00}, /* ! */
	{0x00, 0x07, 0x00, 0x07, 0x00}, /* " */
	{0x14, 0x7f, 0x14, 0x7f, 0x14}, /* # */
	{0x24, 0x2a, 0x7f, 0x2a, 0x12}, /* $ */
	{0x23, 0x13, 0x08, 0x64, 0x62}, /* % */
	{0x36, 0x49, 0x55, 0x22, 0x50}, /* & */
	{0x00, 0x05, 0x03, 0x00, 0x00}, /* ' */
	{0x00, 0x1c, 0x22, 0x41, 0x00}, /* ( */
	{0x00, 0x41, 0x22, 0x1c, 0x00}, /* ) */
	{0x08, 0x2a, 0x1c, 0x2a, 0x08}, /* * */
	{0x08, 0x08, 0x3e, 0x08, 0x08}, /* + */
	{0x00, 0x50, 0x30, 0x00, 0x00}, /* , */
	{0x08, 0x08, 0x08, 0x08, 0x08}, /* - */
	{0x00, 0x60, 0x60, 0x00, 0x00}, /* . */
	{0x20, 0x10, 0x08, 0x04, 0x02}, /* / */
	{0x3e, 0x51, 0x49, 0x45, 0x3e}, /* 0 */
	{0x00, 0x42, 0x7f, 0x40, 0x00}, /* 1 */
	{0x42, 0x61, 0x51, 0x49, 0x46}, /* 2 */
	{0x21, 0x41, 0x45, 0x4b, 0x31}, /* 3 */
	{0x18, 0x14, 0x12, 0x7f, 0x10}, /* 4 */
	{0x27, 0x45, 0x45, 0x45, 0x39}, /* 5 */
	{0x3c, 0x4a, 0x49, 0x49, 0x30}, /* 6 */
	{0x01, 0x71, 0x09, 0x05, 0x03}, /* 7 */
	{0x36, 0x49, 0x49, 0x49, 0x36}, /* 8 */
	{0x06, 0x49, 0x49, 0x29, 0x1e}, /* 9 */
	{0x00, 0x36, 0x36, 0x00, 0x00}, /* : */
	{0x00, 0x56, 0x36, 0x00, 0x00}, /* ; */
	{0x08, 0x14, 0x22, 0x41, 0x00}, /* < */
	{0x14, 0x14, 0x14, 0x14, 0x14}, /* = */
	{0x00, 0x41, 0x22, 0x14, 0x08}, /* > */
	{0x02, 0x01, 0x51, 0x09, 0x06}, /* ? */
	{0x32, 0x49, 0x79, 0x41, 0x3e}, /* @ */
	{0x7e, 0x11, 0x11, 0x11, 0x7e}, /* A */
	{0x7f, 0x49, 0x49, 0x49, 0x36}, /* B */
	{0x3e, 0x41, 0x41, 0x41, 0x22}, /* C */
	{0x7f, 0x41, 0x41, 0x22, 0x1c}, /* D */
	{0x7f, 0x49, 0x49, 0x49, 0x41}, /* E */
	{0x7f, 0x09, 0x09, 0x09, 0x01}, /* F */
	{0x3e, 0x41, 0x49, 0x49, 0x7a}, /* G */
	{0x7f, 0x08, 0x08, 0x08, 0x7f}, /* H */
	{0x00, 0x41, 0x7f, 0x41, 0x00}, /* I */
	{0x20, 0x40, 0x41, 0x3f, 0x01}, /* J */
	{0x7f, 0x08, 0x14, 0x22, 0x41}, /* K */
	{0x7f, 0x40, 0x40, 0x40, 0x40}, /* L */
	{0x7f, 0x02, 0x0c, 0x02, 0x7f}, /* M */
	{0x7f, 0x04, 0x08, 0x10, 0x7f}, /* N */
	{0x3e, 0x41, 0x41, 0x41, 0x3e}, /* O */
	{0x7f, 0x09, 0x09, 0x09, 0x06}, /* P */
	{0x3e, 0x41, 0x51, 0x21, 0x5e}, /* Q */
	{0x7f, 0x09, 0x19, 0x29, 0x46}, /* R */
	{0x46, 0x49, 0x49, 0x49, 0x31}, /* S */
	{0x01, 0x01, 0x7f, 0x01, 0x01}, /* T */
	{0x3f, 0x40, 0x40, 0x40, 0x3f}, /* U */
	{0x1f, 0x20, 0x40, 0x20, 0x1f}, /* V */
	{0x3f, 0x40, 0x38, 0x40, 0x3f}, /* W */
	{0x63, 0x14, 0x08, 0x14, 0x63}, /* X */
	{0x07, 0x08, 0x70, 0x08, 0x07}, /* Y */
	{0x61, 0x51, 0x49, 0x45, 0x43}, /* Z */
	{0x00, 0x7f, 0x41, 0x41, 0x00}, /* [ */
	{0x02, 0x04, 0x08, 0x10, 0x20}, /* \ */
	{0x00, 0x41, 0x41, 0x7f, 0x00}, /* ] */
	{0x04, 0x02, 0x01, 0x02, 0x04}, /* ^ */
	{0x40, 0x40, 0x40, 0x40, 0x40}, /* _ */
	{0x00, 0x01, 0x02, 0x04, 0x00}, /* ` */
	{0x20, 0x54, 0x54, 0x54, 0x78}, /* a */
	{0x7f, 0x48, 0x44, 0x44, 0x38}, /* b */
	{0x38, 0x44, 0x44, 0x44, 0x20}, /* c */
	{0x38, 0x44, 0x44, 0x48, 0x7f}, /* d */
	{0x38, 0x54, 0x54, 0x54, 0x18}, /* e */
	{0x08, 0x7e, 0x09, 0x01, 0x02}, /* f */
	{0x0c, 0x52, 0x52, 0x52, 0x3e}, /* g */
	{0x7f, 0x08, 0x04, 0x04, 0x78}, /* h */
	{0x00, 0x44, 0x7d, 0x40, 0x00}, /* i */
	{0x20, 0x40, 0x44, 0x3d, 0x00}, /* j */
	{0x7f, 0x10, 0x28, 0x44, 0x00}, /* k */
	{0x00, 0x41, 0x7f, 0x40, 0x00}, /* l */
	{0x7c, 0x04, 0x18, 0x04, 0x78}, /* m */
	{0x7c, 0x08, 0x04, 0x04, 0x78}, /* n */
	{0x38, 0x44, 0x44, 0x44, 0x38}, /* o */
	{0x7c, 0x14, 0x14, 0x14, 0x08}, /* p */
	{0x08, 0x14, 0x14, 0x18, 0x7c}, /* q */
	{0x7c, 0x08, 0x04, 0x04, 0x08}, /* r */
	{0x48, 0x54, 0x54, 0x54, 0x20}, /* s */
	{0x04, 0x3f, 0x44, 0x40, 0x20}, /* t */
	{0x3c, 0x40, 0x40, 0x20, 0x7c}, /* u */
	{0x1c, 0x20, 0x40, 0x20, 0x1c}, /* v */
	{0x3c, 0x40, 0x30, 0x40, 0x3c}, /* w */
	{0x44, 0x28, 0x10, 0x28, 0x44}, /* x */
	{0x0c, 0x50, 0x50, 0x50, 0x3c}, /* y */
	{0x44, 0x64, 0x54, 0x4c, 0x44}, /* z */
	{0x00, 0x08, 0x36, 0x41, 0x00}, /* { */
	{0x00, 0x00, 0x7f, 0x00, 0x00}, /* | */
	{0x00, 0x41, 0x36, 0x08, 0x00}, /* } */
	{0x08, 0x04, 0x08, 0x10, 0x08}, /* ~ */
};

BUILD_ASSERT(ARRAY_SIZE(font5x7) == FONT_LAST_CHAR - FONT_FIRST_CHAR + 1);

static inline void put_pixel(const struct overlay_frame *frame, int x, int y, uint16_t color)
{
	uint8_t *p = frame->buf + (size_t)y * frame->pitch + (size_t)x * 2U;

	if (frame->big_endian) {
		sys_put_be16(color, p);
	} else {
		sys_put_le16(color, p);
	}
}

void overlay_fill(const struct overlay_frame *frame, int x0, int y0, int x1, int y1, uint16_t color)
{
	if (x1 < 0 || y1 < 0 || x0 >= frame->width || y0 >= frame->height) {
		return;
	}

	x0 = CLAMP(x0, 0, frame->width - 1);
	x1 = CLAMP(x1, 0, frame->width - 1);
	y0 = CLAMP(y0, 0, frame->height - 1);
	y1 = CLAMP(y1, 0, frame->height - 1);

	for (int y = y0; y <= y1; y++) {
		for (int x = x0; x <= x1; x++) {
			put_pixel(frame, x, y, color);
		}
	}
}

void overlay_rect(const struct overlay_frame *frame, int x0, int y0, int x1, int y1, int thickness,
		  uint16_t color)
{
	for (int t = 0; t < thickness; t++) {
		overlay_fill(frame, x0 + t, y0 + t, x1 - t, y0 + t, color);
		overlay_fill(frame, x0 + t, y1 - t, x1 - t, y1 - t, color);
		overlay_fill(frame, x0 + t, y0 + t, x0 + t, y1 - t, color);
		overlay_fill(frame, x1 - t, y0 + t, x1 - t, y1 - t, color);
	}
}

int overlay_text_width(const char *text, int scale)
{
	size_t len = strlen(text);

	if (len == 0) {
		return 0;
	}

	return (int)(len * (FONT_WIDTH + FONT_SPACING) - FONT_SPACING) * scale;
}

void overlay_text(const struct overlay_frame *frame, int x, int y, const char *text, int scale,
		  uint16_t color)
{
	for (; *text != '\0'; text++, x += (FONT_WIDTH + FONT_SPACING) * scale) {
		char c = *text;

		if (c < FONT_FIRST_CHAR || c > FONT_LAST_CHAR) {
			c = '?';
		}

		for (int col = 0; col < FONT_WIDTH; col++) {
			uint8_t bits = font5x7[c - FONT_FIRST_CHAR][col];

			for (int row = 0; row < OVERLAY_FONT_HEIGHT; row++) {
				if ((bits & BIT(row)) == 0U) {
					continue;
				}

				overlay_fill(frame, x + col * scale, y + row * scale,
					     x + (col + 1) * scale - 1, y + (row + 1) * scale - 1,
					     color);
			}
		}
	}
}
```

## src/overlay.h
```c
/*
 * SPDX-FileCopyrightText: Copyright The Zephyr Project Contributors
 * SPDX-License-Identifier: Apache-2.0
 */

#ifndef OVERLAY_H_
#define OVERLAY_H_

#include <stdbool.h>
#include <stdint.h>

/** An RGB565 frame to draw into */
struct overlay_frame {
	uint8_t *buf;
	uint16_t width;
	uint16_t height;
	/** Bytes per line */
	uint32_t pitch;
	/** True for RGB565X (big-endian) pixels */
	bool big_endian;
};

/** Height of a line of text at scale 1, in pixels */
#define OVERLAY_FONT_HEIGHT 7

/** Build an RGB565 color from 8-bit components */
#define OVERLAY_RGB(r, g, b) ((uint16_t)((((r) & 0xF8U) << 8) | (((g) & 0xFCU) << 3) | ((b) >> 3)))

void overlay_fill(const struct overlay_frame *frame, int x0, int y0, int x1, int y1,
		  uint16_t color);

void overlay_rect(const struct overlay_frame *frame, int x0, int y0, int x1, int y1, int thickness,
		  uint16_t color);

int overlay_text_width(const char *text, int scale);

void overlay_text(const struct overlay_frame *frame, int x, int y, const char *text, int scale,
		  uint16_t color);

#endif /* OVERLAY_H_ */
```
