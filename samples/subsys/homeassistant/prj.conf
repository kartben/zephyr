## CMakeLists.txt
```
# SPDX-License-Identifier: Apache-2.0

cmake_minimum_required(VERSION 3.20.0)

find_package(Zephyr REQUIRED HINTS $ENV{ZEPHYR_BASE})
project(homeassistant_sample)

target_sources(app PRIVATE src/main.c)
```

## sample.yaml
```
sample:
  name: Home Assistant Integration Sample
  description: Demonstrates Home Assistant integration using Zbus and MQTT
tests:
  sample.subsys.homeassistant:
    build_only: true
    platform_allow:
      - native_sim
      - qemu_x86
    integration_platforms:
      - native_sim
    tags:
      - homeassistant
      - mqtt
      - zbus
      - net
```

## prj.conf
```kconfig
# Home Assistant Integration Configuration

# Enable Home Assistant integration
CONFIG_HOMEASSISTANT=y

# MQTT Broker Configuration
# Change these to match your setup
CONFIG_HOMEASSISTANT_MQTT_BROKER_HOSTNAME="192.168.1.157"
CONFIG_HOMEASSISTANT_MQTT_BROKER_PORT=1883
CONFIG_HOMEASSISTANT_MQTT_CLIENT_ID="zephyr_demo"
CONFIG_HOMEASSISTANT_DEVICE_NAME="zephyr_demo"

# Uncomment and set if your MQTT broker requires authentication
# CONFIG_HOMEASSISTANT_MQTT_USERNAME="mqtt_user"
# CONFIG_HOMEASSISTANT_MQTT_PASSWORD="mqtt_password"

# Enable auto-discovery
CONFIG_HOMEASSISTANT_AUTO_DISCOVERY=y

# Zbus is automatically selected by HOMEASSISTANT
CONFIG_ZBUS=y
CONFIG_ZBUS_CHANNEL_NAME=y

# Networking
CONFIG_NETWORKING=y
CONFIG_NET_IPV4=y
CONFIG_NET_TCP=y
CONFIG_NET_SOCKETS=y
CONFIG_NET_CONNECTION_MANAGER=y

# DHCP
CONFIG_NET_DHCPV4=y

# DNS
CONFIG_DNS_RESOLVER=y
CONFIG_DNS_RESOLVER_ADDITIONAL_BUF_CTR=2
CONFIG_DNS_RESOLVER_ADDITIONAL_QUERIES=2

# Network management events
CONFIG_NET_MGMT=y
CONFIG_NET_MGMT_EVENT=y

# POSIX for inet_ntop
CONFIG_POSIX_API=y

# MQTT
CONFIG_MQTT_LIB=y
CONFIG_MQTT_CLEAN_SESSION=y

# Network buffers
CONFIG_NET_PKT_RX_COUNT=16
CONFIG_NET_PKT_TX_COUNT=16
CONFIG_NET_BUF_RX_COUNT=32
CONFIG_NET_BUF_TX_COUNT=32
CONFIG_NET_CONTEXT_NET_PKT_POOL=y

# Logging
CONFIG_LOG=y
CONFIG_NET_LOG=y
CONFIG_HOMEASSISTANT_LOG_LEVEL_INF=y

# Increase stack sizes
CONFIG_MAIN_STACK_SIZE=2048
CONFIG_SYSTEM_WORKQUEUE_STACK_SIZE=2048
CONFIG_NET_TX_STACK_SIZE=2048
CONFIG_NET_RX_STACK_SIZE=2048

# Random number generator for sensor simulation
CONFIG_TEST_RANDOM_GENERATOR=y


CONFIG_REQUIRES_FLOAT_PRINTF=y
```

## boards/native_sim.conf
```kconfig
# Additional configuration for native_sim board

# Network interface
CONFIG_NET_DRIVERS=y
CONFIG_NET_LOOPBACK=y

# Default network configuration for testing
CONFIG_NET_CONFIG_SETTINGS=y
CONFIG_NET_CONFIG_MY_IPV4_ADDR="192.0.2.1"
CONFIG_NET_CONFIG_MY_IPV4_NETMASK="255.255.255.0"
CONFIG_NET_CONFIG_MY_IPV4_GW="192.0.2.2"

# For testing, you may want to set a specific hostname
# Change this to your actual MQTT broker IP for testing
# CONFIG_HOMEASSISTANT_MQTT_BROKER_HOSTNAME="192.168.1.100"
```

## src/main.c
```c
/*
 * Copyright (c) 2024 Benjamin Cabé
 * SPDX-License-Identifier: Apache-2.0
 */

#include <zephyr/kernel.h>
#include <zephyr/logging/log.h>
#include <zephyr/homeassistant/homeassistant.h>
#include <zephyr/zbus/zbus.h>
#include <zephyr/random/random.h>
#include <zephyr/net/net_if.h>
#include <zephyr/net/net_mgmt.h>
#include <zephyr/net/conn_mgr_connectivity.h>
#include <zephyr/net/conn_mgr_monitor.h>

LOG_MODULE_REGISTER(ha_sample, LOG_LEVEL_INF);

/* Network readiness */
static struct net_mgmt_event_callback net_mgmt_cb;
static K_SEM_DEFINE(network_ready, 0, 1);

/* Network event handler */
static void net_event_handler(struct net_mgmt_event_callback *cb, uint64_t mgmt_event,
			      struct net_if *iface)
{
	if (mgmt_event == NET_EVENT_L4_CONNECTED) {
		LOG_INF("Network connected! DHCP address assigned");
		k_sem_give(&network_ready);
	}
}

/* Wait for network to be ready with DHCP */
static void wait_for_network(void)
{
	net_mgmt_init_event_callback(&net_mgmt_cb, net_event_handler, NET_EVENT_L4_CONNECTED);
	net_mgmt_add_event_callback(&net_mgmt_cb);

	/* Trigger connection manager to start DHCP */
	conn_mgr_mon_resend_status();

	LOG_INF("Waiting for network (DHCP)...");
	k_sem_take(&network_ready, K_FOREVER);
}

/* Define Zbus channels - these are the data sources
 * Note: Using simple types (float, bool) that are automatically formatted
 * by the Home Assistant subsystem for MQTT publishing
 */
ZBUS_CHAN_DEFINE(temperature_chan, float, NULL, NULL, ZBUS_OBSERVERS_EMPTY, ZBUS_MSG_INIT(0.0f));

ZBUS_CHAN_DEFINE(humidity_chan, float, NULL, NULL, ZBUS_OBSERVERS_EMPTY, ZBUS_MSG_INIT(0.0f));

ZBUS_CHAN_DEFINE(motion_chan, bool, NULL, NULL, ZBUS_OBSERVERS_EMPTY, ZBUS_MSG_INIT(false));

/* Register channels with Home Assistant */
static const struct homeassistant_channel_config temp_config = {
	.channel = &temperature_chan,
	.sensor_type = HOMEASSISTANT_SENSOR_TEMPERATURE,
	.friendly_name = "Living Room Temperature",
	.unit_of_measurement = "°C",
	.topic = NULL, /* Auto-generate topic */
	.value_template = NULL,
};

static const struct homeassistant_channel_config humidity_config = {
	.channel = &humidity_chan,
	.sensor_type = HOMEASSISTANT_SENSOR_HUMIDITY,
	.friendly_name = "Living Room Humidity",
	.unit_of_measurement = "%",
	.topic = NULL,
	.value_template = NULL,
};

static const struct homeassistant_channel_config motion_config = {
	.channel = &motion_chan,
	.sensor_type = HOMEASSISTANT_SENSOR_BINARY,
	.friendly_name = "Motion Sensor",
	.unit_of_measurement = NULL,
	.topic = NULL,
	.value_template = NULL,
};

/* Simulate sensor readings */
static void sensor_simulator_thread(void)
{
	float temp = 20.0f;
	float humidity = 50.0f;
	bool motion_state = false;
	int motion_counter = 0;

	LOG_INF("Sensor simulator started");

	while (1) {
		/* Simulate temperature changes */
		temp += ((float)sys_rand32_get() / UINT32_MAX - 0.5f) * 2.0f;
		if (temp < 15.0f) {
			temp = 15.0f;
		}
		if (temp > 30.0f) {
			temp = 30.0f;
		}

		zbus_chan_pub(&temperature_chan, &temp, K_SECONDS(1));

		LOG_INF("Temperature: %.1f °C", temp);

		k_sleep(K_SECONDS(5));

		/* Simulate humidity changes */
		humidity += ((float)sys_rand32_get() / UINT32_MAX - 0.5f) * 5.0f;
		if (humidity < 30.0f) {
			humidity = 30.0f;
		}
		if (humidity > 80.0f) {
			humidity = 80.0f;
		}

		zbus_chan_pub(&humidity_chan, &humidity, K_SECONDS(1));

		LOG_INF("Humidity: %.1f %%", humidity);

		k_sleep(K_SECONDS(5));

		/* Simulate motion detection - toggle every few cycles */
		motion_counter++;
		if (motion_counter >= 3) {
			motion_state = !motion_state;
			motion_counter = 0;

			zbus_chan_pub(&motion_chan, &motion_state, K_SECONDS(1));

			LOG_INF("Motion: %s", motion_state ? "DETECTED" : "CLEAR");
		}

		k_sleep(K_SECONDS(5));
	}
}

K_THREAD_DEFINE(sensor_sim_tid, 2048, sensor_simulator_thread, NULL, NULL, NULL, 7, 0, 0);

int main(void)
{
	int ret;

	LOG_INF("=================================================");
	LOG_INF("  Home Assistant Integration Sample");
	LOG_INF("=================================================");
	LOG_INF("");
	LOG_INF("This sample demonstrates easy Home Assistant");
	LOG_INF("integration using Zbus and MQTT.");
	LOG_INF("");
	LOG_INF("Simply publish to Zbus channels and they");
	LOG_INF("automatically appear in Home Assistant!");
	LOG_INF("");
	LOG_INF("MQTT Broker: %s:%d", CONFIG_HOMEASSISTANT_MQTT_BROKER_HOSTNAME,
		CONFIG_HOMEASSISTANT_MQTT_BROKER_PORT);
	LOG_INF("Device Name: %s", CONFIG_HOMEASSISTANT_DEVICE_NAME);
	LOG_INF("");

	/* Wait for network to be ready (DHCP) */
	wait_for_network();

	/* Register channels with Home Assistant */
	ret = homeassistant_register_channel(&temp_config);
	if (ret) {
		LOG_ERR("Failed to register temperature channel: %d", ret);
		return ret;
	}

	ret = homeassistant_register_channel(&humidity_config);
	if (ret) {
		LOG_ERR("Failed to register humidity channel: %d", ret);
		return ret;
	}

	ret = homeassistant_register_channel(&motion_config);
	if (ret) {
		LOG_ERR("Failed to register motion channel: %d", ret);
		return ret;
	}

	LOG_INF("All channels registered successfully!");
	LOG_INF("");
	LOG_INF("Waiting for MQTT connection...");

	/* Wait a bit for connection */
	k_sleep(K_SECONDS(5));

	if (homeassistant_is_connected()) {
		LOG_INF("✓ Connected to Home Assistant!");
		LOG_INF("");
		LOG_INF("Check your Home Assistant UI for:");
		LOG_INF("  - Living Room Temperature");
		LOG_INF("  - Living Room Humidity");
		LOG_INF("  - Motion Sensor");
	} else {
		LOG_WRN("Not yet connected - will retry automatically");
	}

	LOG_INF("");
	LOG_INF("Publishing simulated sensor data...");
	LOG_INF("");

	return 0;
}
```
