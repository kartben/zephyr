/*
 * Copyright The Zephyr Project Contributors
 * SPDX-License-Identifier: Apache-2.0
 */

#include <zephyr/dt-bindings/gpio/gpio.h>

/*
 * OTG2 drives the USB Type-A host connector (CN17). Its VBUS comes from an
 * STMPS2151 power switch enabled by PB9. The register values come from the
 * controller's own hardware configuration registers.
 */
zephyr_uhc0: &usbotg_hs2 {
	compatible = "st,stm32n6-hsotg", "snps,dwc2";
	/delete-property/ num-bidir-endpoints;
	/delete-property/ ram-size;
	/delete-property/ maximum-speed;
	num-in-eps = <9>;
	num-out-eps = <9>;
	ghwcfg1 = <0x00000000>;
	ghwcfg2 = <0x228fe052>;
	ghwcfg4 = <0xe2103e30>;
	vbus-gpios = <&gpiob 9 GPIO_ACTIVE_HIGH>;
	status = "okay";
};

/* Only OTG2 is used, and the Type-C port is the boot ROM's */
&usbotg_hs1 {
	status = "disabled";
};
