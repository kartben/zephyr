/*
 * SPDX-FileCopyrightText: Copyright The Zephyr Project Contributors
 * SPDX-License-Identifier: Apache-2.0
 */

/* Feed the display with DMA, so that the CPU draws while a strip is sent */
&spi2 {
	dma-enabled;
	dmas = <&dma 0>, <&dma 1>;
	dma-names = "rx", "tx";
};
