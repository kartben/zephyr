## samples/subsys/mpipe/espdet/modules/esp-dl/zephyr/Kconfig
```kconfig
# SPDX-FileCopyrightText: Copyright The Zephyr Project Contributors
# SPDX-License-Identifier: Apache-2.0

menuconfig ESP_DL
	bool "Espressif ESP-DL inference library"
	depends on SOC_SERIES_ESP32S3
	depends on ESP_SPIRAM
	depends on STD_CPP20 || STD_CPP2B
	select REQUIRES_FULL_LIBCPP
	select SYS_HEAP_RUNTIME_STATS
	help
	  Build ESP-DL, Espressif's neural network inference library, from an
	  ESP-DL source tree given by the ESP_DL_DIR CMake or environment
	  variable. The model reader, which ESP-DL only distributes as a
	  prebuilt library, is replaced by an open implementation.

if ESP_DL

config ESP_DL_INTERNAL_HEAP_SIZE
	int "Internal RAM heap size for ESP-DL"
	default 131072
	help
	  Size in bytes of the heap in internal SRAM that serves ESP-DL
	  allocations asking for internal memory. The model places its
	  activation buffers here first, as internal SRAM is faster than PSRAM.

config ESP_DL_PSRAM_HEAP_SIZE
	int "PSRAM heap size for ESP-DL"
	default 2097152
	help
	  Size in bytes of the heap carved out of the PSRAM shared multi-heap
	  that serves all other ESP-DL allocations: model parameters, the
	  activations that do not fit in internal SRAM and tensor bookkeeping.
	  It is taken from ESP_SPIRAM_HEAP_SIZE, which must leave room for it.

endif # ESP_DL
```

## soc/mediatek/mt8xxx/mt8196/Kconfig
```kconfig
# Copyright 2024 The ChromiumOS Authors
# SPDX-License-Identifier: Apache-2.0

config SOC_MT8196_ADSP
	select XTENSA
	select XTENSA_HAL if ("$(ZEPHYR_TOOLCHAIN_VARIANT)" != "xcc" && "$(ZEPHYR_TOOLCHAIN_VARIANT)" != "xt-clang")
	select CPU_HAS_DCACHE
	select ARCH_HAS_NOCACHE_MEMORY_SUPPORT
```

## subsys/portability/posix/options/Kconfig.procN
```kconfig
# Copyright (c) 2024 Tenstorrent AI ULC
#
# SPDX-License-Identifier: Apache-2.0

menuconfig POSIX_MULTI_PROCESS
	bool "POSIX multi-process support"
	help
	  Support for multi-processing.

	  Note: Currently Zephyr does not support multiple processes and therefore much of this option
	  group is not implemented and is considered undefined behaviour.

	  For more information, please see
	  https://pubs.opengroup.org/onlinepubs/9699919799/xrat/V4_subprofiles.html

if POSIX_MULTI_PROCESS

config POSIX_MULTI_PROCESS_TIMES
	bool "times()"
	default y
	select SCHED_THREAD_USAGE
	select THREAD_RUNTIME_STATS
	help
	  Provide times(). It reports the time a process has run for, which
	  Zephyr takes from the scheduler's thread usage statistics, and those
	  are gathered at every context switch whether or not anything asks
	  for them. Say n in a program that never calls times().

# These options are intended to be used for compatibility with external POSIX
# implementations such as those in Newlib or Picolibc.

config POSIX_MULTI_PROCESS_ALIAS_GETPID
	bool
	default y
	help
	  Select 'y' here and Zephyr will provide an alias for getpid() as _getpid().

endif # POSIX_MULTI_PROCESS
```

## subsys/usb/device_next/class/Kconfig.cdc_ecm
```kconfig
# Copyright (c) 2023 Nordic Semiconductor ASA
#
# SPDX-License-Identifier: Apache-2.0

config USBD_CDC_ECM_CLASS
	bool "USB CDC ECM implementation"
	default y
	depends on NET_L2_ETHERNET
	depends on DT_HAS_ZEPHYR_CDC_ECM_ETHERNET_ENABLED
	help
	  USB CDC Ethernet Control Model (ECM) implementation"

if USBD_CDC_ECM_CLASS

config USBD_CDC_ECM_RX_BUF_COUNT
	int "Number of receive buffers per CDC ECM instance"
	range 1 16
	default 2
	help
	  Number of buffers queued on the bulk OUT endpoint of a CDC ECM
	  instance. The host is NAKed whenever the endpoint runs out of
	  buffers, which with a single buffer happens on every received frame
	  because the endpoint stays empty until the class has passed the
	  frame to the network stack. Each buffer costs NET_ETH_MAX_FRAME_SIZE
	  bytes of RAM.

config USBD_CDC_ECM_TX_BUF_COUNT
	int "Number of transmit buffers per CDC ECM instance"
	range 1 16
	default 2
	help
	  Number of frames that can be in flight towards the host at once. With
	  a single buffer the network stack has to wait for a frame to reach
	  the host before it can prepare the next one, which puts a full
	  interrupt to thread round trip between two frames. Each buffer costs
	  NET_ETH_MAX_FRAME_SIZE bytes of RAM.

module = USBD_CDC_ECM
module-str = usbd cdc_ecm
default-count = 1
source "subsys/logging/Kconfig.template.log_config"

endif
```

## subsys/usb/device_next/class/Kconfig.cdc_ncm
```kconfig
# Copyright (c) 2024 Nordic Semiconductor ASA
#
# SPDX-License-Identifier: Apache-2.0

config USBD_CDC_NCM_CLASS
	bool "USB CDC NCM implementation"
	default y
	depends on NET_L2_ETHERNET
	depends on DT_HAS_ZEPHYR_CDC_NCM_ETHERNET_ENABLED
	help
	  USB CDC Network Control Model (NCM) implementation

if USBD_CDC_NCM_CLASS

config USBD_CDC_NCM_MAX_DGRAM_PER_NTB
	int "Max number of received datagrams per NTB"
	range 0 $(UINT16_MAX)
	default 2
	help
	  How many datagrams we are able to receive per NTB.

config USBD_CDC_NCM_RX_BUF_COUNT
	int "Number of receive buffers per CDC NCM instance"
	range 1 16
	default 2
	help
	  Number of buffers queued on the bulk OUT endpoint of a CDC NCM
	  instance. The host is NAKed whenever the endpoint runs out of
	  buffers, which with a single buffer happens on every received NTB
	  because the endpoint stays empty until the class has unpacked the
	  NTB and passed its datagrams to the network stack. Each buffer costs
	  CDC_NCM_RECV_NTB_MAX_SIZE bytes of RAM.

config USBD_CDC_NCM_TX_BUF_COUNT
	int "Number of transmit buffers per CDC NCM instance"
	range 1 16
	default 2
	help
	  Number of NTBs that can be in flight towards the host at once. With a
	  single buffer the network stack has to wait for an NTB to reach the
	  host before it can prepare the next one, which puts a full interrupt
	  to thread round trip between two NTBs. Each buffer costs
	  CDC_NCM_SEND_NTB_MAX_SIZE bytes of RAM.

config USBD_CDC_NCM_SUPPORT_NTB32
	bool "Support NTB32 format"
	help
	  Enable support for NTB32 format which allows larger
	  packet sizes.

module = USBD_CDC_NCM
module-str = usbd cdc_ncm
source "subsys/logging/Kconfig.template.log_config"

endif
```

## subsys/usb/device_next/class/Kconfig.midi2
```kconfig
# Copyright (c) 2024 Titouan Christophe
#
# SPDX-License-Identifier: Apache-2.0

config USBD_MIDI2_CLASS
	bool "USB MIDI 2.0 class support [EXPERIMENTAL]"
	select RING_BUFFER
	help
	  Enable the USB MIDI 2.0 device class support.

if USBD_MIDI2_CLASS

config USBD_MIDI2_RX_BUF_COUNT
	int "Number of receive buffers per USB MIDI 2.0 instance"
	range 1 16
	default 2
	help
	  Number of buffers queued on the bulk OUT endpoint of a USB MIDI 2.0
	  instance. The host is NAKed whenever the endpoint runs out of
	  buffers, which with a single buffer happens on every received packet
	  because the endpoint stays empty until the re-arm has travelled
	  through the system workqueue. Each buffer costs 512 bytes of RAM.

module = USBD_MIDI2
module-str = usbd midi2
source "subsys/logging/Kconfig.template.log_config"

endif
```

## tests/cmake/module_requirements/Kconfig
```kconfig
# SPDX-License-Identifier: Apache-2.0

config APPLICATION_REQUIRE_HAL_TDK
	bool
	default y
	select ZEPHYR_HAL_TDK_MODULE_REQUIRED

source "Kconfig.zephyr"
```

## tests/misc/dtdoctor/dts/bindings/vnd,dtdoctor-device.yaml
```yaml
# SPDX-FileCopyrightText: Copyright The Zephyr Project Contributors
# SPDX-License-Identifier: Apache-2.0

description: Fake device without a driver, used by the DT Doctor integration test

compatible: "vnd,dtdoctor-device"

properties:
  dtdoctor-speed:
    type: int
    description: set by the fixture, for the "no such property" diagnosis
  dtdoctor-optional:
    type: int
    description: declared here but never set, and with no default
```

## tests/misc/dtdoctor/dts/bindings/vnd,dtdoctor-gpio.yaml
```yaml
# SPDX-FileCopyrightText: Copyright The Zephyr Project Contributors
# SPDX-License-Identifier: Apache-2.0

description: Fake GPIO controller, used by the DT Doctor integration test

compatible: "vnd,dtdoctor-gpio"

gpio-cells:
  - pin
  - flags

properties:
  gpio-controller:
    type: boolean
    required: true
  "#gpio-cells":
    type: int
    required: true
```

## tests/misc/dtdoctor/dts/bindings/vnd,dtdoctor-nested-device.yaml
```yaml
# SPDX-FileCopyrightText: Copyright The Zephyr Project Contributors
# SPDX-License-Identifier: Apache-2.0

description: Fake device below a disabled parent, used by the DT Doctor integration test

compatible: "vnd,dtdoctor-nested-device"
```

## zenbedded-demo/Kconfig
```kconfig
# Copyright (c) 2026 zenbedded contributors
# SPDX-License-Identifier: Apache-2.0

menuconfig ZENBEDDED
	bool "zenbedded joint control core"
	help
	  Real-time joint control core for the zenbedded demo. Provides the
	  1 kHz control thread, PID, failover state machine, lock-free setpoint
	  handoff and loop-period histogram.

if ZENBEDDED

module = ZENBEDDED
module-str = zenbedded
source "subsys/logging/Kconfig.template.log_config"

menu "Control loop"

config ZENBEDDED_CONTROL_PERIOD_US
	int "Control loop period (us)"
	default 1000
	range 100 100000
	help
	  Period of the control loop. The loop is woken by the kernel timer,
	  never by k_sleep(), and the loop-period histogram buckets are derived
	  from this value.

config ZENBEDDED_CONTROL_PRIO
	int "Control thread cooperative priority"
	default 1
	range 0 15
	help
	  Cooperative priority of the control thread, passed through
	  K_PRIO_COOP(). The comms thread must be preemptible and therefore is
	  always strictly lower priority, whatever this is set to.

config ZENBEDDED_CONTROL_STACK_SIZE
	int "Control thread stack size"
	default 2048

config ZENBEDDED_CONTROL_AUTOSTART
	bool "Start the control thread automatically"
	default y
	help
	  Start the 1 kHz control thread at boot. Tests turn this off so they
	  can drive zb_control_step() directly, in virtual time, and get
	  deterministic results.

endmenu

menu "Failover"

config ZENBEDDED_AGE_DEGRADED_MS
	int "FOLLOWING -> DEGRADED threshold (ms)"
	default 30
	help
	  Age of the last accepted command beyond which the joint stops
	  tracking and holds its last valid setpoint at full gains.

config ZENBEDDED_AGE_HOLDING_MS
	int "DEGRADED -> HOLDING threshold (ms)"
	default 500
	help
	  Age beyond which holding effort is clamped to hold-effort-mnm.

config ZENBEDDED_AGE_PARK_MS
	int "HOLDING -> PARK threshold (ms)"
	default 3000
	help
	  Age beyond which the joint performs a rate-limited descent to its
	  park target and then disables the driver.

config ZENBEDDED_RESUME_EPSILON_MRAD
	int "Resume acceptance window (mrad)"
	default 50
	help
	  Once the joint has left FOLLOWING it refuses to resume until it
	  receives a command within this distance of its current position.
	  This is what stops ros2_control from slamming the arm with whatever
	  stale command was sitting in its buffer at reactivation.

config ZENBEDDED_RESUME_RAMP_MS
	int "Gain ramp on resume (ms)"
	default 250
	help
	  After a resume command is accepted, control gains are ramped from
	  zero to full over this interval.

config ZENBEDDED_PARK_SETTLE_MRAD
	int "PARK settle window (mrad)"
	default 20
	help
	  Distance from the park target within which the joint is considered
	  parked.

config ZENBEDDED_PARK_SETTLE_MRAD_S
	int "PARK settle speed (mrad/s)"
	default 50
	help
	  Speed below which the joint is considered settled. Once inside both
	  the settle window and this speed, the driver is disabled and the
	  joint coasts.

endmenu

choice ZENBEDDED_PLANT
	prompt "Plant backend"
	default ZENBEDDED_PLANT_SIM
	help
	  Selects what the control core drives. Both backends sit behind the
	  same internal API (include/zenbedded/plant.h), so the control core,
	  the failover machine and the tests are identical either way.

config ZENBEDDED_PLANT_SIM
	bool "Simulated second-order plant"
	help
	  Second-order plant with a gravity term, integrated in the control
	  step. Inertia, damping and gravity torque come from devicetree. Lets
	  the whole control core be tested headless.

config ZENBEDDED_PLANT_HW
	bool "Real motor and encoder"
	help
	  Drives the motor and encoder phandles from devicetree. Phase 4.

endchoice

config ZENBEDDED_HIST
	bool "Loop period histogram"
	default y
	help
	  Bin the control loop period on-device into a fixed-size RAM
	  histogram. Publishing per-sample timestamps at 1 kHz would inject the
	  jitter the demo is trying to measure.

endif # ZENBEDDED
```
